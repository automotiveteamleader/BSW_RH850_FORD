AUTOSAR XML (schema 4-0-3)
package /AUTOSAR/EcucDefs
  module definition CryIf [0..1]: category=STANDARDIZED_MODULE_DEFINITION, variants pre-compile  # Configuration of the Crypto Interface.
    container CryIfChannels  # Container for CryIfChannels.
      container CryIfChannel [0..*]  # Container for Channel configuration
        integer CryIfChannelId: 0..4294967295, set at pre-compile, symbolic-name-value=true, default-value=0  # Identifier of the crypto channel
        symbolic name reference CryIfDriverObjectRef: set at pre-compile, destination=CryptoDriverObject  # Reference to a Crypto Driver Object
    container CryIfKeys  # Container for CryIfKeys.
      container CryIfKey [1..*]  # Container for Channel configuration
        integer CryIfKeyId: 0..4294967295, set at pre-compile, symbolic-name-value=true, default-value=0  # Identifier of the key.
        symbolic name reference CryIfKeyRef: set at pre-compile, destination=CryptoKey  # This parameter refers to the crypto driver key.
    container CryIfGeneral  # Container for common configuration options.
      boolean CryIfDevErrorDetect: set at pre-compile, default-value=true  # Switches the development error detection and notification on or off.  true: detection and notification is enabled.  false: detection and notification is disabled. | True: Development error detection enabled. False: Development error detection disabled
      integer CryIfMaxNumberOfKeyElements: set at pre-compile, default-value=30  # Size of the largest key element of all referenced Crypto Drivers (This parameter can also be generated by smart generator logic)
      integer CryIfMaxSizeOfKeyElement: set at pre-compile, default-value=400  # Size of the largest key element of all referenced Crypto Drivers (This parameter can also be generated by smart generator logic)
