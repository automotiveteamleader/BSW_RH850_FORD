AUTOSAR XML (schema 4-0-3)
# The material contained in this specification is protected by copyright and
# other types of Intellectual Property Rights. The commercial exploitation of
# the material contained in this specification requires a license to such
# Intellectual Property Rights.
# This specification may be utilized or reproduced without any modification, in
# any form or by any means, for informational purposes only.
# For any other purpose, no part of the specification may be utilized or
# reproduced, in any form or by any means, without permission in writing from
# the publisher.
# licensed under the same rules as applicable to the AUTOSAR Standard.
package /AUTOSAR/EcucDefs
  module definition EthSM [0..1]: variants pre-compile  # Configuration of the Ethernet State Manager
    container EthSMGeneral  # This container contains the global parameter of the Ethernet State Manager.
      boolean EthSMDevErrorDetect: set at pre-compile  # Enables and disables the development error detection and notification mechanism.
      boolean EthSMDummyMode: set at pre-compile  # Disables the API to the EthIf. The API to the ComM is available but the functionality is deactivated. The function calls from the ComM will be answered with the return value E_OK.
      float EthSMMainFunctionPeriod: 0.005..1, set at pre-compile  # Specifies the period in seconds that the MainFunction has to be triggered with.
      boolean EthSMVersionInfoApi: set at pre-compile  # Enables and disables the version info API.
    container EthSMNetwork [1..*]  # This container contains the Ethernet network-specific parameters of each Ethernet network. It also contains the controller and transceiver IDs assigned to a Ethernet network.
      float EthSMConfirmationTimeout: 0..Inf, set at pre-compile  # Timeout in seconds for the calls to EthIf: | EthIf_ControllerInit EthIf_TransceiverInit EthIf_SetControllerMode EthIf_SetTransceiverMode
      symbolic name reference EthSMComMNetworkHandleRef: set at pre-compile, destination=ComMChannel  # Unique handle to identify one certain Ethernet network. Reference to one of the network handles configured for the ComM.
      symbolic name reference EthSMEthIfControllerRef: set at pre-compile, destination=EthIfController  # Reference to EthIfCtrl container where a ETH controller and | transceiver (optional) combination is configured.
      container EthSMDemEventParameterRefs [0..1]  # Container for the references to DemEventParameter elements which shall be invoked using the API Dem_ReportErrorStatus API in case the corresponding error occurs. The EventId is taken from the referenced DemEventParameter's DemEventId value. The standardized errors are provided in the container and can be extended by vendor specific error references.
        symbolic name reference ETHSM_E_LINK_DOWN [0..1]: set at pre-compile, destination=DemEventParameter  # Reference to configured DEM event to report bus off errors for this Eth network.
