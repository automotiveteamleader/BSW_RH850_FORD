AUTOSAR XML (schema 4-0-3)
# The material contained in this specification is protected by copyright and
# other types of Intellectual Property Rights. The commercial exploitation of
# the material contained in this specification requires a license to such
# Intellectual Property Rights.
# This specification may be utilized or reproduced without any modification, in
# any form or by any means, for informational purposes only.
# For any other purpose, no part of the specification may be utilized or
# reproduced, in any form or by any means, without permission in writing from
# the publisher.
# licensed under the same rules as applicable to the AUTOSAR Standard.
package /AUTOSAR/EcucDefs
  module definition StbM [0..1]: variants pre-compile  # Configuration of the Synchronized Time-base Manager (StbM) module.
    container StbMDemEventParameterRefs [0..1]  # Container for the references to DemEventParameter elements which shall be invoked using the API Dem_ReportErrorStatus API in case the corresponding error occurs. The EventId is taken from the referenced DemEventParameter's DemEventId value. The standardized errors are provided in the container and can be extended by vendor specific error references.
      symbolic name reference STBM_E_INIT_FAILED [0..1]: set at pre-compile, destination=DemEventParameter  # Reference to the DemEventParameter which shall be issued when the error "StbM initialization failed" has occured.
      symbolic name reference STBM_E_INTEGRITY_FAILED [0..1]: set at pre-compile, destination=DemEventParameter  # Reference to the DemEventParameter which shall be issued when the error "API request integrity failed" has occured.
      symbolic name reference STBM_E_REQ_FAILED [0..1]: set at pre-compile, destination=DemEventParameter  # Reference to the DemEventParameter which shall be issued when the error "API request failed" has occured.
    container StbMGeneral  # This container holds the general parameters of the Synchronized Time-base Manager
      boolean StbMAbsoluteTimeApi: set at pre-compile  # Enables/Disables the StbM_GetAbsoluteTime API.
      boolean StbMDevErrorDetect: set at pre-compile  # Switch for enabling the development error detection.
      integer StbMTickTypeRange: 0..65535, set at pre-compile  # Defines the upper range of the type "StbM_TickType".
      boolean StbMVersionInfo: set at pre-compile  # Activate/Deactivate the version information API (StbM_GetVersionInfo). True: version information API activated False: version information API deactivated.
    container StbMSynchronizedTimeBase [1..*]  # Synchronized time.base collects the information about a specific time-base provider within the system.
      function name StbMGlobalTimeProviderCallout [0..1]: set at pre-compile  # Entry address of the time-base specific callout routine which shall be invoked by the StbM for gathering the current time-base value. | In case the synchronized time-base is derived from the local time, this container can be omitted. For this case, the StbM achieves the current time-base value by calling the OS interface "GetCounterValue" with the respective OSCounter configured via the ECUC param "StbMLocalTimeRef".
      function name StbMSyncStateProviderCallout [0..1]: set at pre-compile  # Entry address of the time-base specific callout routine which shall be invoked by the StbM for gathering the current time-base status. | In case the synchronized time-base is derived from the local time, this container can be omitted. For this case, the state is always "STBM_STATE_SYNC".
      integer StbMSynchronizedTimeBaseIdentifier: 0..65535, set at pre-compile, symbolic-name-value=true  # Identification of a synchronized time-base via a unique identifier.
      function name StbMTickDurationProviderCallout [0..1]: set at pre-compile  # Entry address of the time-base specific callout routine which shall be invoked by the StbM for gathering the current time-base tick duration. | In case the synchronized time-base is derived from the local time, this container can be omitted. For this case, the StbM achieves the tick duration by configuring an alarm which uses the HW counter configured via the ECUC param "StbMLocalTimeRef". Note: The tick duration of the local time will not change during runtime.
      foreign reference StbMFlexRayClusterRef [0..1]: set at pre-compile, destination-type=FLEXRAY-CLUSTER  # Optional reference to the FlexRay cluster.
      foreign reference StbMTtcanClusterRef [0..1]: set at pre-compile, destination-type=TTCAN-CLUSTER  # Optional reference to the Ttcan cluster.
      reference StbMLocalTimeRef [0..1]: set at pre-compile, destination=OsCounter  # Optional sub container in case a local time shall be accessed. | In case this subcontainer is used, the destinated OS counter has to be configured properly, meaning: - the counter is directly driven by a HW timer - the counter's OsCounterTicksPerBase set to one tick in ms.
    container StbMTriggeredCustomer [1..*]  # The triggered customer is directliy triggered by the Synchronized Time-base Manager by getting synchronized with the current (global) definition of time and passage of time.
      function name StbMGlobalTimeCustomerCallback [0..1]: set at pre-compile  # Entry address of the customer specific call-back routine which shall be invoked by the StbM periodically for time value propagation. | This configuration is only valid if the explicit OS ScheduleTable is NOT defined as triggered customer (via the reference "StbMOSScheduleTableRef").
      function name StbMSyncStateCustomerCallback [0..1]: set at pre-compile  # Entry address of the customer specific call-back routine which shall be invoked by the StbM when state changes occur. | This configuration is only valid if the explicit OS ScheduleTable is NOT defined as triggered customer (via the reference "StbMOSScheduleTableRef").
      boolean StbMTriggerInSyncState: set at pre-compile  # Activate/Deactivate the triggering of the customer in case the related time-base (StbmSynchronizedTimeBaseRef) is not synchronized. | True: the customer will only be triggered when the related time-base is synchronized. False: the customer will be triggered with the local time-base when no synchronization for the related time-base is established.
      integer StbMTriggeredCustomerPeriod: 0..4294967295, set at pre-compile  # The triggering period of the triggered customer, called by the StbM_MainFunction. | The period is documented in microseconds.
      reference StbMOSScheduleTableRef [0..1]: set at pre-compile, destination=OsScheduleTable  # Optional reference to synchronized OS ScheduleTables. | This configuration is only valid if the triggered customer shall be an OS ScheduleTable. In this case, the OS ScheduleTable will be explicitely synchronized by the StbM.
      symbolic name reference StbMSynchronizedTimeBaseRef: set at pre-compile, destination=StbMSynchronizedTimeBase  # Mandatory reference to the required synchronized time-base.
