AUTOSAR XML (schema 4-0-3)
# The material contained in this specification is protected by copyright and
# other types of Intellectual Property Rights. The commercial exploitation of
# the material contained in this specification requires a license to such
# Intellectual Property Rights.
# This specification may be utilized or reproduced without any modification, in
# any form or by any means, for informational purposes only.
# For any other purpose, no part of the specification may be utilized or
# reproduced, in any form or by any means, without permission in writing from
# the publisher.
# licensed under the same rules as applicable to the AUTOSAR Standard.
package /AUTOSAR/EcucDefs
  module definition TcpIp [0..1]: variants link-time/post-build/pre-compile  # Configuration of the TcpIp (TCP/IP stack) module.
    container TcpIpConfig  # This container contains the configuration parameters and sub containers of the AUTOSAR TcpIp module.
      container TcpIpCtrl [1..*]  # Specifies the EthIf controller used for IP communication and TcpIp errors that shall be reported to DEM.
        integer TcpIpIpFramePrioDefault [0..1]: 0..7, default-value=0  # Specifies the default value for the frame priority used by all sockets. | Note: the value can be changed for each socket individually via TcpIp_ChangeParameter() service. If this optional parameter is not available, 0 is used as default priority.
        reference TcpIpDhcpServerConfigRef [0..1]: destination=TcpIpDhcpServerConfig  # Reference to a TcpIpDhcpServerConfig which shall be used for this controller setting (VLAN).
        symbolic name reference TcpIpEthIfCtrlRef: destination=EthIfController  # Reference to EthIf controller where the IP address shall be assigned.
        container TcpIpCtrlDemEventParameterRefs [0..1]  # This container is a subcontainer of TcpIpCtrl and specifies the references to DemEventParameter elements which shall be invoked using the API Dem_ReportErrorStatus API in case the corresponding TcpIp error occurs for communication on the EthIf Controller. The EventId is taken from the referenced DemEventParameter's DemEventId value. The standardized errors are provided in the container and can be extended by vendor specific error references.
          symbolic name reference TCPIP_E_CONNREFUSED [0..1]: destination=DemEventParameter  # Reference to the DemEventParameter which shall be issued when the error "Connection refused” has occurred.
          symbolic name reference TCPIP_E_HOSTUNREACH [0..1]: destination=DemEventParameter  # Reference to the DemEventParameter which shall be issued when the error "No route to host” has occurred.
          symbolic name reference TCPIP_E_PACKETTOBIG [0..1]: destination=DemEventParameter  # Reference to the DemEventParameter which shall be issued when the error "Path does not support frame size" has occurred.
          symbolic name reference TCPIP_E_TIMEDOUT [0..1]: destination=DemEventParameter  # Reference to the DemEventParameter which shall be issued when the error "Operation timed out” has occurred.
        choice container TcpIpIpVXCtrl  # Specifies whether this controller is an Internet Protocol version 4 (IPv4) or Internet Protocol version 6 (IPv4) instance.
          container TcpIpIpV4Ctrl [0..1]  # Specifies an Internet Protocol version 4 (IPv4) instance.
            integer TcpIpIpTypeOfServiceDefault: 0..255, set at pre-compile, origin=Vector Informatik, default-value=0  # This value specifies the default for the "Type of Service" field of the IPv4 header in outgoing packets on this IP controller.
            integer TcpIpIpCtrlIdx: 0..255, origin=Vector Informatik, symbolic-name-value=true, default-value=0  # IpV4 Controller Index | IPv4 controller index (calculated automatically)
            integer TcpIpIpDefaultTtl: 0..255, set at pre-compile, origin=Vector Informatik, default-value=64  # Default Time To Live | This value specifies the default for the "Time to Live" field of the IPv4 header in outgoing packets on this IP controller.
            reference TcpIpArpConfigRef [0..1]: destination=TcpIpArpConfig  # Reference to ARP configuration for this IPv4 instance. | (Multiple IPv4 instances may use the same configuration container but will operate independently)
            reference TcpIpAutoIpConfigRef [0..1]: destination=TcpIpAutoIpConfig  # Reference to AutoIp configuration for this IPv4 instance. | (Multiple IPv4 instances may use the same configuration container but will operate independently)
            reference TcpIpDhcpConfigRef [0..1]: destination=TcpIpDhcpConfig  # Reference to DHCP configuration for this IPv4 instance. | (Multiple IPv4 instances may use the same configuration container but will operate independently)
            reference TcpIpFragmentationConfigRef [0..1]: destination=TcpIpIpFragmentationConfig  # Reference to Fragmentation configuration for this IPv4 instance. | (Multiple IPv4 instances may use the same configuration container but will operate independently)
            reference TcpIpStaticArpTableRef [0..1]: origin=Vector Informatik, destination=TcpIpStaticArpTable  # Reference to a static ARP table that shall be used for this controller.
          container TcpIpIpV6Ctrl [0..1]  # Specifies an Internet Protocol version 6 (IPv6) instance.
            integer TcpIpIpV6DefaultHopLimit: 0..255, set at pre-compile, origin=Vector Informatik, default-value=64  # Default Hop Limit | This value specifies the default Hop Limit for outgoing IPv6 packets. If "Allow Hop Limit Reconfiguration" is checked, the value may be reconfigured based on received Router Advertisements according to [RFC4861 6.3.4. Processing Received Router Advertisements].
            integer TcpIpIpV6DefaultTrafficClass: 0..255, set at pre-compile, origin=Vector Informatik, default-value=0  # This value specifies the default 'Traffic Class' set in the IPv6 header of outgoing packets of this controller. This value may be changed to a socket specific value during runtime.
            integer TcpIpIpV6DefaultFlowLabel: 0..1048575, set at pre-compile, origin=Vector Informatik, default-value=0  # This value specifies the default 'FlowLabel' set in the IPv6 header of outgoing packets of this controller. This value may be changed to a socket specific value during runtime.
            integer TcpIpIpV6CtrlIdx: 0..255, origin=Vector Informatik, symbolic-name-value=true, default-value=0  # IpV6 Controller Index | IPv6 controller index (calculated automatically)
            reference TcpIpIpV6DhcpConfigRef [0..1]: destination=TcpIpDhcpV6Config  # Reference to DHCPv6 configuration. | (Multiple IPv6 instances may use the same configuration container but will operate independently)
            reference TcpIpIpV6FragmentationConfigRef [0..1]: destination=TcpIpIpV6FragmentationConfig  # Reference to IPv6 Fragmentation Configuration. | (Multiple IPv6 instances may use the same configuration container but will operate independently)
            reference TcpIpIpV6NdpConfigRef: destination=TcpIpNdpConfig  # Reference to Neighbor Discovery Protocol Configuration. | (Multiple IPv6 instances may use the same configuration container but will operate independently)
            reference TcpIpIpV6MldConfigRef [0..1]: set at pre-compile, origin=Vector Informatik, destination=TcpIpIpV6MldConfig  # MLDv2 Configuration | Reference to Multicast Listener Discovery version 2 Configuration. If no reference is set, MLDv2 [RFC3810] is disabled on this IpV6 instance. (Multiple IpV6 instances may use the same configuration container but will operate independently)
            reference TcpIpIpV6PrivExtConfigRef [0..1]: set at pre-compile, origin=Vector Informatik, destination=TcpIpIpV6PrivExtConfig  # Privacy Extensions Configuration | Reference to Privacy Extensions Configuration. If no reference is set, Privacy Extensions [RFC4941] are disabled on this IpV6 instance, (Multiple IpV6 instances may use the same configuration container but will operate independently)
            container TcpIpIpV6MtuConfig  # This container specifies the Maximum Transmission Unit parameters for this IPv6 instance.
              integer TcpIpIpV6DefaultMtuSize: 1280..65535, default-value=1500  # Maximum Transmission Unit (MTU) of the link. | [RFC2460 5. Packet Size Issues] "IPv6 requires that every link in the internet have an MTU of 1280 octets or greater. On any link that cannot convey a 1280-octet packet in one piece, link-specific fragmentation and reassembly must be provided at a layer below IPv6. Links that have a configurable MTU (for example, PPP links [RFC-1661]) must be configured to have an MTU of at least 1280 octets; it is recommended that they be configured with an MTU of 1500 octets or greater, to accommodate possible encapsulations (i.e., tunneling) without incurring IPv6-layer fragmentation. From each link to which a node is directly attached, the node must be able to accept packets as large as that link's MTU."
              boolean TcpIpIpV6PathMtuEnabled: default-value=false  # If enabled the IPv6 processes incoming ICMPv6 "Packet Too Big" messages and stores a MTU value for each destination address. | See RFC1981 "Path MTU Discovery for IP version 6" for details about PathMTU.
              float TcpIpIpV6PathMtuTimeout: 0..86400, default-value=600  # If this value is >0 the IpV6 will reset the MTU value stored for each destination after n seconds. | see [RFC1981 5.3. Purging stale PMTU information] Default: 600 seconds (10 minutes)
      container TcpIpDhcpServerConfig [0..*]  # Specifies the configuration parameters of the DHCP Server sub-module.
        string TcpIpDhcpDefaultRouter [0..1]  # IP address of default router (gateway).
        integer TcpIpDhcpNetmask [0..1]: 0..128, default-value=24  # Network mask of IPv4 address or address prefix of IPv6 address in CIDR Notation, i.e. decimal value between 0 and 32 (IPv4) or 0 and 128 (IPv6) that describes the number of significant bits defining the network number or prefix of an IP address.
        float TcpIpDhcpOfferValidTime: 0..4294967295, set at pre-compile, origin=Vector Informatik, default-value=5
        string TcpIpDhcpGetPortMacAddrFunctionInclude: set at pre-compile, origin=Vector Informatik, default-value=EthIf.h, min-length=3  # This parameter defines the name of a header file that contains the declaration of the function defined in TcpIpGetPortMacAddrFunctionName.
        function name TcpIpDhcpGetPortMacAddrFunctionName: set at pre-compile, origin=Vector Informatik, default-value=EthIf_GetPortMacAddr  # This parameter defines the name of a function that will be called in order to map a client link-layer (MAC) address to a switch index and port index. The valid address assignment configurations for a client are selected based on these values. The function must have the following signature: Std_ReturnType [TcpIpGetPortMacAddrFunctionName](uint8* MacAddrPtr, uint8* SwitchIdxPtr, uint8* PortIdxPtr)
        float TcpIpDhcpLeaseTimeMax [0..1]: 1..4294967295, set at pre-compile, origin=Vector Informatik, default-value=60  # This value specifies the maximum lease time. If a client requests a longer lease time the server will use this maximum value instead. If this parameter does not exists the maximum lease time is infinite.
        float TcpIpDhcpLeaseTimeMin: 1..4294967295, set at pre-compile, origin=Vector Informatik, default-value=60  # This value specifies the minimum lease time. If a client requests a shorter lease time the server will use this minimum value instead.
        float TcpIpDhcpLeaseTimeDefault [0..1]: 1..4294967295, set at pre-compile, origin=Vector Informatik, default-value=4294967295  # This value specifies the default lease time that is used if a client does not has requested a specific lease time. If this parameter does not exist the maximum lease time will be used as default.
        integer TcpIpDhcpMaxClientIdLen: 6..255, set at pre-compile, origin=Vector Informatik, default-value=7  # This value specifies the maxumin length of a DHCP client identifier. A client identifier may be either the value of the 'chaddr' filed in the DHCP message header or the content of the client identifier option [RFC2132 9.14. Client-identifier]. A client identifer may be up to 255 bytes long but usually the client MAC address is used as client identifer. This value should be at least set to 7 in order to store the type (1 byte) and the address value (6 bytes).
        string TcpIpDhcpHostname [0..1]: set at pre-compile, origin=Vector Informatik, max-length=64, min-length=1  # This parameter defines the value of the DHCP server name that will be sent in the 'sname' field of outgoing DHCPOFFER, DHCPACK and DHCPNAK messages.
        symbolic name reference TcpIpDhcpEthIfSwitchRef [0..1]: destination=EthIfSwitch  # Reference to EthIfSwitch representation. | Optional in case the Dhcp server is operating without an Ethernet switch.
        container TcpIpDhcpAddressAssignment [0..*]  # Defines a Ethernet Switch port based IP address assignment.
          string TcpIpDhcpAddressLowerBound  # The lower bound IP address which shall be assigned. | If lower bound and upper bound are identical exactly this IP address shall be assigned.
          string TcpIpDhcpAddressUpperBound  # The upper bound IP address which shall be assigned. | If lower bound and upper bound are identical exactly this IP address shall be assigned.
          symbolic name reference TcpIpDhcpSwitchPortRef [0..1]: destination=EthSwtPort  # Reference to Ethernet Switch port. | Optional in case the Dhcp server is operating without an Ethernet switch.
          symbolic name reference TcpIpDhcpLocalAddrRef: set at pre-compile, origin=Vector Informatik, destination=TcpIpLocalAddr  # Reference to a TcpIp local address on which this address assignment configuration shall be active. This reference specifies the interface/VLAN this address assignment shall be valid for.
      container TcpIpIpConfig [0..1]  # Specifies the configuration parameters of the IP (Internet Protocol) sub-module
        container TcpIpIpV4Config [0..1]  # Specifies the configuration parameters of the IPv4 (Internet Protocol version 4) sub-module.
          container TcpIpArpConfig [0..*]  # Specifies the configuration parameters of the ARP (Address Resolution Protocol) sub-module.
            integer TcpIpArpNumGratuitousARPonStartup: 0..255, default-value=0  # Arp Num Gratuitous Arp On Startup | Specifies the number of gratuitous ARP replies which shall be sent on assignment of a new IP address.
            boolean TcpIpArpPacketQueueEnabled: default-value=false  # Enables (TRUE) or disables (FALSE) support of the ARP Packet Queue according to IETF RFC 1122, section 2.3.2.2.
            float TcpIpArpTableEntryTimeout: 0..65535, default-value=30  # Timeout in seconds after which an unused ARP entry is removed.
            integer TcpIpArpTableSizeMax: 1..65535, default-value=10  # Maximum number of entries in the ARP table.
            float TcpIpArpRetryTime: 1..65535, set at pre-compile, origin=Vector Informatik, default-value=5  # ARP Retry Time | This value specifies the maximum time for an ARP resolution. If no answer has been received before this time has expired, ARP resolution is canceled.
            float TcpIpArpRetryInterval: 1..65535, set at pre-compile, origin=Vector Informatik, default-value=2  # ARP Retry Interval | This value specifies the ARP retry interval.
          container TcpIpAutoIpConfig [0..*]  # Specifies the configuration parameters of the Auto-IP (automatic private IP addressing) sub-module.
            float TcpIpAutoIpInitTimeout: 0..65.535, default-value=1  # The time Auto-IP waits at startup, before beginning with ARP probing. This delay is used to give DHCP time to acquire a lease in case a DHCP server is present.
            integer TcpIpAutoIpProbeNum: 1..255, set at pre-compile, origin=Vector Informatik, default-value=1  # Probe Number | This value specifies the number of probe packets (RFC standard: 3)
            float TcpIpAutoIpProbeMin: 0..65.535, set at pre-compile, origin=Vector Informatik, default-value=0.4  # Probe Min Delay | This value specifies the minimum interval between probe messages (RFC standard: 1s)
            float TcpIpAutoIpProbeMax: 0..65.535, set at pre-compile, origin=Vector Informatik, default-value=0.6  # Probe Max Delay | This value specifies the maximum delay between probe messages (RFC standard: 2s)
            float TcpIpAutoIpAnnounceWait: 0..65.535, set at pre-compile, origin=Vector Informatik, default-value=0.5  # Announce Wait | This value specifies the delay before the first announcement message (RFC standard: 2s)
            integer TcpIpAutoIpAnnounceNum: 1..255, set at pre-compile, origin=Vector Informatik, default-value=1  # Announce Number | This value specifies the number of announcement packets (RFC standard: 2)
            float TcpIpAutoIpAnnounceInterval: 0..65.535, set at pre-compile, origin=Vector Informatik, default-value=0.4  # Announce Interval | This value specifies the interval between announcement packets (RFC standard: 2s)
            integer TcpIpAutoIpMaxConflicts: 1..255, set at pre-compile, origin=Vector Informatik, default-value=10  # Max Number Of Conflicts | This value specifies the maximum number of conflicts before rate limiting (RFC standard: 10) If the specified number of conflicts has been reached new address configurations attempts are rate limited by "Rate Limit Interval".
            float TcpIpAutoIpRateLimitInterval: 0..65.535, set at pre-compile, origin=Vector Informatik, default-value=5  # Rate Limit Interval | This value specifies the delay between successive address configuration attempts when rate limiting is active (RFC standard: 60s) see "Max Number Of Conflicts"
            float TcpIpAutoIpDefendInterval: 0..65.535, set at pre-compile, origin=Vector Informatik, default-value=5  # Defend Interval | This value specifies the minimum interval between defensive ARPs (RFC standard: 10s)
            float TcpIpAutoIpProbeWaitMax: 0..65.535, set at pre-compile, origin=Vector Informatik, default-value=7  # Probe Wait Max | This value specifies the maximum initial random delay before the first probe message is sent. (RFC standard: 1s)
          container TcpIpDhcpConfig [0..*]  # Specifies the configuration parameters of the DHCPv4. | This container may be referenced by multiple IPv4 instances if they shall use the same configuration. This container may have multiple instances if different configurations are required for different IPv4 instances.
            float TcpIpDhcpV4InitWaitMin: 0..65535, set at pre-compile, origin=Vector Informatik, default-value=100  # Init Wait Min | Minimum initial delay for DISCOVER (RFC standard: 1s) RESTRICTIONS: 'DhcpV4InitWaitMin' is only available, if 'TcpIpEnableDhcpV4' is set to 'true'.
            float TcpIpDhcpV4InitWaitMax: 0..65535, set at pre-compile, origin=Vector Informatik, default-value=800  # Init Wait Max | Maximum initial delay for DISCOVER (RFC standard: 10s) RESTRICTIONS: 'DhcpV4InitWaitMax' is only available, if 'TcpIpEnableDhcpV4' is set to 'true'.
            integer TcpIpDhcpV4DiscoverMaxNum: 0..255, set at pre-compile, origin=Vector Informatik, default-value=5  # Discover Max Num | Maximum number of DISCOVER messages RESTRICTIONS: 'DhcpV4DiscoverMaxNum' is only available, if 'TcpIpEnableDhcpV4' is set to 'true'.
            float TcpIpDhcpV4DiscoverIntervalMin: 0..255, set at pre-compile, origin=Vector Informatik, default-value=2  # Discover Interval Min | Minimum DISCOVER interval RESTRICTIONS: 'DhcpV4DiscoverIntervalMin' is only available, if 'TcpIpEnableDhcpV4' is set to 'true'.
            float TcpIpDhcpV4DiscoverIntervalMax: 0..255, set at pre-compile, origin=Vector Informatik, default-value=30  # Discover Interval Max | Maximum DISCOVER interval RESTRICTIONS: 'DhcpV4DiscoverIntervalMax' is only available, if 'TcpIpEnableDhcpV4' is set to 'true'.
            integer TcpIpDhcpV4RequestMaxNum: 0..255, set at pre-compile, origin=Vector Informatik, default-value=6  # Request Max Num | Maximum number of REQUEST messages RESTRICTIONS: 'DhcpV4RequestMaxNum' is only available, if 'TcpIpEnableDhcpV4' is set to 'true'.
            float TcpIpDhcpV4RequestInterval: 0..255, set at pre-compile, origin=Vector Informatik, default-value=2  # Request Interval | REQUEST interval RESTRICTIONS: 'DhcpV4RequestInterval' is only available, if 'TcpIpEnableDhcpV4' is set to 'true'.
            float TcpIpDhcpV4RenewIntervalMin: 0..255, set at pre-compile, origin=Vector Informatik, default-value=5  # Renew Interval Min | Minimum Renew interval RESTRICTIONS: 'DhcpV4RenewIntervalMin' is only available, if 'TcpIpEnableDhcpV4' is set to 'true'.
            float TcpIpDhcpV4RebindIntervalMin: 0..255, set at pre-compile, origin=Vector Informatik, default-value=5  # Rebind Interval Min | Minimum Rebind interval RESTRICTIONS: 'DhcpV4RebindIntervalMin' is only available, if 'TcpIpEnableDhcpV4' is set to 'true'.
            integer TcpIpDhcpV4HostNameLenMax: 0..255, set at pre-compile, origin=Vector Informatik, default-value=30  # Host Name Length Max | Maximum support Host name length [byte] RESTRICTIONS: 'DhcpV4HostNameLenMax' is only available, if 'TcpIpEnableDhcpV4' is set to 'true'.
            boolean TcpIpDhcpV4RestartOnFail: set at pre-compile, origin=Vector Informatik, default-value=false  # Restart On Failure | Restart the DHCP address assignment process if a used address lease times out and no lease update could be obtained. After the lease expires either the DHCP process is restarted or the process will be stopped completely (no new address assignment). RESTRICTIONS: 'TcpIpDhcpV4RestartOnFail' is only available, if 'TcpIpEnableDhcpV4' is set to 'true'.
          container TcpIpIcmpConfig [0..1]  # Specifies the configuration parameters of the ICMP (Internet Control Message Protocol) sub-module.
            integer TcpIpIcmpTtl: 0..255, default-value=64  # Default Time-to-live value of outgoing ICMP packets.
            integer TcpIpIcmpEchoReplyMaxLen: 0..32767, set at pre-compile, origin=Vector Informatik, default-value=32  # Echo Data Buffer Size | This value specifies the maximum payload length of an Echo Reply. If an Echo Request contains more data the payload of the response will be truncated.
            container TcpIpIcmpMsgHandler [0..1]  # This container is a subcontainer of TcpIpIcmpConfig and specifies the configuration parameters for the ICMP message handler.
              string TcpIpIcmpMsgHandlerHeaderFileName: max-length=32, min-length=1  # This parameter specifies the name of the header file containing the definition of the ICMP message handler function.
              function name TcpIpIcmpMsgHandlerName  # This parameter defines the name of the ICMP message handler function <User_IcmpMsgHandler>.
          container TcpIpIpFragmentationConfig [0..*]  # Specifies the configuration parameters of IPv4 packet fragmentation/reassembly. | This container may be referenced by multiple IPv4 instances if they shall use the same configuration. This container may have multiple instances if different configurations are required for different IPv4 instances.
            boolean TcpIpIpFragmentationRxEnabled: default-value=false  # Enables (TRUE) or disables (FALSE) support for reassembling of incoming datagrams that are fragmented according to IETF RFC 815 (IP Datagram Reassembly Algorithms).
            integer TcpIpIpNumFragments [0..1]: 0..255, default-value=0  # Specifies the maximum number of IP fragments per datagram. | Note: this parameter is only relevant if TcpIpIpFragmentationRxEnabled is TRUE.
            integer TcpIpIpNumReassDgrams [0..1]: 0..65535, default-value=3  # Specifies the maximum number of fragmented IP datagrams that can be reassembled in parallel. | Note: this parameter is only relevant if TcpIpIpFragmentationRxEnabled is TRUE.
            float TcpIpIpReassTimeout [0..1]: 0..1.7976931348623157E+308, default-value=60  # Specifies the timeout in [s] after which an incomplete datagram gets discarded. | Note: this parameter is only relevant if TcpIpIpFragmentationRxEnabled is TRUE.
          container TcpIpStaticArpTable [0..*]  # This container includes one or more static ARP table entries. It may be referenced by multiple IpV4CtrlConfig containers if they shall use the same static ARP table. The static ARP table is stored into the ROM and cannot be overwritten during runtime. IP instances using this static ARP table will never send ARP requests for the configured addresses.
            container TcpIpStaticArpEntry [1..*]  # This container includes a static IP address to physical address mapping.
              string TcpIpStaticArpEntryIpAddr: set at pre-compile, origin=Vector Informatik, max-length=15, min-length=7  # IPv4 Address | This parameter defines the IP address that shall be statically mapped to the physical address defined in IpV4StaticArpEntryPhysAddr
              string TcpIpStaticArpEntryPhysAddr: set at pre-compile, origin=Vector Informatik, max-length=17, min-length=17  # Physical Address | This parameter defines the physical address that shall be used for outgoing packets to the IP address specified in IpV4StaticArpEntryIpAddr
        container TcpIpIpV6Config [0..1]  # Specifies the configuration parameters of the IPv6 (Internet Protocol version 6) sub-module.
          container TcpIpDhcpV6Config [0..*]  # Specifies the configuration parameters of the DHCPv6. | This container may be referenced by multiple IPv6 instances if they shall use the same configuration. This container may have multiple instances if different configurations are required for different IPv6 instances.
            float TcpIpDhcpV6CnfDelayMax: 0..100, default-value=1  # Maximum delay (s) before sending the first Confirm message. If this value is bigger than the previous minimum delay value a random delay will be chosen from the interval.
            float TcpIpDhcpV6CnfDelayMin: 0..100, default-value=0  # Minimum delay (s) before the first Confirm message will be sent.
            float TcpIpDhcpV6InfDelayMax: 0..100, default-value=1  # Maximum delay (s) before sending the first Information Request message. If this value is bigger than the previous minimum delay value a random delay will be chosen from the interval.
            float TcpIpDhcpV6InfDelayMin: 0..100, default-value=0  # Minimum delay (s) before the first Information Request message will be sent.
            float TcpIpDhcpV6SolDelayMax: 0..100, default-value=1  # Maximum delay (s) before sending the first Solicit message. If this value is bigger than the previous minimum delay value a random delay will be chosen from the interval.
            float TcpIpDhcpV6SolDelayMin: 0..100, default-value=0  # Minimum delay (s) before the first Solicit message will be sent.
            float TcpIpDhcpV6ClientIdTime: 0.., set at pre-compile, origin=Vector Informatik, default-value=0  # Client DUID Time | Time value used to build the DHCP Unique Identifier (DUID) of the client. The Identifier of the client will be built from this time value and the link-layer address of this node. "The time value is the time that the DUID is generated represented in seconds since midnight (UTC), January 1, 2000, modulo 2^32." [RFC3315 9.2. DUID Based on Link-layer Address Plus Time [DUID-LLT]]
            boolean TcpIpDhcpV6RandomizeTimeouts: set at pre-compile, origin=Vector Informatik, default-value=true  # Randomize Timeouts | Use randomization factor for computing retransmission timeouts. "Each of the computations of a new RT include a randomization factor (RAND), which is a random number chosen with a uniform distribution between -0.1 and +0.1. The randomization factor is included to minimize synchronization of messages transmitted by DHCP clients." [RFC3315 14. Reliability of Client Initiated Message Exchanges]
            integer TcpIpDhcpV6TxMsgBufferLen: 64..1280, set at pre-compile, origin=Vector Informatik, default-value=128  # DHCP Tx Message Buffer Size | Size of the buffer for outgoing DHCPv6 messages. The size of a DHCPv6 message depends on the number and length of options included in it.
            boolean TcpIpDhcpV6UseFirstValidAdv: set at pre-compile, origin=Vector Informatik, default-value=false  # Use first valid advertisment | If enabled the Dhcp will not wait for other advertise messages if a valid one has been received but the preference is less than 255. "A client MUST collect Advertise messages for the first RT seconds, unless it receives an Advertise message with a preference value of 255" [RFC3315 17.1.2. Transmission of Solicit Messages]
            boolean TcpIpDhcpV6Rfc3646DomainListOptEnabled: set at pre-compile, origin=Vector Informatik, default-value=false  # Enable Domain List Option | If enabled the DhcpV6 will notify the Dns of dns search lists contained in DOMAIN_LIST options of received DHCPv6 Reply messages. [RFC3646 4. Domain Search List option] Requires Dns Component.
            boolean TcpIpDhcpV6Rfc3646DnsServersOptEnabled: set at pre-compile, origin=Vector Informatik, default-value=false  # Enable DNS Server Option | If enabled the DhcpV6 will notify the Dns of dns server addresses contained in DNS_SERVERS options of received DHCPv6 Reply messages. [RFC3646 3. DNS Recursive Name Server option] Requires Dns Component.
          container TcpIpIcmpV6Config  # Specifies the configuration parameters of the ICMPv6 (Internet Control Message Protocol for IPv6) sub-module.
            integer TcpIpIcmpV6EchoDataBufferSize: 0..1452, default-value=64  # Configure the maximum amount of arbitrary data that will be sent back to the sender of an echo request. If the arbitrary data of an incoming echo request is bigger than configured here, the response payload will be truncated.
            boolean TcpIpIcmpV6EchoReplyEnabled: default-value=false  # If enabled, the stack will respond to incoming ICMPv6 Echo Requests (Pings).
            integer TcpIpIcmpV6HopLimit: 0..255, default-value=64  # Default Hop-Limit value of outgoing ICMPv6 packets.
            boolean TcpIpIcmpV6MsgDestinationUnreachableEnabled: default-value=false  # Dis/Enables transmission of Destination Unreachable Messages
            boolean TcpIpIcmpV6MsgParameterProblemEnabled: default-value=true  # If enabled an ICMPv6 parameter problem message will be sent if a received packet has been dropped due to unknown options or headers that are found in the packet. | [RFC2460 4. IPv6 Extension Headers]
            boolean TcpIpIcmpV6EchoRequestApiEnabled: set at pre-compile, origin=Vector Informatik, default-value=false  # Enable Echo Request API | This parameter defines whether the API function IpV6_Icmp_TxEchoRequest() is available. This function can be used to send outgoing Echo Requests (Pings) to other Hosts. Note: This function is for debugging purposes only. Incoming Echo Replies are currently not handled by the ICMPv6.
            boolean TcpIpIcmpV6ErrorMessagesEnabled: set at pre-compile, origin=Vector Informatik, default-value=true  # Send ICMP Error Messages | This parameter defines whether ICMPv6 Error Messages will be sent as specified in [RFC4443]. [RFC4443 3.2. Packet Too Big Message] [RFC4443 3.3. Time Exceeded Message] [RFC4443 3.4. Parameter Problem Message] If disabled, no ICMPv6 Error Messages will be sent
            integer TcpIpIcmpV6TxMessageBufferSize: 48..1280, set at pre-compile, origin=Vector Informatik, default-value=1280  # Tx Message Buffer Size | This value specifies the maximum size of outgoing ICMPv6 messages. This value should be 1280 if IpV6EnableIcmpErrMsgs is enabled. If the value is smaller the Original Packet payload in ICMPv6 Error messages will be truncated.
            container TcpIpIcmpV6MsgHandler [0..1]  # This container is a subcontainer of TcpIpIcmpConfig and specifies the configuration parameters for the ICMPv6 message handler.
              string TcpIpIcmpV6MsgHandlerHeaderFileName [1..*]: max-length=32, min-length=1  # This parameter specifies the name of the header file containing the definition of the ICMPv6 message handler function.
              function name TcpIpIcmpV6MsgHandlerName  # This parameter defines the name of the ICMP message handler function <User_IcmpMsgHandler>.
              function name TcpIpIcmpV6MaxPayloadLenChgHandlerName [0..1]: set at pre-compile, origin=Vector Informatik  # Maximum Payload Length Change Callback Function | This parameter defines a function that will be called when the maximum payload length, that fits into one IPv6 packet, changes due to MTU limitations on the path to a specific destination. see [RFC1981 Path MTU Discovery for IP version 6] Callback function signature: void Cbk_Name(uint8 CtrlIdx, const IpBase_SockAddrType DstAddrPtr, uint16 Mtu) For reasons of efficiency at least the callback "TcpIp_Cbk_VPathMtuChg" of "TcpIp_Cbk.h" should be configured here in order to avoid that TCP transmits packets that need to be fragmented by the IP layer.
              function name TcpIpIcmpV6IndAddrListReceivedHandlerName [0..1]: set at pre-compile, origin=Vector Informatik  # Inverse ND Address List Received Callback Function | This parameter defines a function that will be called when an Inverse Neighbor Discovery Solicitation or Advertisement with an Address List Option [RFC3122] is received. Callback function signature: void Cbk_Name(uint8 CtrlIdx, IPV6_P2C(Eth_PhysAddrType) RemoteLLAddrPtr, IPV6_P2C(IpV6_AddrType) AddrListPtr, uint8 AddrCount);
          container TcpIpIpV6FragmentationConfig [0..*]  # Specifies the configuration parameters of IPv6 packet fragmentation/reassembly. | This container may be referenced by multiple IPv6 instances if they shall use the same configuration. This container may have multiple instances if different configurations are required for different IPv6 instances.
            integer TcpIpIpV6ReassemblyBufferCount: 0..255, default-value=2  # Number of buffers that can be used for fragment reassembly. In case of a reassembly error or if not all fragments are received in time this buffer will be blocked until the specified "Fragment Reassembly Timeout" has been exceeded. | A value of 0 disables fragment reassembly. [RFC2460 5. Packet Size Issues] "In order to send a packet larger than a path's MTU, a node may use the IPv6 Fragment header to fragment the packet at the source and have it reassembled at the destination(s). However, the use of such fragmentation is discouraged in any application that is able to adjust its packets to fit the measured path MTU (i.e., down to 1280 octets)."
            integer TcpIpIpV6ReassemblyBufferSize [0..1]: 1500..65535, default-value=1500  # [RFC2460 5. Packet Size Issues] | "A node must be able to accept a fragmented packet that, after reassembly, is as large as 1500 octets. A node is permitted to accept fragmented packets that reassemble to more than 1500 octets."the measured path MTU (i.e., down to 1280 octets)."
            integer TcpIpIpV6ReassemblySegmentCount [0..1]: 1..255, default-value=5  # Specifies the maximum number of consecutive data segments that can be managed in each reassembly buffer. If all fragments are received in order, only one segment will be needed. | To deal with fragments received out of order this value should be configured bigger than 1.
            float TcpIpIpV6ReassemblyTimeout [0..1]: 0.001..100, default-value=60  # [RFC2460 4.5 Fragment Header] | Default: 60 seconds
            integer TcpIpIpV6TxFragmentBufferCount: 0..255, default-value=2  # These buffers will be used if the IpV6 receives packets from the upper layer that do not fit into the MTU and thus must be fragmented. | A value of 0 disables tx fragmentation. If the upper layer transmits packets that do not fit into the link or path MTU, the IpV6 will split-up the packet into fragments. see "Enable Fragment Reassembly"
            integer TcpIpIpV6TxFragmentBufferSize [0..1]: 1500..65535, default-value=1500  # Size of each fragment tx buffer in bytes
          container TcpIpNdpConfig [1..*]  # Specifies the configuration parameters of the Neighbor Discovery Protocol for IPv6 | This container may be referenced by multiple IPv6 instances if they shall use the same configuration. This container may have multiple instances if different configurations are required for different IPv6 instances.
            boolean TcpIpNdpRfc6106DnsslOptEnabled: set at pre-compile, origin=Vector Informatik, default-value=false  # Enable DNS Search List Option | This parameter defines whether the IpV6 will notify the DNS of domain names of DNS suffixes contained in DNSSL options of received Router Advertisements. [RFC6106 5.2. DNS Search List Option]
            boolean TcpIpNdpRfc6106RdnssOptEnabled: set at pre-compile, origin=Vector Informatik, default-value=false  # Enable Recursive DNS Server Option | This parameter defines whether the IpV6 will notify the DNS of dns server adresses contained in RDNS options of received Router Advertisements. [RFC6106 5.1. Recursive DNS Server Option]
            container TcpIpNdpArNudConfig [0..1]  # Specifies the configuration parameters for NDP Address Resolution and Neighbor Unreachability Detection.
              float TcpIpNdpDefaultReachableTime: 0..120, default-value=30  # Configuration of the ReachableTime (s) specified in [RFC4861 6.3.2. Host Variables]. | "The time a neighbor is considered reachable after receiving a reachability confirmation." If "TcpIpNdpDynamicReachableTimeEnabled" is checked, this value may be reconfigured based on received Router Advertisements. Default: REACHABLE_TIME = 30 seconds
              float TcpIpNdpDefaultRetransTimer: 0..60, default-value=1  # Configures the default value (s) for the RetransTimer variable specified in [RFC4861 6.3.2. Host Variables]. | "The time between retransmissions of Neighbor Solicitation messages to a neighbor when resolving the address or when probing the reachability of a neighbor." If "TcpIpNdpDynamicRetransTimeEnabled" is checked, this value may be reconfigured based on received Router Advertisements. Default: RETRANS_TIMER = 1 second
              float TcpIpNdpDelayFirstProbeTime: 0..60, default-value=5  # Delay before sending the first NUD probe in (s). | [RFC4861 7.3.3. Node Behavior] Default: DELAY_FIRST_PROBE_TIME = 5 seconds
              integer TcpIpNdpMaxNeighborCacheSize: 1..254, default-value=5  # Maximum number of entries in the neighbor cache. | [RFC4861 5.1. Conceptual Data Structures]
              integer TcpIpNdpMaxRandomFactor: 0..100, default-value=15  # Maximum random factor used for randomization | [RFC4861 10. Protocol Constants] Default: 15 (MAX_RANDOM_FACTOR = 1.5)
              integer TcpIpNdpMinRandomFactor: 0..100, default-value=5  # Minimum random factor used for randomization | [RFC4861 10. Protocol Constants] Default: 5 (MIN_RANDOM_FACTOR = 0.5)
              boolean TcpIpNdpNeighborUnreachabilityDetectionEnabled: default-value=true  # Neighbor Unreachability Detection is used to remove unused entries from the neighbor cache. This feature is a basic feature of NDP and should be turned on.
              integer TcpIpNdpNumMulticastSolicitations: 0..255, default-value=3  # Maximum number of multicast solicitations that will be sent when performing address resolution. | [RFC4861 7.2.2. Sending Neighbor Solicitations] Default: MAX_MULTICAST_SOLICIT = 3
              integer TcpIpNdpNumUnicastSolicitations: 0..255, default-value=3  # Maximum number of unicast solicitations that will be sent when performig Neighbor Unreachability Detection. | [RFC4861 7.3.3. Node Behavior] Default: MAX_UNICAST_SOLICIT = 3
              boolean TcpIpNdpPacketQueueEnabled: default-value=true  # Enables (TRUE) or disables (FALSE) support of a NDP Packet Queue according to IETF RFC 4861, section 7.2.2.
              boolean TcpIpNdpRandomReachableTimeEnabled: default-value=true  # If enabled the value of ReachableTime will be multiplied with a random value between MIN_RANDOM_FACTOR and MAX_RANDOM_FACTOR in order to prevent multiple nodes from transmitting at exactly the same time | [RFC4861 6.3.2. Host Variables / ReachableTime]
              boolean TcpIpNdpInverseNaEnabled: set at pre-compile, origin=Vector Informatik, default-value=false  # Inverse Advertisements | This parameter defines whether Inverse Neighbor Advertisements are processed or silently discarded. This also enables the API IpV6_Ndp_SendInverseSolicitation(). Use "User Callback Configuration" to configure a callback function that handles received Address Lists. If disabled no Inverse Neighbor Solicitations can be sent and received Inverse Neighbor Advertisements will be silently ignored. [RFC3122 4.2.2 Processing Inverse Neighbor Advertisement Messages]
              boolean TcpIpNdpInverseNsEnabled: set at pre-compile, origin=Vector Informatik, default-value=false  # Inverse Solicitations | This parameter defines whether Inverse Neighbor Advertisements are sent in response to received Inverse Neighbor Solicitations. Use "User Callback Configuration" to configure a callback function that handles received Address Lists. If disabled received Inverse Neighbor Solicitations will be silently ignored. [RFC3122 4.2.2 Processing Inverse Neighbor Advertisement Messages]
              boolean TcpIpNdpNeighborCacheUpdateByInverseNaEnabled: set at pre-compile, origin=Vector Informatik, default-value=true  # Inverse Advertisement Neighbor Cache Updates | This parameter defines whether the Neighbor Cache will be updated with information from received Inverse Neighbor Advertisements. [RFC3122 4.2.2 Processing Inverse Neighbor Advertisement Messages]
            container TcpIpNdpPrefixRouterDiscoveryConfig [0..1]  # Specifies the configuration parameters for NDP Prefix and Router Discovery.
              integer TcpIpNdpDefaultRouterListSize: 2..254, default-value=2  # Maximum number of default router entries. | [RFC4861 5.1. Conceptual Data Structures]
              integer TcpIpNdpDestinationCacheSize: 1..254, default-value=5  # Maximum number of entries in the destination cache. | [RFC4861 5.1. Conceptual Data Structures]
              boolean TcpIpNdpDynamicHopLimitEnabled: default-value=true  # If enabled the default hop limit may be reconfigured based on received Router Advertisements. | [RFC4861 6.3.4. Processing Received Router Advertisements]
              boolean TcpIpNdpDynamicMtuEnabled: default-value=false  # Allow dynamic reconfiguration of link MTU via Router Advertisements. | [RFC4861 4.6.4. MTU]
              boolean TcpIpNdpDynamicReachableTimeEnabled: default-value=true  # If enabled the default Reachable Time value may be reconfigured based on received Router Advertisements. | [RFC4861 6.3.4. Processing Received Router Advertisements] Default: Enabled
              boolean TcpIpNdpDynamicRetransTimeEnabled: default-value=true  # If enabled the default Retransmit Timer value may be reconfigured based on received Router Advertisements. | [RFC4861 6.3.4. Processing Received Router Advertisements] Default: Enabled
              float TcpIpNdpMaxRtrSolicitationDelay: 0.001..60, default-value=1  # Maximum delay before the first Router Solicitation will be sent after interface initialization in (s). | [RFC4861 6.3.7. Sending Router Solicitations] Default: MAX_RTR_SOLICITATION_DELAY = 1 second
              integer TcpIpNdpMaxRtrSolicitations: 0..255, default-value=3  # Maximum number of Router Solicitations that will be sent before the first Router Advertisement has been received. | 0 = No Router Solicitations will be sent. This has no impact on handling Router Advertisements. [RFC4861 6.3.7. Sending Router Solicitations] Default: MAX_RTR_SOLICITATIONS = 3 transmissions
              integer TcpIpNdpPrefixListSize: 1..254, default-value=5  # Maximum number of entries in the on-link prefix list. | [RFC4861 5.1. Conceptual Data Structures]
              boolean TcpIpNdpRndRtrSolicitationDelayEnabled: default-value=true  # If enabled the first router solicitation will be delayed randomly from [0...MAX_RTR_SOLICITATION_DELAY]. Otherwise the first router solicitation will be sent after exactly MAX_RTR_SOLICITATION_DELAY milliseconds. | [RFC4861 6.3.7. Sending Router Solicitations] Default: Enabled
              float TcpIpNdpRtrSolicitationInterval: 0.001..60, default-value=4  # Interval between consecutive Router Solicitations in (s). | [RFC4861 6.3.7. Sending Router Solicitations] Default: RTR_SOLICITATION_INTERVAL = 4 seconds
            container TcpIpNdpSlaacConfig  # Specifies the configuration parameters for StateLess Address AutoConfiguration.
              integer TcpIpNdpSlaacDadNumberOfTransmissions: 0..254, default-value=1  # Number of Neighbor Solicitations that have to be unanswered in order to set an autoconfigurated address to PREFERRED (usable) state. | [RFC4861 5.1. Node Configuration Variables] Default: DupAddrDetectTransmits = 1 Setting this value to 0 turns off DAD.
              float TcpIpNdpSlaacDadRetransmissionDelay: 0..10, default-value=1  # Sets the maximum value for the address configuration delay (s). | According to [RFC4861 5.4.2. Sending Neighbor Solicitation Messages] this value should be the same as MAX_RTR_SOLICITATION_DELAY. Default: MAX_RTR_SOLICITATION_DELAY = 1 second
              boolean TcpIpNdpSlaacDelayEnabled: default-value=false  # If enabled transmission of the first DAD Neighbor Solicitation will be delayed by a random value from [0...MAX_DAD_DELAY]. | "This serves to alleviate congestion when many nodes start up on the link at the same time, such as after a power failure, and may help to avoid race conditions when more than one node is trying to solicit for the same address at the same time." "The delay will avoid similar congestion when multiple nodes are going to configure addresses by receiving the same single multicast router advertisement." [RFC4861 5.4.2. Sending Neighbor Solicitation Messages] Default: True
              boolean TcpIpNdpSlaacOptimisticDadEnabled: default-value=false  # Enable Optimistic Duplicate Address Detection (DAD) according to RFC4429.
              float TcpIpNdpSlaacMinLifetime: 10..120000, set at pre-compile, origin=Vector Informatik, default-value=7200  # Minimum Address Lifetime | This value specifies the minimum valid Lifetime for addresses configured via Stateless Address Autoconfiguration. [RFC4862 5.5.3. e] RFC Default: 7200sec (2hrs)
              float TcpIpNdpSlaacMaxDelay: 0..10000, set at pre-compile, origin=Vector Informatik, default-value=1000  # Max address configuration delay | This value specifies the maximum value for the address configuration delay. According to [RFC4861 5.4.2. Sending Neighbor Solicitation Messages] this value should be the same as MAX_RTR_SOLICITATION_DELAY. RFC Default: "MAX_RTR_SOLICITATION_DELAY" = 1000 milliseconds
            container TcpIpIpV6MldConfig  # This container includes configuration parameters for the Multicast Listener Discovery Version 2 (MLDv2) for IPv6. See [RFC3810 Multicast Listener Discovery Version 2 (MLDv2) for IPv6]
              float TcpIpMldV1QuerierPresentTimeout: 1..600000, set at pre-compile, origin=Vector Informatik, default-value=5000  # Older Version Querier Present Timeout | This value specifies the value of the "Older Version Querier Present Timeout" Variable. See [RFC3810 9.12. Older Version Querier Present Timeout] "This value MUST be ([Robustness Variable] times ([Query Interval]) plus (one half of [Query Response Interval])."
              integer TcpIpMldIfStatePoolSize: 1..254, set at pre-compile, origin=Vector Informatik, default-value=8  # This value specifies the maximum number of multicast addresses the IpV6 instance can listen to.
              integer TcpIpMldSrcAddrPoolSize: 0..254, set at pre-compile, origin=Vector Informatik, default-value=32  # This value specifies the maximum number of source addresses that can be stored for all socket-based multicast memberships. If multicast packets shall only be received if they have been sent from specific source addresses each of these addresses requires an entry in this pool.
              integer TcpIpMldSocketMembershipPoolSize: 1..254, set at pre-compile, origin=Vector Informatik, default-value=8  # This value specifies the maximum number of multicast memberships that can be managed via the IpV6_MulticastListen() API. All sockets share the same membership pool. Each multicast address can apper at most once for each socket. Maximum: IpV6MldIfStatePoolSize * number of sockets (all socket are member of all multicast groups) Minimum: IpV6MldIfStatePoolSize * 1 (exactly one socket is member of each multicast address group)
              integer TcpIpMldIfStateSrcAddrPoolSize: 1..254, set at pre-compile, origin=Vector Informatik, default-value=16  # This value specifies the total number of all source addresses for all multicast addresses. This value may be less than IpV6MldSrcAddrPoolSize if multiple sockets only need multicast packets from the same source addresses.
              integer TcpIpMldRobustness: 1..255, set at pre-compile, origin=Vector Informatik, default-value=2  # This value specifies the value of the [Robustness Variable] which is defined in [RFC3810 9.1. Robustness Variable]. "MLD is robust to [Robustness Variable] - 1 packet losses. The value of the Robustness Variable MUST NOT be zero, and SHOULD NOT be one. Default value: 2."
              integer TcpIpMldMaxReportMsgSize: 76..1500, set at pre-compile, origin=Vector Informatik, default-value=1280  # This value specifies the maximum size of a MLDv2 Report message inclusive the IPv6 header (40 bytes) and the Hop-by-Hop header (8 bytes). This value directly depends on the Ethernet Tx buffer size. (No extra buffer will be allocated.)
              float TcpIpMldMinUnsolicitedReportInt: 0..100000, set at pre-compile, origin=Vector Informatik, default-value=0  # This value specifies the lower bound for the randomized Unsolicited Report Interval. If this value equals IpV6MldMaxUnsolicitedReportInt the interval will be fixed. RFC Default: 0 See: IpV6MldMaxUnsolicitedReportInt
              float TcpIpMldMaxUnsolicitedReportInt: 0..100000, set at pre-compile, origin=Vector Informatik, default-value=1000  # This value specifies the upper bound for the randomized Unsolicited Report Interval. "The Unsolicited Report Interval is the time between repetitions of a node's initial report of interest in a multicast address." [RFC3810 9.11. Unsolicited Report Interval] RFC Default: 1 second. "To cover the possibility of the State Change Report being missed by one or more multicast routers, [Robustness Variable] - 1 retransmissions are scheduled, through a Retransmission Timer, at intervals chosen at random from the range (0, [Unsolicited Report Interval])." [RFC3810 6.1. Action on Change of Per-Interface State]
            container TcpIpIpV6PrivExtConfig [0..1]  # This container includes configuration parameters for the Privacy Extensions for Stateless Address Autoconfiguration in IPv6. See [RFC4941 Privacy Extensions for Stateless Address Autoconfiguration in IPv6]
              float TcpIpPrivExtTempValidLifetime: 0..4294967, set at pre-compile, origin=Vector Informatik, default-value=604800  # Lifetime of temp. Address | This value specifies the maximum time a temporary address is valid. RFC Default: 604800s (1 week) [RFC4941 5. Defined Constants] [RFC4941 3.3. Generating Temporary Addresses / 1.]
              float TcpIpPrivExtTempPreferredLifetime: 0..4294967, set at pre-compile, origin=Vector Informatik, default-value=86400  # Time temp. Address is preferred | This value specifies the maximum time a temporary address is preferred. RFC Default: 86400s (1 day) [RFC4941 5. Defined Constants] [RFC4941 3.3. Generating Temporary Addresses / 1.]
              float TcpIpPrivExtRegenAdvance: 0..100, set at pre-compile, origin=Vector Informatik, default-value=5  # Time in advance for temp. Address Regeneration | A new temporary addresses is generated RegenAdvance time units before its predecessor gets deprecated. RFC Default: 5s [RFC4941 5. Defined Constants] "To ensure that a preferred temporary address is always available, a new temporary address SHOULD be regenerated slightly before its predecessor is deprecated. This is to allow sufficient time to avoid race conditions in the case where generating a new temporary address is not instantaneous, such as when duplicate address detection must be run. The node SHOULD start the address regeneration process REGEN_ADVANCE time units before a temporary address would actually be deprecated." [RFC4941 3.4. Expiration of Temporary Addresses]
              float TcpIpPrivExtMaxDesyncFactor: 0..10000, set at pre-compile, origin=Vector Informatik, default-value=600  # DeSync-Factor upper bound | This value specifies the upper bound for the random value DESYNC_FACTOR. RFC Default: 600s (10 minutes) [RFC4941 5. Defined Constants] "The value DESYNC_FACTOR is a random value (different for each client) that ensures that clients don't synchronize with each other and generate new addresses at exactly thesame time." [RFC4941 3.5. Regeneration of Randomized Interface Identifiers]
              integer TcpIpPrivExtTempIdGenRetries: 0..10, set at pre-compile, origin=Vector Informatik, default-value=3  # Interface UID generation retries | This parameter defines the number of times the node shall retry to generate an unique interface identifier for a temporary address. If an unique identifier could not be generated after the specified number of retries, there will be no temporary address available. RFC Default: 3 [RFC4941 5. Defined Constants] [RFC4941 3.3. Generating Temporary Addresses / 7.]
              integer TcpIpPrivExtMaxTempAddrs: 1..254, set at pre-compile, origin=Vector Informatik, default-value=4  # Temp. Address count | This value specifies the maximum number of temporary addresses that can be configured at the same time. This should be at least 2 times the number of golbal prefixes advertised by routers.
              boolean TcpIpPrivExtUseOnLinkPrefixes: set at pre-compile, origin=Vector Informatik, default-value=false  # This parameter defines whether the IpV6 will generate temporary addresses for prefixes marked as on-link in received Router Advertisements. Normally temporary addresses are only created for prefixes that are not marked as on-link.
      container TcpIpLocalAddr [1..*]  # Specifies the local IP (Internet Protocol) addresses used for IP communication.
        integer TcpIpAddrId: 0..65535, symbolic-name-value=true, default-value=0  # IP address table identifier assigned by TCP/IP stack.
        enumeration TcpIpAddressType  # Address type.
          TCPIP_MULTICAST  # Multicast
          TCPIP_UNICAST  # Unicast
          TCPIP_IPV4_BROADCAST  # Broadcast
        enumeration TcpIpDomainType: {TCPIP_AF_INET, TCPIP_AF_INET6}  # Address family.
        boolean TcpIpIpAddrReceiveAllNotConfiguredMulticasts: set at pre-compile, origin=Vector Informatik, default-value=false  # This parameter defines whether an address of type "AutoSelect_Broadcast" shall also be used to receive multicasts that have not been configured individually by addresses of type "Multicast". Note: If this parameter is set, the IPv4 will configure the EthIf to accept all multicast packets on the corresponsing controller. This parameter is only valid for an "AutoSelect_Broadcast" address.
        reference TcpIpCtrlRef: destination=TcpIpCtrl  # Reference to a TcpIpCtrl specifying the EthIf Controller where the IP address shall be assigned and DEM errors that shall be reported in case of an error on this controller.
        container TcpIpAddrAssignment [1..*]  # This container is a subcontainer of TcpIpLocalAddr and specifies the assignment policy for the IP address.
          enumeration TcpIpAssignmentLifetime [0..1]: {TCPIP_FORGET, TCPIP_STORE}, default-value=TCPIP_FORGET  # Defines the lifetime of a dynamically fetched IP address. | If TcpIpAssignmentMethod = TCPIP_STATIC then TcpIpAssignmentLifetime shall be omitted.
          enumeration TcpIpAssignmentMethod: {TCPIP_DHCP, TCPIP_IPV6_ROUTER, TCPIP_LINKLOCAL, TCPIP_LINKLOCAL_DOIP, TCPIP_STATIC}  # Method of address assignment
          integer TcpIpAssignmentPriority: 1..3, default-value=1  # Priority of assignment (1 is highest). If a new address from an assignment method with a higher priority is available, it overwrites the IP address previously assigned by an assignment method with a lower priority.
          enumeration TcpIpAssignmentTrigger: {TCPIP_AUTOMATIC, TCPIP_MANUAL}  # Trigger of address assignment.
        container TcpIpStaticIpAddressConfig [0..1]  # This container is a subcontainer of TcpIpLocalAddr and specifies a static IP address including directly related parameters.
          string TcpIpDefaultRouter [0..1]  # IP address of default router (gateway)
          integer TcpIpNetmask [0..1]: 0..128  # Network mask of IPv4 address or address prefix of IPv6 address in CIDR Notation, i.e. decimal value between 0 and 32 (IPv4) or 0 and 128 (IPv6) that describes the number of significant bits defining the network number or prefix of an IP address.
          string TcpIpStaticIpAddress  # Static IP Address. | To specify any IP address for a certain EthIfCtrl, “ANY” has to be set as wildcard. See TcpIp_Bind() for more details.
          boolean TcpIpRequestIpAddrAssignmentEnabled [0..1]: set at pre-compile, origin=Vector Informatik, default-value=true  # This parameter defines if this ip address can be changed during runtime via the TcpIp_RequestIpAddrAssignment() API.
      container TcpIpNvmBlock [0..1]  # Configuration of optional usage of Nvm in case the TcpIp module requires non volatile memory in the Ecu to store information (e.g. IP Address received via DHCP and shall be stored).
        symbolic name reference TcpIpNvmBlockDescriptorRef: destination=NvMBlockDescriptor  # Reference to the Nvm block description in the Nvm module configuration.
      container TcpIpPhysAddrConfig [0..1]  # Specifies the physical address configuration.
        container TcpIpPhysAddrChgHandler [0..1]  # This container is a subcontainer of TcpIpPhysAddrConfig and | specifies the configuration parameters for physical address change handler.
          string TcpIpPhysAddrChgHandlerHeaderFileName: max-length=32, min-length=1  # This parameter specifies the name of the header file containing the definition of the physical address change handler function.
          function name TcpIpPhysAddrChgHandlerName  # This parameter defines the name of the physical address change function <Up>_PhysAddrTableChg.
      container TcpIpSocketOwnerConfig  # Specifies the upper layer modules of TcpIp using the socket API.
        container TcpIpSocketOwner [1..*]  # This container is a subcontainer of TcpIpSocketOwnerConfig and specifies an upper layer of TcpIp that uses the socket API.
          string TcpIpSocketOwnerCopyTxDataName [0..1]  # This parameter defines the name of the <Up_CopyTxData> function of the TcpIpSocketOwner module. The function name shall only be configurable if TcpIpSocketOwnerUpperLayerType is set to CDD.
          string TcpIpSocketOwnerHeaderFileName [0..1]  # This parameter specifies the name of the header file containing the definition of the TcpIpSocketOwner module functions. The header file name shall only be configurable if TcpIpSocketOwnerUpperLayerType is set to CDD.
          string TcpIpSocketOwnerLocalIpAddrAssignmentChgName [0..1]  # This parameter defines the name of the <Up_LocalIpAddrAssignmentChg> function of the TcpIpSocketOwner module. The function name shall only be configurable if TcpIpSocketOwnerUpperLayerType is set to CDD.
          string TcpIpSocketOwnerRxIndicationName [0..1]  # This parameter defines the name of the <Up_RxIndication> function of the TcpIpSocketOwner module. The function name shall only be configurable if TcpIpSocketOwnerUpperLayerType is set to CDD.
          string TcpIpSocketOwnerTcpAcceptedName [0..1]  # This parameter defines the name of the <Up_TcpAccepted> function of the TcpIpSocketOwner module. The function name shall only be configurable if TcpIpSocketOwnerUpperLayerType is set to CDD.
          string TcpIpSocketOwnerTcpConnectedName [0..1]  # This parameter defines the name of the <Up_TcpConnected> function of the TcpIpSocketOwner module. The function name shall only be configurable if TcpIpSocketOwnerUpperLayerType is set to CDD.
          string TcpIpSocketOwnerTxConfirmationName [0..1]  # This parameter defines the name of the <Up_TxConfirmation> function of the TcpIpSocketOwner module. The function name shall only be configurable if TcpIpSocketOwnerUpperLayerType is set to CDD.
          enumeration TcpIpSocketOwnerUpperLayerType: {CDD, SOAD, DHCPV4_SERVER}  # This parameter specifies the type of the upper layer module.
          integer TcpIpSocketOwnerId: 0..65535, set at pre-compile, origin=Vector Informatik, symbolic-name-value=true, default-value=0  # Socket User Index | This value specifies the ID of the socket user. (auto calculated)
          string TcpIpSocketOwnerTcpIpEventName [0..1]: set at pre-compile, origin=Vector Informatik  # TcpIp Event Callback Function | This parameter defines the function called for a TCP/IP event on related sockets.The function name shall only be configurable if TcpIpSocketOwnerUpperLayerType is set to CDD.
          integer TcpIpSocketOwnerTcpListenSocketMax: 0..255, set at pre-compile, origin=Vector Informatik, default-value=0  # This value specifies the number of TCP listen sockets this socket owner will use simultaneously
      container TcpIpTcpConfig [0..1]  # Specifies the configuration parameters of the TCP (Transmission Control Protocol) sub-module.
        boolean TcpIpTcpCongestionAvoidanceEnabled: default-value=false  # Enables (TRUE) or disables (FALSE) support of TCP congestion avoidance algorithm according to IETF RFC 5681.
        boolean TcpIpTcpFastRecoveryEnabled: default-value=false  # Enables (TRUE) or disables (FALSE) support of TCP Fast Recovery according to IETF RFC 5681.
        boolean TcpIpTcpFastRetransmitEnabled: default-value=false  # Enables (TRUE) or disables (FALSE) support of TCP Fast Retransmission according to IETF RFC 5681.
        float TcpIpTcpFinWait2Timeout: 0..1.7976931348623157E+308, default-value=30  # Timeout in [s] to receive a FIN from the remote node (after this node has initiated connection termination), i.e. maximum time waiting in FINWAIT-2 for a connection termination request from the remote TCP.
        boolean TcpIpTcpKeepAliveEnabled: default-value=false  # Enables (TRUE) or disables (FALSE) TCP Keep Alive Probes according to IETF RFC 1122 chapter 4.2.3.6
        float TcpIpTcpKeepAliveInterval: 0..1.7976931348623157E+308, default-value=0  # Specifies the interval in [s] between subsequent keepalive probes.
        integer TcpIpTcpKeepAliveProbesMax: 0..65535, default-value=0  # Maximum number of times that a TCP Keep Alive is retransmitted before the connection is closed.
        float TcpIpTcpKeepAliveTime: 0..1.7976931348623157E+308, default-value=7200  # Specifies the time in [s] between the last data packet sent (simple ACKs are not considered data) and the first keepalive probe. Note: Setting this configuration parameter to a value smaller or equal to the value of TcpIpMainFunctionPeriod results in the transmission of keep alive probes within every MainFunction cycle.
        integer TcpIpTcpMaxRtx [0..1]: 0..255, default-value=0  # Maximum number of times that a TCP segment is retransmitted before the TCP connection is closed. This parameter is only valid if TcpIpTcpRetransmissionTimeout is configured. | Note: This parameter also applies for FIN retransmissions.
        float TcpIpTcpMsl: 0..1.7976931348623157E+308, default-value=120  # Maximum segment lifetime in [s]. | (Note: TIME-WAIT = 2 x TcpIpTcpMsl – to ensure that the remote node received the acknowledgment to its connection termination request.)
        boolean TcpIpTcpNagleEnabled: default-value=true  # Enables (TRUE) or disables (FALSE) support of Nagle’s algorithm according to IETF RFC 896. If enabled the Nagle’s algorithm is activated per default for all TCP sockets, but can be deactivated via TcpIp_ChangeParameter() API.
        integer TcpIpTcpReceiveWindowMax: 0..65535, default-value=512  # Default value of maximum receive window in bytes.
        float TcpIpTcpRetransmissionTimeout [0..1]: 0.001..1.7976931348623157E+308, default-value=1  # Timeout in [s] before an unacknowledged TCP segment is sent again. | If the timeout is disabled or set to INF, no TCP segments shall be retransmitted.
        boolean TcpIpTcpSlowStartEnabled: default-value=false  # Enables (TRUE) or disables (FALSE) support of TCP slow start algorithm according to IETF RFC 5681.
        integer TcpIpTcpSynMaxRtx: 0..255, default-value=255  # Maximum number of times that a TCP SYN is retransmitted. | Note: SYN will be retried after TcpIpTcpRetransmissionTimeout. The connection will be dropped if no matching connection request has been received after the last TCP SYN has been sent and TcpIpTcpRetransmissionTimeout has been expired.
        float TcpIpTcpSynReceivedTimeout: 0..1.7976931348623157E+308, default-value=0  # Timeout in [s] to complete a remotely initiated TCP connection establishment, i.e. maximum time waiting in SYN-RECEIVED for a confirming connection request acknowledgment after having both received and sent a connection request.
        integer TcpIpTcpTtl: 0..255, default-value=64  # Default Time-to-live value of outgoing TCP packets.
        boolean TcpIpTcpEnableDiagReadAckSeqNum [0..1]: set at pre-compile, origin=Vector Informatik, default-value=false  # Enable reading of current TCP sequence number and acknowledgement number for a specified socket.
        boolean TcpIpTcpSackOptionSupport [0..1]: set at pre-compile, origin=Vector Informatik, default-value=false  # Enable Selective Acknowledgement Support | This parameter defines if the TCP option 'selective acknowlagement' is enabled. [RFC 2018] RESTRICTIONS: 'TcpSackOptionSupport' is only available, if 'TcpOutOfOrderRxSupport' is set to 'true'.
        integer TcpIpTcpMaxNumOooSegsPerSocket [0..1]: 1..65535, set at pre-compile, origin=Vector Informatik, default-value=5  # Max Num Out Of Order Segments per Socket | This value specifes the maximum number of out of order control elements that can be allocated for one TCP socket during runtime. RESTRICTIONS: 'TcpAvgNumOooSegsPerSocket' is only available, if 'TcpOutOfOrderRxSupport' is set to 'true'.
        integer TcpIpTcpAvgNumOooSegsPerSocket [0..1]: 1..254, set at pre-compile, origin=Vector Informatik, default-value=5  # Avg Num Out Of Order Segments per Socket | This value specifes the number of out of order control elements per TCP socket. The elements are grouped into a pool shared by all TCP sockets. A TCP socket is allowed to allocate as much elements as specified by 'TcpIpTcpMaxNumOooSegsPerSocket'. RESTRICTIONS: 'TcpAvgNumOooSegsPerSocket' is only available, if 'TcpOutOfOrderRxSupport' is set to 'true'.
        float TcpIpTcpUserTimeoutDef: 0..10000, set at pre-compile, origin=Vector Informatik, default-value=20  # This value specifies the default value for User Timeout. (default: 20s) (time transmitted data may stay un-acknowlaged) RESTRICTION: Value of 'TcpUserTimeoutDef' has to be in the range defined by 'TcpUserTimeoutMin' and 'TcpUserTimeoutMax'.
        float TcpIpTcpUserTimeoutMax [0..1]: 0..10000, set at pre-compile, origin=Vector Informatik, default-value=300  # This value specifes the maximum value for User Timeout. (default: 300s) RESTRICTION: Value of 'TcpUserTimeoutMax' has to be greater than 'TcpUserTimeoutMin' and greater than or equal to 'TcpUserTimeoutDef'.
        float TcpIpTcpUserTimeoutMin [0..1]: 0..5000, set at pre-compile, origin=Vector Informatik, default-value=5  # This value specifies the minimum value for User Timeout. (default: 5s) RFC 1122 defines it to 100 seconds (3 minutes for SYN segments). RESTRICTION: Value of 'TcpUserTimeoutMin' has to be smaller than 'TcpUserTimeoutMax' and smaller than or equal to 'TcpUserTimeoutDef'.
        boolean TcpIpTcpUserTimeoutOptionSupport: set at pre-compile, origin=Vector Informatik, default-value=false  # This parameter defines if the User Timeout Option of TCP is enabled.
        float TcpIpTcpTxRetryIntMaxTime: 10..60, set at pre-compile, origin=Vector Informatik, default-value=60  # Max Tx Retry Interval Time | This value specifies the upper bound of the time interval, in which the retransmittion of a not acknowledged TCP packet is triggered.
        float TcpIpTcpTxRetryIntMinTime: 0.1..10, set at pre-compile, origin=Vector Informatik, default-value=1  # Min Tx Retry Interval Time | This value specifies the lower bound of the time interval, in which the retransmittion of a not acknowledged TCP packet is triggered.
        boolean TcpIpTcpTimeStampOptionSupport: set at pre-compile, origin=Vector Informatik, default-value=false  # Enable Time Stamp Option | This parameter defines if the Timestamp Option of TCP is enabled.
        float TcpIpTcpNagleTimeout [0..1]: 0..65535, set at pre-compile, origin=Vector Informatik, default-value=0  # Nagle Timeout | This value specifies the timeout for Nagle algorithm, Note: Value must be a multiple of Main Function Period RESTRICTIONS: 'TcpNagleTimeoutMsec' is only available, if 'TcpEnableNagle' is enabled.
        float TcpIpTcpIdleTimeout: 1..65535, set at pre-compile, origin=Vector Informatik, default-value=30  # Idle Timeout | This value specifes the TCP idle timeout (must be bigger than MSL timeout)
        integer TcpIpTcpTxResetQueueSize: 0..127, set at pre-compile, origin=Vector Informatik, default-value=8  # Tx Reset Queue Size | This value specifies the amount of entries reserved for the Tx Reset Queue. Note: The Reset Queue is shared by all TCP Sockets.
        integer TcpIpTcpTxRetryQueueSize: 0..127, set at pre-compile, origin=Vector Informatik, default-value=10  # Average Tx Retry Queue Size | This value specifies the average amount of entries allocated for the Tx Retry Queue of one TCP Socket. Note: The Retry Queues are grouped in a pool shared by all TCP Sockets. Therefore a Socket may have less entries available as specified.
        boolean TcpIpTcpOutOfOrderRxSupport: set at pre-compile, origin=Vector Informatik, default-value=true  # Out Of Order Rx Support | This parameter defines if the reception of out of order TCP segments is supported.
        container TcpIpTcpSocketBuffer [1..*]  # This container includes the rx and tx buffer configuration of a TCP socket. The number of available socket handles will be the sum of all TCP rx and tx buffer configurations and the number of all TCP listen sockets. Note: rx and tx buffers are not bound to a specific socket handle. The buffers are shared between all users and must be allocated to a socket during runtime via the TcpIp_ChangeParameter() API.
          integer TcpIpTcpSocketRxBufferSize: 1..65535, set at pre-compile, origin=Vector Informatik, default-value=512  # This value specifies the size of a RX buffer segment that can be allocated to a TCP socket handle via the TcpIp_ChangeParameter() API during runtime. Note: A buffer segment is shared between all TCP sockets but can only be used for one socket at a time. If multiple sockets with the same buffer size shall be used simultaneously, multiple buffer segments of the same size have to be configured.
          integer TcpIpTcpSocketTxBufferSize: 1..65535, set at pre-compile, origin=Vector Informatik, default-value=512  # This value specifies the size of a TX buffer segment that can be allocated to a TCP socket handle via the TcpIp_ChangeParameter() API during runtime. Note: A buffer segment is shared between all TCP sockets but can only be used for one socket at a time. If multiple sockets with the same buffer size shall be used simultaneously, multiple buffer segments of the same size have to be configured.
      container TcpIpUdpConfig [0..1]  # Specifies the configuration parameters of the UDP (User Datagram Protocol) sub-module
        integer TcpIpUdpTtl: 0..255, default-value=64  # Default Time-to-live value of outgoing UDP packets.
        container TcpIpUdpTxReqList [0..*]  # This container includes configuration parameters of a UDP TX request list that can be attached to a UDP socket handle via TcpIp_ChangeParameter() during runtime. A UDP socket only needs a TX request list if a TxConfirmation is required by the upper layer. Note: A UDP tx request list is shared between all UDP sockets but can only be used for one socket at a time. If multiple sockets with the same request list size shall be used simultaneously, multiple request lists of the same size have to be configured.
          integer TcpIpUdpTxReqListSize: 1..255, set at pre-compile, origin=Vector Informatik, default-value=1  # This value specifies the maximum number of entries in the UDP TX request list.
    container TcpIpGeneral  # This container is a subcontainer of TcpIp and specifies the general configuration parameters of the TCP/IP stack.
      integer TcpIpBufferMemory: 0..4294967295, default-value=0  # Memory size in bytes reserved for TCP/IP buffers.
      boolean TcpIpDevErrorDetect: default-value=true  # If true then TCP/IP will enable the error-reporting to the Development Error Tracer (DET).
      boolean TcpIpDhcpServerEnabled: default-value=false  # Enables (TRUE) or disables (FALSE) the DHCPv4 (Dynamic Host Configuration Protocol) Server.
      float TcpIpMainFunctionPeriod: 0.0001..1000, default-value=0.005  # Period of TcpIp_MainFunction in [s].
      boolean TcpIpResetIpAssignmentApi: default-value=true  # Enables/disables the API TcpIp_ResetIpAssignment of a DHCP-client.
      enumeration TcpIpScalabilityClass: {SC1, SC2, SC3}, default-value=SC1  # In order to customize the TcpIp Stack to the specific needs of the user it can be scaled according to the scalability classes.
      boolean TcpIpTcpEnabled: default-value=false  # Enables (TRUE) or disabled (FALSE) support of TCP (Transmission Control Protocol).
      integer TcpIpTcpSocketMax: 0..65535, default-value=0  # Maximum number of TCP sockets
      boolean TcpIpUdpEnabled: default-value=false  # Enables (TRUE) or disabled (FALSE) support of UDP (User Datagram Protocol)
      integer TcpIpUdpSocketMax: 0..65535, default-value=0  # Maximum number of UDP sockets.
      boolean TcpIpVersionInfoApi: default-value=false  # If true the TcpIp_GetVersionInfo API is available.
      string TcpIpUserConfigFile: set at pre-compile, origin=Vector Informatik  # User Config File | Reference to an external user configuration file that will be included during generation. The content of the user configuration file will be added at the end of the generated module configuration file and allows altering or extending the generated code. Caution: User configuration files can cause the software module to malfunction and must only be used with great care!
      function name TcpIpRandNoFct: set at pre-compile, origin=Vector Informatik, default-value=Appl_Crypto_GetRandNo  # Random Number Function | This parameter defines the function called for the random number generation.
      string TcpIpRandNoFctIncludeFile: set at pre-compile, origin=Vector Informatik, default-value=Appl_Rand.h  # Random Function Include File | This parameter defines the header file holding the declaration of the random number generation function defined in 'TcpIpRandNoFct'.
      boolean TcpIpDiagExtensionsEnabled: set at pre-compile, origin=Vector Informatik, default-value=false  # Enable diagnostic read access to several parameters. For some parameters read access has to be enabled separately. Read features can be located at TcpIp_General or at the different sub-components.
      container TcpIpIpV4General  # This container is a subcontainer of TcpIp and specifies the general configuration parameters of the TCP/IP stack for IPv4
        boolean TcpIpArpEnabled: default-value=true  # Enables (TRUE) or disables (FALSE) support of ARP (Address Resolution Protocol).
        boolean TcpIpAutoIpEnabled: default-value=false  # Enables (TRUE) or disables (FALSE) the Auto-IP (automatic private IP addressing) sub-module.
        boolean TcpIpDhcpClientEnabled: default-value=false  # Enables (TRUE) or disables (FALSE) the DHCP (Dynamic Host Configuration Protocol) Client.
        boolean TcpIpIcmpEnabled: default-value=true  # Enables (TRUE) or disabled (FALSE) support of ICMP (Internet Control Message Protocol).
        boolean TcpIpIpV4Enabled: default-value=false  # Enables (TRUE) or disables (FALSE) support of IPv4 (Internet Protocol version 4).
        integer TcpIpLocalAddrIpv4EntriesMax: 0..255, default-value=0  # Maximum number of LocalAddr table entries for IPv4.
        boolean TcpIpPathMtuDiscoveryEnabled: default-value=false  # Enables (TRUE) or disables (FALSE) the discovery of the maximum transmission unit on a path according to IETF RfC 1191.
        string TcpIpIpV4UserConfigFile: set at pre-compile, origin=Vector Informatik  # User Config File | Reference to an external user configuration file that will be included during generation. The content of the user configuration file will be added at the end of the generated module configuration file and allows altering or extending the generated code. Caution: User configuration files can cause the software module to malfunction and must only be used with great care!
        reference TcpIpIpV4DefaultCtrl [0..1]: set at pre-compile, origin=Vector Informatik, destination=TcpIpIpV4Ctrl  # Default IP Controller | Reference to the default controller for messages not directed to own subnet(s)
      container TcpIpIpV6General  # This container is a subcontainer of TcpIp and specifies the general configuration parameters of the TCP/IP stack for IPv6.
        boolean TcpIpDhcpV6ClientEnabled: default-value=false  # Enables (TRUE) or disables (FALSE) the DHCPv6 (Dynamic Host Configuration Protocol for IPv6) Client.
        boolean TcpIpIpV6Enabled: default-value=false  # Enables (TRUE) or disables (FALSE) support of IPv6 (Internet Protocol version 6).
        boolean TcpIpIpV6PathMtuDiscoveryEnabled: default-value=false  # Enables (TRUE) or disables (FALSE) Path MTU Discovery support for IPv6 according to IETF RFC 1981.
        integer TcpIpLocalAddrIpv6EntriesMax: 0..255, default-value=0  # Maximum number of LocalAddr table entries for IPv6.
        boolean TcpIpNdpAddressResolutionUnrechabilityDetectionEnabled: default-value=true  # Enables (TRUE) or disables (FALSE) support of Address Resoultion and Neighbor Unreachability Detetion via NDP.
        boolean TcpIpNdpPrefixAndRouterDiscoveryEnabled: default-value=true  # Enables (TRUE) or disables (FALSE) support of Prefix and Router Discovery via NDP.
        string TcpIpIpV6UserConfigFile: set at pre-compile, origin=Vector Informatik  # User Config File | Reference to an external user configuration file that will be included during generation. The content of the user configuration file will be added at the end of the generated module configuration file and allows altering or extending the generated code (in IpV6_Cfg.h). Caution: User configuration files can cause the software module to malfunction and must only be used with great care!
        boolean TcpIpIpV6EthIfUpdatePhysAddrFilterApiEnabled: set at pre-compile, origin=Vector Informatik, default-value=true  # Enable Configuration of Ethernet Group Address filter | This parameter defines whether the IpV6 will call EthIf_SetPhysAddrFilter() in order to configure the ethernet group address Rx filter. Since the IPv6 Neighbor Discovery Protocol uses ethernet link-layer multicasts, the controller must be configured to accept received ethernet multicast IPv6 packets. If the controller is in promiscuous mode or statically configured to accept all neccessary multicasts, this parameter can be disabled in order to avoid superfluous calls to the EthIf API.
        boolean TcpIpIpV6SetTrafficClassAndFlowLabelApiEnabled: set at pre-compile, origin=Vector Informatik, default-value=false  # Enable Traffic Class API | This parameter defines whether the IpV6 provides the IpV6_SetTrafficClass() and IpV6_SetFlowLabel() APIs to change the Traffic Class octet of the IPv6 header for outgoing packets. If enabled the value can be set on a per-socket basis during runtime. The default values for the Traffic Class and the Flow Label for all outgoing packets are controller specific and are configured by the IpV6DefaultTrafficClass and IpV6DefaultFlowLabel parameters. [RFC2460 3. IPv6 Header Format] [RFC2460 7. Traffic Classes] see also [RFC2474 3. Differentiated Services Field Definition]
        boolean TcpIpIpV6ExtendedDestAddrValidationEnabled: set at pre-compile, origin=Vector Informatik, default-value=false  # This parameter defines whether the IpV6 will check the destination address every time IpV6_ProvideTxBuffer() is called. If disabled the user should call IpV6_IsValidDestinationAddr() before IpV6_ProvideTxBuffer() is called the first time with a specific destination address.
        boolean TcpIpIpV6CacheLookupOptimizationEnabled: set at pre-compile, origin=Vector Informatik, default-value=true  # Enable Cache Lookup Optimization | This parameter defines whether lookups in internal IpV6 data structures shall be optimized. If enabled the last lookup result is stored and reused for the next lookup. Disabling this feature will save some bytes in RAM and ROM but reduce performance.
        reference TcpIpIpV6DefaultCtrl [0..1]: set at pre-compile, origin=Vector Informatik, destination=TcpIpIpV6Ctrl  # Default IP Controller | Reference to the IpV6 controller instance to which this address shall be assigned.
