AUTOSAR XML (schema 4-0-3)
# The material contained in this specification is protected by copyright and
# other types of Intellectual Property Rights. The commercial exploitation of
# the material contained in this specification requires a license to such
# Intellectual Property Rights.
# This specification may be utilized or reproduced without any modification, in
# any form or by any means, for informational purposes only.
# For any other purpose, no part of the specification may be utilized or
# reproduced, in any form or by any means, without permission in writing from
# the publisher.
# licensed under the same rules as applicable to the AUTOSAR Standard.
package /AUTOSAR/EcucDefs
  module definition FlsTst [0..1]: variants post-build/pre-compile
    container FlsTstConfigSet: multiple-configuration-container=true  # Multiple Configuration Set Container
      integer FlsTstBlockNumberBgnd: 0..4294967295, set at post-build in variant post-build / pre-compile in variant pre-compile  # This parameter shall represent the number of test blocks available for the background test. | calculationFormula = Number of configured FlsTstBlocks in the FlsTstBlockBgndConfigSet (or 0 if no FlsTstBlocks are configured).
      integer FlsTstBlockNumberFgnd: 0..4294967295, set at post-build in variant post-build / pre-compile in variant pre-compile  # This parameter shall represent the number of test blocks available for the foreground test. | calculationFormula = Number of configured FlsTstBlocks in the FlsTstBlockFgndConfigSet (or 0 if no FlsTstBlocks are configured).
      function name FlsTstTestCompletedNotification: set at post-build in variant post-build / pre-compile in variant pre-compile  # Pointer to function, which shall be called after finishing the background Flash test interval.
      container FlsTstBlockBgndConfigSet [0..1]  # This container defines the blocks in background mode.
        container FlsTstBlock [1..*]  # This container specifies configuration parameters for an individual test block.
          integer FlsTstBlockBaseAddress: 0..18446744073709551615, set at post-build in variant post-build / pre-compile in variant pre-compile  # Start Address of the Flash block.
          integer FlsTstBlockIndex: 0..4294967295, set at post-build in variant post-build / pre-compile in variant pre-compile, symbolic-name-value=true  # Foreground Test: Index identifies block to be tested by FlsTst_StartFgnd(); | Background Test: The scheduling for background test shall follow an order defined by this index. '0' means highest priority.
          integer FlsTstBlockSize: 0..4294967295, set at post-build in variant post-build / pre-compile in variant pre-compile  # This parameter shall represent the Flash Test block size.
          integer FlsTstNumberOfTestedCells: 0..4294967295, set at pre-compile  # Configures the Number of cells to be tested in background mode during one scheduled task (FlsTst_MainFunction() call).
          integer FlsTstSignatureAddress: 0..18446744073709551615, set at post-build in variant post-build / pre-compile in variant pre-compile  # Address of the signature reference value of the Flash test block.
          enumeration FlsTstTestAlgorithm: {FLSTST_16BIT_CRC, FLSTST_32BIT_CRC, FLSTST_8BIT_CRC, FLSTST_CHECKSUM, FLSTST_DUPLICATED_MEMORY, FLSTST_ECC}, set at post-build in variant post-build / pre-compile in variant pre-compile  # This is the configuration of the test algorithm for foreground mode and background mode. The availability of algorithm is implementation specific.
      container FlsTstBlockFgndConfigSet [0..1]  # This container defines the blocks in foreground mode.
        container FlsTstBlock [1..*]  # This container specifies configuration parameters for an individual test block.
          integer FlsTstBlockBaseAddress: 0..18446744073709551615, set at post-build in variant post-build / pre-compile in variant pre-compile  # Start Address of the Flash block.
          integer FlsTstBlockIndex: 0..4294967295, set at post-build in variant post-build / pre-compile in variant pre-compile, symbolic-name-value=true  # Foreground Test: Index identifies block to be tested by FlsTst_StartFgnd(); | Background Test: The scheduling for background test shall follow an order defined by this index. '0' means highest priority.
          integer FlsTstBlockSize: 0..4294967295, set at post-build in variant post-build / pre-compile in variant pre-compile  # This parameter shall represent the Flash Test block size.
          integer FlsTstNumberOfTestedCells: 0..4294967295, set at pre-compile  # Configures the Number of cells to be tested in background mode during one scheduled task (FlsTst_MainFunction() call).
          integer FlsTstSignatureAddress: 0..18446744073709551615, set at post-build in variant post-build / pre-compile in variant pre-compile  # Address of the signature reference value of the Flash test block.
          enumeration FlsTstTestAlgorithm: {FLSTST_16BIT_CRC, FLSTST_32BIT_CRC, FLSTST_8BIT_CRC, FLSTST_CHECKSUM, FLSTST_DUPLICATED_MEMORY, FLSTST_ECC}, set at post-build in variant post-build / pre-compile in variant pre-compile  # This is the configuration of the test algorithm for foreground mode and background mode. The availability of algorithm is implementation specific.
    container FlsTstConfigurationOfOptApiServices
      boolean FlsTstGetCurrentStateApi: set at pre-compile, default-value=false  # Adds / removes the service FlsTst_GetCurrentState() from the code.
      boolean FlsTstGetErrorDetailsApi: set at pre-compile, default-value=false  # Adds / removes the service FlsTst_GetErrorDetails() from the code.
      boolean FlsTstGetTestResultBgndApi: set at pre-compile, default-value=false  # Adds / removes the service FlsTst_GetTestResultBgnd() from the code.
      boolean FlsTstGetTestResultFgndApi: set at pre-compile, default-value=false  # Adds / removes the service FlsTst_GetTestResultFgnd() from the code.
      boolean FlsTstGetTestSignatureBgndApi: set at pre-compile, default-value=false  # Adds / removes the service FlsTst_GetTestSignatureBgnd() from the code.
      boolean FlsTstGetTestSignatureFgndApi: set at pre-compile, default-value=false  # Adds / removes the service FlsTst_GetTestSignatureFgnd() from the code.
      boolean FlsTstStartFgndApi: set at pre-compile, default-value=false  # Adds / removes the service FlsTst_StartFgnd() from the code.
      boolean FlsTstSuspendResumeApi: set at pre-compile, default-value=false  # Adds / removes the services FlsTst_Suspend() and FlsTst_Resume() from the code.
      boolean FlsTstTestEccApi: set at pre-compile, default-value=false  # Adds / removes the service FlsTst_TestEcc() from the code.
      boolean FlsTstVersionInfoApi: set at pre-compile, default-value=false  # Adds / removes the service FlsTst_GetVersionInfo() from the code.
    container FlsTstDemEventParameterRefs [0..1]  # Container for the references to DemEventParameter elements which shall be invoked using the API Dem_ReportErrorStatus API in case the corresponding error occurs. The EventId is taken from the referenced DemEventParameter's DemEventId value. The standardized errors are provided in the container and can be extended by vendor specific error references.
      symbolic name reference FLSTST_E_FLSTST_FAILURE [0..1]: set at pre-compile, destination=DemEventParameter  # Reference to the DemEventParameter which shall be issued when the error "Flash Failure" has occurred.
    container FlsTstGeneral
      boolean FlsTstDevErrorDetect: set at pre-compile, default-value=false  # Switch for enabling the development error detection.
      integer FlsTstNumberOfTestedCellsAtomic: 0..4294967295, set at pre-compile  # Configures the Number of cells to be tested in background mode without checking user requests (Abort, Suspend).
      boolean FlsTstTestCompletedNotificationSupported: set at pre-compile, default-value=true  # Switch to indicate that the notification is supported.
      integer FlsTstTestIntervalIdEndValue: 0..4294967295, set at pre-compile  # Defines the end value of the Test Interval Id.
      boolean FlsTstTestResultSignature: set at pre-compile, default-value=false  # Configures the result of the test in background mode: | True: Test Result is a signature (see FlsTst155, FlsTst054) False: Test Result is ok/not ok (see FlsTst153, FlsTst042)
