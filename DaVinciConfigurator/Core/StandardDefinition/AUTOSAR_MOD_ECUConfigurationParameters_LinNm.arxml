AUTOSAR XML (schema 4-0-3)
# The material contained in this specification is protected by copyright and
# other types of Intellectual Property Rights. The commercial exploitation of
# the material contained in this specification requires a license to such
# Intellectual Property Rights.
# This specification may be utilized or reproduced without any modification, in
# any form or by any means, for informational purposes only.
# For any other purpose, no part of the specification may be utilized or
# reproduced, in any form or by any means, without permission in writing from
# the publisher.
# licensed under the same rules as applicable to the AUTOSAR Standard.
package /AUTOSAR/EcucDefs
  module definition LinNm [0..1]: variants link-time/pre-compile  # Configuration Parameters for the Lin Nm module.
    container LinNmGlobalConfig  # This container contains the global configuration parameter of the LinNm.
      boolean LinNmBusSynchronizationEnabled: set at pre-compile  # Pre-processor switch for enabling bus synchronization support of the LinNm. This feature is required for NM Coordinator nodes only.
      boolean LinNmComControlEnabled: set at pre-compile  # Pre-processor switch for enabling the Communication Control support.
      boolean LinNmComUserDataSupport: set at pre-compile  # Pre-processor switch for enabling the NM COM user data support
      boolean LinNmCoordinatorSyncSupport: set at pre-compile  # Enables/disables the coordinator synchronisation support.
      boolean LinNmDevErrorDetect: set at pre-compile  # Pre-processor switch for enabling development error detection support.
      boolean LinNmNodeDetectionEnabled: set at pre-compile  # Pre-processor switch for enabling the Node Detection feature.
      boolean LinNmNodeIdEnabled: set at pre-compile  # Pre-processor switch for enabling transmission of the source node identifier in NM messages.
      boolean LinNmPassiveModeEnabled: set at pre-compile  # Pre-processor switch for enabling support of the Passive Mode of the LinNm.
      boolean LinNmRemoteSleepIndicationEnabled: set at pre-compile  # Pre-processor switch for enabling Remote Sleep Indication support. This feature is required for NM Coordinator nodes only.
      boolean LinNmStateChangeIndEnabled: set at pre-compile  # Pre-processor switch for enabling the Network Management state change notification.
      boolean LinNmSynchronizationPointEnabled: set at pre-compile, default-value=false  # Pre-processor switch for enabling the Synchronize NM feature.
      boolean LinNmUserDataEnabled: set at pre-compile  # Pre-processor switch for enabling User Data support.
      boolean LinNmVersionInfoApi: set at pre-compile  # Pre-processor switch for enabling version info API support.
      container LinNmChannelConfig [1..*]  # This container contains the channel specific configuration parameter of the LinNm.
        symbolic name reference LinNmComMNetworkHandleRef: set at link in variant link-time / pre-compile in variant pre-compile, destination=ComMChannel  # This reference points to the unique channel defined by the ComMChannel and provides access to the unique channel index value in ComMChannelId.
