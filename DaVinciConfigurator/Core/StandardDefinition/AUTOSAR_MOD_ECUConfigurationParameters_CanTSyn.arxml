AUTOSAR XML (schema 4-0-3)
# The material contained in this specification is protected by copyright and
# other types of Intellectual Property Rights. The commercial exploitation of
# the material contained in this specification requires a license to such
# Intellectual Property Rights.
# This specification may be utilized or reproduced without any modification, in
# any form or by any means, for informational purposes only.
# For any other purpose, no part of the specification may be utilized or
# reproduced, in any form or by any means, without permission in writing from
# the publisher.
# licensed under the same rules as applicable to the AUTOSAR Standard.
package /AUTOSAR/EcucDefs
  module definition CanTSyn [0..1]: category=VENDOR_SPECIFIC_MODULE_DEFINITION, variants post-build/pre-compile  # Configuration of the Synchronized Time-base Manager (StbM) module with respect to global time handling on CAN.
    container CanTSynGeneral  # This container holds the general parameters of the CAN-specific Synchronized Time-base Manager
      boolean CanTSynDevErrorDetect: default-value=true  # Switch for enabling the development error detection.
      float CanTSynMainFunctionPeriod: 0..1.7976931348623157E+308  # Schedule period of the main function CanTSyn_MainFunction. Unit: [s].
      boolean CanTSynVersionInfo: default-value=false  # Activate/Deactivate the version information API (CanTSyn_GetVersionInfo). True: version information API activated False: version information API deactivated.
      container CanTSynGlobalTimeFupDataIDList  # The DataIDList for FUP messages ensures the identification of data elements due to CRC calculation process.
        container CanTSynGlobalTimeFupDataIDListElement [16..16]  # Element of the DataIDList for FUP messages ensures the identification of data elements due to CRC calculation process.
          integer CanTSynGlobalTimeFupDataIDListIndex: 0..15  # Index of the DataIDList for FUP messages ensures the identification of data elements due to CRC calculation process.
          integer CanTSynGlobalTimeFupDataIDListValue: 0..255  # Value of the DataIDList for FUP messages ensures the identification of data elements due to CRC calculation process.
      container CanTSynGlobalTimeOfnsDataIDList  # The DataIDList for OFNS messages ensures the identification of data elements due to CRC calculation process.
        container CanTSynGlobalTimeOfnsDataIDListElement [16..16]  # Element of the DataIDList for OFNS messages ensures the identification of data elements due to CRC calculation process.
          integer CanTSynGlobalTimeOfnsDataIDListIndex: 0..15  # Index of the DataIDList for OFNS messages ensures the identification of data elements due to CRC calculation process.
          integer CanTSynGlobalTimeOfnsDataIDListValue: 0..255  # Value of the DataIDList for OFNS messages ensures the identification of data elements due to CRC calculation process.
      container CanTSynGlobalTimeOfsDataIDList  # The DataIDList for OFS messages ensures the identification of data elements due to CRC calculation process.
        container CanTSynGlobalTimeOfsDataIDListElement [16..16]  # Element of the DataIDList for OFS messages ensures the identification of data elements due to CRC calculation process.
          integer CanTSynGlobalTimeOfsDataIDListIndex: 0..15  # Index of the DataIDList for OFS messages ensures the identification of data elements due to CRC calculation process.
          integer CanTSynGlobalTimeOfsDataIDListValue: 0..255  # Value of the DataIDList for OFS messages ensures the identification of data elements due to CRC calculation process.
      container CanTSynGlobalTimeSyncDataIDList  # The DataIDList for SYNC messages ensures the identification of data elements due to CRC calculation process.
        container CanTSynGlobalTimeSyncDataIDListElement [16..16]  # Element of the DataIDList for SYNC messages ensures the identification of data elements due to CRC calculation process.
          integer CanTSynGlobalTimeSyncDataIDListIndex: 0..15  # Index for the DataIDList for SYNC messages ensures the identification of data elements due to CRC calculation process.
          integer CanTSynGlobalTimeSyncDataIDListValue: 0..255  # Value of the DataIDList for SYNC messages ensures the identification of data elements due to CRC calculation process.
    container CanTSynGlobalTimeDomain [1..*]  # This represents the existence of a global time domain on CAN. The CanTSyn module can administrate several global time domains at the same time that in itself form a hierarchy of domains and sub-domains. | If the CanTSyn exists it is assumed that at least one global time domain exists.
      integer CanTSynGlobalTimeDomainId: 0..31  # The global time domain ID.
      float CanTSynGlobalTimeFollowUpTimeout: 0..1.7976931348623157E+308  # Rx timeout for the follow-up message. This is only relevant for selected bus systems Unit:seconds
      integer CanTSynGlobalTimeSequenceCounterJumpWidth: 1..15  # The SequenceCounterJumpWidth specifies the maximum allowed gap of the Sequence Counter between two SYNC resp. two OFS messages.
      symbolic name reference CanTSynSynchronizedTimeBaseRef: destination=StbMSynchronizedTimeBase  # Mandatory reference to the required synchronized time-base.
      container CanTSynGlobalTimeMaster [0..*]  # Configuration of the global time master. Each global time domain is required to have exactly one global time master. This master may or may not exist on the configured ECU.
        enumeration CanTSynGlobalTimeTxCrcSecured: {CRC_NOT_SUPPORTED, CRC_SUPPORTED}  # This represents the configuration of whether or not CRC is supported.
        float CanTSynGlobalTimeTxFollowUpOffset: 0..1.7976931348623157E+308  # This represents the transmission time offset between a SYNC message and the related FUP message resp. OFS message and related OFNS message. Unit: seconds.
        float CanTSynGlobalTimeTxPeriod: 0..1.7976931348623157E+308  # This represents configuration of the TX period. Unit: seconds
        float CanTSynMasterConfirmationTimeout: 0..1.7976931348623157E+308  # This represents the confirmation timeout after transmission of a SYNC message resp. OFS message. Unit: seconds.
        container CanTSynGlobalTimeMasterPdu  # This container encloses the configuration of the PDU that is supposed to contain the global time information.
          integer CanTSynGlobalTimeMasterConfirmationHandleId: 0..65535, symbolic-name-value=true, default-value=0  # This represents the handle ID of the PDU that contains the global time information.
          reference CanTSynGlobalTimePduRef: destination=Pdu  # This represents the reference to the Pdu taken to transmit the global time information. The global time master of a global time domain acts as the sender of the Pdu while all the time slaves are supposed to receive the Pdu.
      container CanTSynGlobalTimeSlave [0..1]  # Configuration of a global time slave. Each global time domain is required to have at least one time slave. The configured ECU may or may not represent a time slave.
        enumeration CanTSynRxCrcValidated: {CRC_IGNORED, CRC_NOT_VALIDATED, CRC_VALIDATED}  # Definition of whether or not validation of the CRC is supported.
        container CanTSynGlobalTimeSlavePdu  # This container encloses the configuration of the PDU that is supposed to contain the global time information.
          integer CanTSynGlobalTimeSlaveHandleId: 0..65535, symbolic-name-value=true, default-value=0  # This represents the handle ID of the PDU that contains the global time information.
          reference CanTSynGlobalTimePduRef: destination=Pdu  # This represents the reference to the Pdu taken to transmit the global time information. The global time master of a global time domain acts as the sender of the Pdu while all the time slaves are supposed to receive the Pdu.
