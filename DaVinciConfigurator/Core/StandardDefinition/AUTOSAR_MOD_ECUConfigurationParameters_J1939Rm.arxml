AUTOSAR XML (schema 4-0-3)
# The material contained in this specification is protected by copyright and
# other types of Intellectual Property Rights. The commercial exploitation of
# the material contained in this specification requires a license to such
# Intellectual Property Rights.
# This specification may be utilized or reproduced without any modification, in
# any form or by any means, for informational purposes only.
# For any other purpose, no part of the specification may be utilized or
# reproduced, in any form or by any means, without permission in writing from
# the publisher.
# licensed under the same rules as applicable to the AUTOSAR Standard.
package /AUTOSAR/EcucDefs
  module definition J1939Rm [0..1]: variants link-time/post-build/pre-compile  # The SAE J1939 Nm module
    container J1939RmConfigSet: multiple-configuration-container=true  # This container is a MultipleConfigurationContainer, i.e. this container and its sub-containers exist once per configuration set.
      container J1939RmChannel [1..*]: post-build-changeable=true  # Contains the parameters for a CAN channel supported by the J1939 Request Manager.
        integer J1939RmAckQueueSize: 0..255, set at link in variant link-time+post-build / pre-compile in variant pre-compile  # Number of transmitted acknowledgements that can be stored.
        integer J1939RmRequestQueueSize: 0..255, set at link in variant link-time+post-build / pre-compile in variant pre-compile  # Number of transmitted requests that can be stored.
        integer J1939RmRequestTimeoutMonitors: 0..255, set at link in variant link-time+post-build / pre-compile in variant pre-compile  # Number of transmitted requests that can be monitored for timeout.
        symbolic name reference J1939RmComMNetworkHandleRef: set at link in variant link-time+post-build / pre-compile in variant pre-compile, destination=ComMChannel  # Reference to the channel defined by the ComMChannel providing access to the unique channel index ComMChannelId.
        container J1939RmAckmRxPdu [0..1]  # Contains the configuration of the I-PDU used to receive the Acknowledgement PG.
          integer J1939RmAckmRxPduId: 0..65535, set at link in variant link-time+post-build / pre-compile in variant pre-compile, symbolic-name-value=true  # The I-PDU identifier used for RxIndication from PduR.
          reference J1939RmAckmRxPduRef: set at link in variant link-time+post-build / pre-compile in variant pre-compile, destination=Pdu  # Reference to the Pdu object representing the I-PDU.
        container J1939RmAckmTxPdu [0..1]  # Contains the configuration of the I-PDU used to transmit the Acknowledgement PG.
          integer J1939RmAckmTxPduId: 0..65535, set at link in variant link-time+post-build / pre-compile in variant pre-compile, symbolic-name-value=true  # The I-PDU identifier used for TxConfirmation from PduR.
          reference J1939RmAckmTxPduRef: set at link in variant link-time+post-build / pre-compile in variant pre-compile, destination=Pdu  # Reference to the Pdu object representing the I-PDU.
        container J1939RmRqstRxPdu [0..1]  # Contains the configuration of the I-PDU used to receive the Request PG.
          integer J1939RmRqstRxPduId: 0..65535, set at link in variant link-time+post-build / pre-compile in variant pre-compile, symbolic-name-value=true  # The I-PDU identifier used for RxIndication from PduR.
          reference J1939RmRqstRxPduRef: set at link in variant link-time+post-build / pre-compile in variant pre-compile, destination=Pdu  # Reference to the Pdu object representing the I-PDU.
        container J1939RmRqstTxPdu [0..1]  # Contains the configuration of the I-PDU used to transmit the Request PG.
          integer J1939RmRqstTxPduId: 0..65535, set at link in variant link-time+post-build / pre-compile in variant pre-compile, symbolic-name-value=true  # The I-PDU identifier used for TxConfirmation from PduR.
          reference J1939RmRqstTxPduRef: set at link in variant link-time+post-build / pre-compile in variant pre-compile, destination=Pdu  # Reference to the Pdu object representing the I-PDU.
      container J1939RmNode [1..*]: post-build-changeable=true  # Contains the parameters for the support of a logical J1939 node (identified by an ECU address).
        reference J1939RmNodeChannelRef [1..*]: set at link in variant link-time+post-build / pre-compile in variant pre-compile, destination=J1939RmChannel  # Reference to the channels this node has access to.
        symbolic name reference J1939RmNmNodeRef: set at link in variant link-time+post-build / pre-compile in variant pre-compile, destination=J1939NmNode  # Reference to the corresponding J1939Nm node.
        container J1939RmUser [1..*]: post-build-changeable=true  # Contains the configuration of a module that uses the request and acknowledgement interfaces of J1939Rm.
          boolean J1939RmUserAckIndication: set at pre-compile  # Enable AckIndication for this module. In case of CDD, the name is <apiServicePrefix>_AckIndication. In case of RTE, the port is defined as J1939RmRPort<J1939RmUserId>, and the operation is called AckIndication. This parameter shall not be set for J1939RmUserType J1939RM_USER_J1939NM, J1939RM_USER_J1939DCM, or J1939RM_USER_COM.
          integer J1939RmUserAckPGN [0..*]: 0..262143, set at link in variant link-time / post-build in variant post-build / pre-compile in variant pre-compile  # PGN supported to be acknowledged to this module. The PGNs supported by different modules should usually be disjunctive. This parameter shall not be set for J1939RmUserType J1939RM_USER_J1939NM, J1939RM_USER_J1939DCM, and J1939RM_USER_COM.
          integer J1939RmUserComIPduRequestQueueSize [0..1]: 0..255, set at link in variant link-time+post-build / pre-compile in variant pre-compile  # Number of received requests that can be stored for COM I-PDUs of this user.
          integer J1939RmUserId [0..1]: 0..65535, set at pre-compile, symbolic-name-value=true  # Identifier used by a module using J1939Rm. This parameter is only required when the module uses transmission of requests.
          integer J1939RmUserPGN [0..*]: 0..262143, set at link in variant link-time / post-build in variant post-build / pre-compile in variant pre-compile  # PGN supported to be requested from this module. The PGNs supported by different modules should usually be disjunctive. This parameter is predefined to AC (0x0EE00) for J1939RmUserType J1939RM_USER_J1939NM and is derived from the J1939Dcm PDUs in the system description for J1939RmUserType J1939RM_USER_J1939DCM. It shall not be set for J1939RmUserType J1939RM_USER_COM.
          boolean J1939RmUserRequestIndication: set at pre-compile  # Enable RequestIndication for this module. In case of J1939Nm or J1939Dcm, the name is fixed. In case of CDD, the name is <apiServicePrefix>_RequestIndication. In case of RTE, the port is defined as J1939RmRPort<J1939RmUserId>, and the operation is called RequestIndication. This parameter shall not be set for J1939RmUserType J1939RM_USER_COM.
          boolean J1939RmUserSendAck: set at pre-compile  # Enable the SendAck API for this module. In case of RTE, the port is defined as J1939RmPPort<J1939RmUserId>, and the operation is called SendAck. This parameter shall not be set for J1939RmUserType J1939RM_USER_J1939NM or J1939RM_USER_COM.
          boolean J1939RmUserSendRequest: set at pre-compile  # Enable the SendRequest API for this module. In case of RTE, the port is defined as J1939RmPPort<J1939RmUserId>, and the operation is called SendRequest. This parameter shall not be set for J1939RmUserType J1939RM_USER_J1939NM, J1939RM_USER_J1939DCM, or J1939RM_USER_COM.
          boolean J1939RmUserTimeoutSupervision: set at pre-compile  # Enable RequestTimeoutIndication and CancelRequestTimeout for this module. RequestTimeoutIndication: In case of CDD, the name is <apiServicePrefix>_RequestTimeoutIndication. | In case of RTE, the port is defined as J1939RmRPort<J1939RmUserId>, and the operation is called RequestTimeoutIndication. CancelRequestTimeout: In case of RTE, the port is defined as J1939RmPPort<J1939RmUserId>, and the operation is called CancelRequestTimeout. This parameter shall not be set for J1939RmUserType J1939RM_USER_J1939NM, J1939RM_USER_J1939DCM, or J1939RM_USER_COM.
          enumeration J1939RmUserType: {J1939RM_CDD, J1939RM_RTE, J1939RM_USER_COM, J1939RM_USER_J1939DCM, J1939RM_USER_J1939NM}, set at pre-compile  # Type of module using J1939Rm.
          foreign reference J1939RmUserCddRef [0..1]: set at pre-compile, destination-type=ECUC-MODULE-CONFIGURATION-VALUES  # Reference to the CDD module description. This parameter is only required for J1939RmUserType J1939RM_USER_CDD.
          container J1939RmComIPdu [0..*]: post-build-changeable=true  # Contains the configuration of an I-PDU that is to be transmitted on request by COM. This configuration container is only relevant for J1939RmUserType J1939RM_USER_COM.
            integer J1939RmComIPduDA: 0..253, set at link in variant link-time / post-build in variant post-build / pre-compile in variant pre-compile  # Destination address of the COM I-PDU.
            integer J1939RmComIPduPGN: 0..262143, set at link in variant link-time / post-build in variant post-build / pre-compile in variant pre-compile  # PGN of the COM I-PDU.
            integer J1939RmComIPduSA: 0..253, set at link in variant link-time / post-build in variant post-build / pre-compile in variant pre-compile  # Source address of the COM I-PDU.
            container J1939RmLowerComIPdu  # Contains the configuration of the I-PDU that is sent from J1939Rm to CanIf or J1939Tp.
              integer J1939RmLowerComIPduId: 0..65535, set at link in variant link-time+post-build / pre-compile in variant pre-compile, symbolic-name-value=true  # The I-PDU identifier used for communication with PduR.
              reference J1939RmLowerComIPduRef: set at link in variant link-time+post-build / pre-compile in variant pre-compile, destination=Pdu  # Reference to the Pdu object representing the I-PDU.
            container J1939RmUpperComIPdu  # Contains the configuration of the I-PDU that is sent from COM to J1939Rm.
              integer J1939RmUpperComIPduId: 0..65535, set at link in variant link-time+post-build / pre-compile in variant pre-compile, symbolic-name-value=true  # The I-PDU identifier used for communication with PduR.
              reference J1939RmUpperComIPduRef: set at link in variant link-time+post-build / pre-compile in variant pre-compile, destination=Pdu  # Reference to the Pdu object representing the I-PDU.
    container J1939RmGeneral  # Contains the general configuration parameters of the module.
      boolean J1939RmDevErrorDetect: set at pre-compile  # Pre-processor switch for enabling development error detection support.
      float J1939RmMainFunctionPeriod: 0.001..0.255, set at link in variant link-time+post-build / pre-compile in variant pre-compile  # Execution cycle of J1939Rm_MainFunction in seconds.
      boolean J1939RmSupportAckIndication: set at pre-compile  # Pre-processor switch for enabling support of acknowledgement indications.
      boolean J1939RmSupportAckTransmission: set at pre-compile  # Pre-processor switch for enabling support of acknowledgement transmission.
      boolean J1939RmSupportRequestIndication: set at pre-compile  # Pre-processor switch for enabling support of request indications.
      boolean J1939RmSupportRequestTransmission: set at pre-compile  # Pre-processor switch for enabling support of request transmission.
      boolean J1939RmSupportTimeoutSupervision: set at pre-compile  # Pre-processor switch for enabling support of request timeout supervision.
      float J1939RmTxConfirmationTimeout: 0..65.535, set at link in variant link-time+post-build / pre-compile in variant pre-compile  # Time in seconds to wait for a confirmation after transmission of a message. The behaviour when the time elapses depends on the transmitted message.
      boolean J1939RmVersionInfoApi: set at pre-compile  # Pre-processor switch for enabling version info API support.
