AUTOSAR XML (schema 4-0-3)
# The material contained in this specification is protected by copyright and
# other types of Intellectual Property Rights. The commercial exploitation of
# the material contained in this specification requires a license to such
# Intellectual Property Rights.
# This specification may be utilized or reproduced without any modification, in
# any form or by any means, for informational purposes only.
# For any other purpose, no part of the specification may be utilized or
# reproduced, in any form or by any means, without permission in writing from
# the publisher.
# licensed under the same rules as applicable to the AUTOSAR Standard.
package /AUTOSAR/EcucDefs
  module definition SoAd [0..1]: variants link-time/post-build/pre-compile  # Configuration of the SoAd (Socket Adaptor) module.
    container SoAdBswModules [0..*]  # Each container describes a specific BSW module that the SoAd shall interface to.
      boolean SoAdIf: set at pre-compile  # Specifies if the BSW module supports the Communication Interface APIs or not. Value true means that the APIs are supported. A module can have both Communication Interface APIs and Transport Protocol APIs (e.g. the PduR module).
      boolean SoAdIfTriggerTransmit: set at pre-compile  # Specifies if the BSW module supports the TriggerTransmit API or not. Value true means that the API is supported.
      boolean SoAdIfTxConfirmation: set at pre-compile  # Specifies if the BSW module supports the TxConfirmation API or not. Value true means that the API is supported.
      boolean SoAdLocalIpAddrAssigmentChg: set at pre-compile  # Specifies if the BSW module supports the LocalIpAddrAssigmentChg API or not. Value true means that the API is supported.
      boolean SoAdSoConModeChg: set at pre-compile  # Specifies if the BSW module supports the SoConModeChg API or not. Value true means that the API is supported.
      boolean SoAdTp: set at pre-compile  # Specifies if the BSW module supports the TransportProtocol APIs or not. Value true means that the APIs are supported. A module can have both Communication Interface APIs and Transport Protocol APIs (e.g. the PduR module).
      boolean SoAdUseCallerInfix: set at pre-compile, default-value=true  # Specifies if SoAd shall use (TRUE) the infix "SoAd" when calling an upper layer module function or not (FALSE). E.g. if SoAdUseCallerInfix is TRUE for the upper layer "ABC" then SoAd will call ABC_SoAdIfRxIndication() otherwise SoAd would call ABC_IfRxIndication().
      boolean SoAdUseTypeInfix: set at pre-compile, default-value=true  # Specifies if SoAd shall use (TRUE) the API type infix "Tp" or "If" when calling an upper layer module function or not (FALSE). E.g. if SoAdUseTypeInfix is TRUE for the upper layer "ABC" then SoAd will call ABC_IfRxIndication(), otherwise SoAd would call ABC_RxIndication().
      foreign reference SoAdBswModuleRef: set at pre-compile, destination-type=ECUC-MODULE-CONFIGURATION-VALUES  # This is a reference to one BSW module's configuration (i.e. not the ECUC parameter definition template). | Example, there could be several configurations of PduR and this reference selects one of them. SoAd has to figure out from the structure of the referenced BSW module's configuration, what kind of upper layer he deals with. In case of a CDD SoAd expects UL-APIs in form of _SoAd<If|Tp><function> and expects CDD Pdu configuration structures according to the Ecu Configuration specification (chapter CDD module\Socket Adaptor). In case it is one of the standardized AUTOSAR BSW modules, the configuration structures and API names for interaction with SoAd are defined in the corresponding SWS.
    container SoAdConfig: multiple-configuration-container=true  # This container contains the configuration parameters and sub containers of the AUTOSAR SoAd module. This container is a MultipleConfigurationContainer, i.e. this container and its sub-containers exist once per configuration set.
      integer SoAdConfigurationId: 0..65535, set at link in variant link-time / post-build in variant post-build / pre-compile in variant pre-compile  # Identification of the SoAd configuration.
      container SoAdPduRoute [1..*]  # Describes the path of a PDU from an upper layer of the SoAd to the socket in the TCP/IP stack for transmission.
        integer SoAdTxPduId: 0..65535, set at link in variant link-time / post-build in variant post-build / pre-compile in variant pre-compile, symbolic-name-value=true  # Tx PDU ID of the PDU coming from the PDU Router.
        enumeration SoAdTxUpperLayerType: {IF, TP}, set at link in variant link-time / post-build in variant post-build / pre-compile in variant pre-compile  # Specifies the upper layer interface type (must be "IF" in case of multiple PduRoutes).
        reference SoAdTxPduRef: set at link in variant link-time / post-build in variant post-build / pre-compile in variant pre-compile, destination=Pdu  # Reference to the global PDU structure
        container SoAdPduRouteDest [1..*]  # Specifies the PDU route destination.
          integer SoAdTxPduHeaderId [0..1]: 0..4294967296, set at link in variant link-time / post-build in variant post-build / pre-compile in variant pre-compile  # ID to be sent on the TCP/IP connection if the PDU header option is enabled.
          enumeration SoAdTxUdpTriggerMode [0..1]: {TRIGGER_ALWAYS, TRIGGER_NEVER}, set at link in variant link-time / post-build in variant post-build / pre-compile in variant pre-compile  # Specifies whether a PDU triggers the transmission of the nPduUdpTxBuffer. | If this parameter is set to TRIGGER_NEVER, SoAd shall use an nPduUdpTxBuffer for the related socket connection. nPduUdpTxBuffer can only be used for upper layers with IF API, i.e. this parameter shall only be set to TRIGGER_NEVER if all upper layers belonging to the related socket connection have SoAdTxUpperLayerType set to "IF". This parameter is only relevant for UDP connections.
          reference SoAdTxRoutingGroupRef [0..*]: set at link in variant link-time / post-build in variant post-build / pre-compile in variant pre-compile, destination=SoAdRoutingGroup  # Reference to the routing group.
          reference SoAdTxSocketConnectionRef: set at link in variant link-time / post-build in variant post-build / pre-compile in variant pre-compile, destination=SoAdSocketConnection  # Connection on which the PDU is to be sent on, references the appropriate entry in the Socket Connection Table.
      container SoAdRoutingGroup [0..*]  # Each container describes a specific routing group which can be enabled or disabled. A routing group consists of PDUs. Routing of PDUs can either be forwarding of PDUs from the upper layer to a TCP or UDP socket of the TCP/IP stack specified by a SoAdPduRoute or the other way around specified by a SoAdSocketRoute.
        integer SoAdRoutingGroupId: 0..65535, set at link in variant link-time / post-build in variant post-build / pre-compile in variant pre-compile, symbolic-name-value=true  # Unique ID of Routing Group
        boolean SoAdRoutingGroupIsEnabledAtInit: set at link in variant link-time / post-build in variant post-build / pre-compile in variant pre-compile  # If set to true this routing group will be enabled after initializing the SoAd module (i.e. enabled in the SoAd_Init function).
        boolean SoAdRoutingGroupTxTriggerable: set at pre-compile  # Specifies if the If-TxPDUs related to the PduRouteDest containers | referenced by this routing group can be triggered via SoAd_IfRoutingGroupTransmit (TRUE) or not (FALSE).
      container SoAdSocketConnectionGroup [1..*]  # Specifies the configuration of a socket connection group, i.e. specifies the socket connections belonging to the group and the parameters which are common for all socket connections of the group. A socket connection specifies how data can be received and transmited via a TCP or UDP socket.
        boolean SoAdPduHeaderEnable: set at link in variant link-time / post-build in variant post-build / pre-compile in variant pre-compile  # Enables the transmission of the PDU header (ID, length) on this socket connection. | TRUE: add SoAd PDU header before PDU data FALSE: No SoAd PDU header is used
        boolean SoAdResourceManagementEnable: set at link in variant link-time / post-build in variant post-build / pre-compile in variant pre-compile  # Enables the resource management option for this socket. | May not be activated for UDP sockets in receive. TRUE: resource management option enabled FALSE: resource management option disabled
        boolean SoAdSocketAutomaticSoConSetup: set at link in variant link-time / post-build in variant post-build / pre-compile in variant pre-compile, default-value=true  # Specifies if the setup of the socket connection shall be done automatically (TRUE) or manually (FALSE) via SoAd_OpenSoCon() and SoAd_CloseSoCon().
        integer SoAdSocketFramePriority [0..1]: 0..7, set at link in variant link-time / post-build in variant post-build / pre-compile in variant pre-compile  # Specifies the priority of the Ethernet frame. | If IEEE 802.1Q VLAN Tags are used, the specified priority will be used in the VLAN Tag PCP filed. If this optional parameter is not available the default priority specified in the TcpIp module is used.
        boolean SoAdSocketIpAddrAssignmentChgNotification: set at link in variant link-time / post-build in variant post-build / pre-compile in variant pre-compile, default-value=false  # Specifies if the local IP address assignment change notification callback function of the upper layer shall be called if the assignment of the local IP address used by this socket connection changes.
        integer SoAdSocketLocalPort: 0..65535, set at link in variant link-time / post-build in variant post-build / pre-compile in variant pre-compile, default-value=0  # Local UDP or TCP port used for this connection.If this parameter set to 0 SoAd requests TcpIp to select an ephemeral port.
        boolean SoAdSocketMsgAcceptanceFilterEnabled: set at link in variant link-time / post-build in variant post-build / pre-compile in variant pre-compile, default-value=true  # Specifies if the message acceptance filter is enabled (TRUE) or not (FALSE). | Note: if a wildcard is used in SoAdSocketRemoteAddress AND SoAdSocketUdpListenOnly is FALSE, this parameter must be TRUE. Note: if multiple SoAdSocketConnections are configured for one SoAdSocketConnectionGroup, this parameter must be TRUE.
        boolean SoAdSocketSoConModeChgNotification: set at link in variant link-time / post-build in variant post-build / pre-compile in variant pre-compile, default-value=false  # Specifies if the SoCon mode change notification callback function of the upper layer shall be called in case of SoCon mode change.
        integer SoAdSocketTpRxBufferMin [0..1]: 0..65535, set at link in variant link-time / post-build in variant post-build / pre-compile in variant pre-compile  # Specifies the amout of data in bytes (PDU data for the upper layer and PDU Header if used) the SoAd shall at least be able to buffer for data reception via each socket connection of the socket connection group and using an upper layer with TP. | Note: in case of a TCP socket where PduHeaderMode is used and an upper layer with IF-API, the required buffer size can be determined automatically.
        symbolic name reference SoAdSocketLocalAddressRef: set at link in variant link-time / post-build in variant post-build / pre-compile in variant pre-compile, destination=TcpIpLocalAddr  # Local IP address and interface used for this connection.
        container SoAdSocketConnection [1..*]  # Specifies the socket connection (Id and remote address information). | Note: Parameters which are common to all socket connections of a socket connection group are specified directly at the group.
          integer SoAdSocketId: 0..65535, set at link in variant link-time / post-build in variant post-build / pre-compile in variant pre-compile, symbolic-name-value=true  # Socket connection identifier used as SoConId in the interaction with upper layers.
          container SoAdSocketRemoteAddress [0..1]  # Subcontainer of SoAdSocketConnection to specify the remote address (IP address and port) for a socket connection. | If SoAdSocketRemoteAddress is not specified the remote address has to be set by the upper layer via SoAd_SetRemoteAddr().
            string SoAdSocketRemoteIpAddress: set at link in variant link-time / post-build in variant post-build / pre-compile in variant pre-compile  # IP address of remote node. | To accept any remote IP address, set SoAdSocketRemoteIpAddress to "ANY". See message acceptance policy for more details.
            integer SoAdSocketRemotePort: 0..65535, set at link in variant link-time / post-build in variant post-build / pre-compile in variant pre-compile  # Remote UDP or TCP port used for this connection. | To accept any remote port, set SoAdSocketRemotePort to 0. See message acceptance policy for more details.
        choice container SoAdSocketProtocol  # Specifies the transport protocol and transport protocol specific parameters used for the socket connections of the socket connection group.
          container SoAdSocketTcp [0..1]  # Specifies that TCP is used as transport protocol for the socket connection group and parameters only related to TCP socket connections.
            boolean SoAdSocketTcpImmediateTpTxConfirmation: set at link in variant link-time / post-build in variant post-build / pre-compile in variant pre-compile, default-value=false  # If set to FALSE, SoAd notifies the TP upper layer via transmit confirmation after a Tcp Ack has been received. If set to TRUE, SoAd notifies the TP upper layer via transmit confirmation immediately after transmit has been accepted by TcpIp.
            boolean SoAdSocketTcpInitiate: set at link in variant link-time / post-build in variant post-build / pre-compile in variant pre-compile  # Specifies the initiator for this TCP connection. It will not be defined for UDP sockets. | TRUE: This TCP connection is initiated by this module. FALSE: This TCP connection is to be initiated in the listen mode.
            boolean SoAdSocketTcpNoDelay [0..1]: set at link in variant link-time / post-build in variant post-build / pre-compile in variant pre-compile  # Specifies not to use the congestion control mechanism for this connection. It will not be defined for UDP sockets. | TRUE: This TCP connection will NOT use congestion control. FALSE: This TCP connection will use congestion control. If the optional parameter is not enabled, the default behavior configured for TcpIp via the parameter TcpIpTcpNagleEnabled is applied. Note: This parameter must not be set to FALSE if TcpIpTcpNagleEnabled is set to FALSE.
            integer SoAdSocketTcpTxQuota [0..1]: 0..4294967295, set at link in variant link-time / post-build in variant post-build / pre-compile in variant pre-compile  # Specifies the maximum amout of bytes (PDU data provided by the upper layer and PDU Header if used) the SoAd may queue for transmission via TCP at the TcpIp module for each socket connection of this socket connection group. | Rationale: prohibits that a socket connection consumes all available transmit buffers at the TcpIp and blocks transmissions via other socket connections. If the optional parameter is not enabled, the amout of data is not limited.
          container SoAdSocketUdp [0..1]  # Specifies that UDP is used as transport protocol for the socket connection group and parameters only related to UDP socket connections.
            boolean SoAdSocketUdpListenOnly: set at link in variant link-time / post-build in variant post-build / pre-compile in variant pre-compile, default-value=false  # Specifies if the socket connection group is only used for reception (TRUE) or used for both reception and transmission (FALSE).
            boolean SoAdSocketUdpRetryEnabled: set at link in variant link-time / post-build in variant post-build / pre-compile in variant pre-compile, default-value=false  # Specifies if an UdpTxBuffer shall be used (TRUE) to retry an UDP transmission in case of TCPIP_E_ARP_CACHE_MISS or not (FALSE).
            float SoAdSocketUdpTriggerTimeout [0..1]: 0..Inf, set at link in variant link-time / post-build in variant post-build / pre-compile in variant pre-compile  # Specifies the timeout in [s] a nPduUdpTxBuffer is waiting for a PDU with TriggerMode = TRIGGER_ALWAYS, i.e. when the timeout expires the nPduUdpTxBuffer is transmitted. Timer is reset after each UDP transmission. This optional parameter is only relevant if a nPduUdpTxBuffer is used.
            integer SoAdSocketnPduUdpTxBufferMin [0..1]: 0..65535, set at link in variant link-time / post-build in variant post-build / pre-compile in variant pre-compile  # Specifies the amout of data in bytes (PDU data provided by the upper layer and PDU Header if used) the SoAd shall be able to buffer for data transmission via this socket connection in case the UDP message shall be buffered for transmission of multiple PDUs per UDP. | Note: in case of a UDP socket and an upper layer with TP API or an upper layer with IF API with UDP transmit retry (for single PDUs) configured, the required buffer size can be determined automatically. This optional parameter is only relevant if a nPduUdpTxBuffer is used.
      container SoAdSocketRoute [1..*]  # Describes the path of a PDU from a socket in the TCP/IP stack to an upper layer of the SoAd after reception in the TCP/IP Stack.
        integer SoAdRxPduHeaderId [0..1]: 0..4294967296, set at link in variant link-time / post-build in variant post-build / pre-compile in variant pre-compile  # ID contained in the packet received on the TCP/IP connection if the PDU header option is enabled.
        reference SoAdRxSocketConnectionRef: set at link in variant link-time / post-build in variant post-build / pre-compile in variant pre-compile, destination=SoAdSocketConnection  # Connection on which the PDU was received. This references an entry in the Socket Connection Table.
        container SoAdSocketRouteDest  # Describes the upper layer destination PDU for a message received on a TcpIp socket.
          integer SoAdRxPduId [0..1]: 0..65535, set at link in variant link-time / post-build in variant post-build / pre-compile in variant pre-compile  # This unique identifier is used for a receive cancellation request from an upper layer of the SoAd.
          enumeration SoAdRxUpperLayerType: {IF, TP}, set at link in variant link-time / post-build in variant post-build / pre-compile in variant pre-compile  # Specifies the upper layer interface type (must be "IF" in case of multiple RxPdus).
          reference SoAdRxPduRef: set at link in variant link-time / post-build in variant post-build / pre-compile in variant pre-compile, destination=Pdu  # Reference to the global PDU structure
          reference SoAdRxRoutingGroupRef [0..*]: set at link in variant link-time / post-build in variant post-build / pre-compile in variant pre-compile, destination=SoAdRoutingGroup  # Reference to the routing group.
    container SoAdGeneral  # This container contains all global configuration parameters of SoAd.
      boolean SoAdDevErrorDetect: set at pre-compile  # Pre-processor switch for enabling development error detection support.
      boolean SoAdIPv6AddressEnabled: set at pre-compile  # Allows for increased memory allocation to store IPv6 addresses. | TRUE: Enables support for IPv6 addresses FALSE: Only IPv4 addresses are supported
      float SoAdMainFunctionPeriod: 0..Inf, set at pre-compile  # Determines the frequency at which the SoAd_MainFunction() is called in [s].
      integer SoAdRoutingGroupMax: 0..65535, set at pre-compile  # Specifies the maximum number of SoAd routing groups. Furthermore it defines the platform type used for RoutingGroupIdType. If SoAdRoutingGroupMax is not greater than 256, an uint8 is used, | otherwise an uint16.
      integer SoAdSoConMax: 0..65535, set at pre-compile  # Specifies the maximum number of SoAd socket connections. | Furthermore it defines the platform type used for SoAd_SoConIdType. If SoAdSoConMax is not greater than 256, an uint8 is used, otherwise uint16.
      boolean SoAdVersionInfoApi: set at pre-compile  # Activates the SoAd_GetVersionInfo() API. | TRUE: Enables the SoAd_GetVersionInfo() API. FALSE: SoAd_GetVersionInfo() API is not included.
