AUTOSAR XML (schema 4-3-0)
package /AUTOSAR/EcucDefs
  module definition Crypto [0..*]: category=STANDARDIZED_MODULE_DEFINITION, variants pre-compile  # Configuration of the Crypto (CryptoDriver) module
    container CryptoDriverObjects: multiplicity set at pre-compile  # Container for CRYPTO Objects
      container CryptoDriverObject [0..*]  # Configuration of a CryptoDriverObject
        integer CryptoDriverObjectId: 1..4294967295, multiplicity set at pre-compile, set at pre-compile, symbolic-name-value=true  # Identifier of the Crypto Driver Object. The Crypto Driver Object offers different crypto primitives.
        integer CryptoQueueSize: 0..4294967295, multiplicity set at pre-compile, set at pre-compile  # Size of the queue in the Crypto Driver. Defines the maximum number of jobs in the Crypto Driver Object queue. If it is set to 0, queueing is disabled in the Crypto Driver Object.
        reference CryptoPrimitiveRef: multiplicity set at pre-compile, set at pre-compile, destination=CryptoPrimitive  # Refers to primitive in the CRYPTO. | The CryptoPrimitive is a pre-configured container of the crypto service that shall be used.
    container CryptoGeneral: multiplicity set at pre-compile  # Container for common configuration options
      boolean CryptoDevErrorDetect: multiplicity set at pre-compile, set at pre-compile  # Switches the development error detection and notification on or off. | true: detection and notification is enabled. false: detection and notification is disabled
      float CryptoMainFunctionPeriod [0..1]: 0..1.7976931348623157E+308, multiplicity set at pre-compile, set at pre-compile  # Specifies the period of main function Crypto_MainFunction in seconds.
      boolean CryptoVersionInfoApi: multiplicity set at pre-compile, set at pre-compile  # Pre-processor switch to enable and disable availability of the API Crypto_GetVersionInfo(). | True: API Crypto_GetVersionInfo() is available False: API Cryptosm_GetVersionInfo() is not available.
    container CryptoKeyElements [0..1]  # Container for Crypto key elements
      container CryptoKeyElement [1..*]  # Configuration of a CryptoKeyElement
        boolean CryptoKeyElementAllowPartialAccess: multiplicity set at pre-compile, set at pre-compile  # Enable or disable writing and reading the key element with data smaller than the size of the element. | True: enable partial access of the key element False: disable partial access of the key element
        integer CryptoKeyElementId: 1..4294967295, multiplicity set at pre-compile, set at pre-compile, symbolic-name-value=true  # Identifier of the CRYPTO key element
        string CryptoKeyElementInitValue: multiplicity set at pre-compile, set at pre-compile  # Value which will be used to fill the element during initialisation, when the element is not already initialized.
        boolean CryptoKeyElementPersist: multiplicity set at pre-compile, set at pre-compile  # Enable or disable persisting of the key element in non-volatile storage. | True: enable persisting of the key element. False: disable persisting of the key element.
        enumeration CryptoKeyElementReadAccess: {CRYPTO_RA_ALLOWED, CRYPTO_RA_DENIED, CRYPTO_RA_ENCRYPTED, CRYPTO_RA_INTERNAL_COPY}, multiplicity set at pre-compile, set at pre-compile  # Define the reading access rights of the key element. | CRYPTO_RA_DENIED = key element cannot be read from outside the Crypto Driver CRYPTO_RA INTERNAL_COPY = key element can be copied to another key element in the same crypto driver. CRYPTO_RA_ALLOWED = key element can be read as plaintext CRYPTO_RA_ENCRYPTED = key element can be read encrypted. E.g. SHE Ram-Key export.
        integer CryptoKeyElementSize: 1..4294967295, multiplicity set at pre-compile, set at pre-compile  # Maximum Size size of a CRYPTO key element in bytes
        enumeration CryptoKeyElementWriteAccess: {CRYPTO_WA_ALLOWED, CRYPTO_WA_DENIED, CRYPTO_WA_ENCRYPTED, CRYPTO_WA_INTERNAL_COPY}, multiplicity set at pre-compile, set at pre-compile  # Define the writing access rights of the key element | CRYPTO_WA_DENIED = key element can not be written from outside the Crypto Driver CRYPTO_WA INTERNAL_COPY = key element can be filled with another key element in the same crypto driver. CRYPTO_WA_ALLOWED = key element can be rwritten as plaintext CRYPTO_WA_ENCRYPTED = key element can be written encrypted. E.g. SHE load key.
        reference CryptoKeyElementVirtualTargetRef [1..*]: multiplicity set at pre-compile, post-build-variant-value=true, set at pre-compile, destination=CryptoKeyElement  # Refers to a key element which will contain the actual data. If the Reference is configured, the key element will be a virtual key element.
    container CryptoKeyTypes [0..1]: multiplicity set at pre-compile  # Container for CRYPTO key types
      container CryptoKeyType [1..*]  # Configuration of a CryptoKeyType
        reference CryptoKeyElementRef [1..*]: multiplicity set at pre-compile, set at pre-compile, destination=CryptoKeyElement  # Refers to a pointer in the Crypto Key Element, which holds the data of the crypto key element.
    container CryptoKeys [0..1]  # Container for CRYPTO keys
      container CryptoKey [1..*]: multiplicity set at pre-compile  # Configuration of a CryptoKey
        integer CryptoKeyDeriveIterations: 1..4294967295, multiplicity set at pre-compile, set at pre-compile  # Holds the number of iterations to be performed by the key derivation primitive
        integer CryptoKeyId: 1..4294967295, multiplicity set at pre-compile, set at pre-compile, symbolic-name-value=true  # Identifier of the CRYPTO Key
        reference CryptoKeyTypeRef: multiplicity set at pre-compile, set at pre-compile, destination=CryptoKeyType  # Refers to a pointer in the CRYPTOto a CryptoKeyType. The CryptoKeyType provides the information which key elements are contained in a CryptoKey.
    container CryptoPrimitives [0..*]: multiplicity set at pre-compile  # Container for CRYPTO primitives
      container CryptoPrimitive [0..*]: multiplicity set at pre-compile  # Configuration of a CryptoPrimitive
        enumeration CryptoPrimitiveAlgorithmFamily [1..*]: {CRYPTO_ALGOFAM_3DES, CRYPTO_ALGOFAM_AES, CRYPTO_ALGOFAM_BLAKE_1_256, CRYPTO_ALGOFAM_BLAKE_1_512, CRYPTO_ALGOFAM_BLAKE_2s_256, CRYPTO_ALGOFAM_BLAKE_2s_512, CRYPTO_ALGOFAM_BRAINPOOL, CRYPTO_ALGOFAM_CHACHA, CRYPTO_ALGOFAM_CUSTOM, CRYPTO_ALGOFAM_ECCNIST, CRYPTO_ALGOFAM_ECIES, CRYPTO_ALGOFAM_ED25519, CRYPTO_ALGOFAM_NOT_SET, CRYPTO_ALGOFAM_RIPEMD160, CRYPTO_ALGOFAM_RNG, CRYPTO_ALGOFAM_RSA, CRYPTO_ALGOFAM_SECURECOUNTER, CRYPTO_ALGOFAM_SHA1, CRYPTO_ALGOFAM_SHA2_224, CRYPTO_ALGOFAM_SHA2_256, CRYPTO_ALGOFAM_SHA2_384, CRYPTO_ALGOFAM_SHA2_512, CRYPTO_ALGOFAM_SHA2_512_224, CRYPTO_ALGOFAM_SHA2_512_256, CRYPTO_ALGOFAM_SHA3_224, CRYPTO_ALGOFAM_SHA3_256, CRYPTO_ALGOFAM_SHA3_384, CRYPTO_ALGOFAM_SHA3_512, CRYPTO_ALGOFAM_SHAKE128, CRYPTO_ALGOFAM_SHAKE256, CRYPTO_ALGOFAM_SIPHASH}, multiplicity set at pre-compile, set at pre-compile  # Determines the algorithm family used for the crypto service
        enumeration CryptoPrimitiveAlgorithmMode [1..*]: {CRYPTO_ALGOMODE_12ROUNDS, CRYPTO_ALGOMODE_20ROUNDS, CRYPTO_ALGOMODE_8ROUNDS, CRYPTO_ALGOMODE_CBC, CRYPTO_ALGOMODE_CFB, CRYPTO_ALGOMODE_CMAC, CRYPTO_ALGOMODE_CTR, CRYPTO_ALGOMODE_CTRDRBG, CRYPTO_ALGOMODE_CUSTOM, CRYPTO_ALGOMODE_ECB, CRYPTO_ALGOMODE_GCM, CRYPTO_ALGOMODE_GMAC, CRYPTO_ALGOMODE_HMAC, CRYPTO_ALGOMODE_NOT_SET, CRYPTO_ALGOMODE_OFB, CRYPTO_ALGOMODE_RSAES_OAEP, CRYPTO_ALGOMODE_RSAES_PKCS1_v1_5, CRYPTO_ALGOMODE_RSASSA_PKCS1_v1_5, CRYPTO_ALGOMODE_RSASSA_PSS, CRYPTO_ALGOMODE_XTS}, multiplicity set at pre-compile, set at pre-compile  # Determines the algorithm mode used for the crypto service
        enumeration CryptoPrimitiveAlgorithmSecondaryFamily [1..*]: {CRYPTO_ALGOFAM_3DES, CRYPTO_ALGOFAM_AES, CRYPTO_ALGOFAM_BLAKE_1_256, CRYPTO_ALGOFAM_BLAKE_1_512, CRYPTO_ALGOFAM_BLAKE_2s_256, CRYPTO_ALGOFAM_BLAKE_2s_512, CRYPTO_ALGOFAM_BRAINPOOL, CRYPTO_ALGOFAM_CHACHA, CRYPTO_ALGOFAM_CUSTOM, CRYPTO_ALGOFAM_ECCNIST, CRYPTO_ALGOFAM_ECIES, CRYPTO_ALGOFAM_ED25519, CRYPTO_ALGOFAM_NOT_SET, CRYPTO_ALGOFAM_RIPEMD160, CRYPTO_ALGOFAM_RNG, CRYPTO_ALGOFAM_RSA, CRYPTO_ALGOFAM_SECURECOUNTER, CRYPTO_ALGOFAM_SHA1, CRYPTO_ALGOFAM_SHA2_224, CRYPTO_ALGOFAM_SHA2_256, CRYPTO_ALGOFAM_SHA2_384, CRYPTO_ALGOFAM_SHA2_512, CRYPTO_ALGOFAM_SHA2_512_224, CRYPTO_ALGOFAM_SHA2_512_256, CRYPTO_ALGOFAM_SHA3_224, CRYPTO_ALGOFAM_SHA3_256, CRYPTO_ALGOFAM_SHA3_384, CRYPTO_ALGOFAM_SHA3_512, CRYPTO_ALGOFAM_SHAKE128, CRYPTO_ALGOFAM_SHAKE256, CRYPTO_ALGOFAM_SIPHASH}, multiplicity set at pre-compile, set at pre-compile  # Determines the algorithm secondary family used for the crypto service
        enumeration CryptoPrimitiveService: {AEAD_DECRYPT, AEAD_ENCRYPT, DECRYPT, ENCRYPT, HASH, MAC_GENERATE, MAC_VERIFY, RANDOM, SIGNATURE_GENERATE, SIGNATURE_VERIFY, SECCOUNTER_READ, SECCOUNTER_INCREMENT}, multiplicity set at pre-compile, set at pre-compile  # Determines the crypto service used for defining the capabilities
