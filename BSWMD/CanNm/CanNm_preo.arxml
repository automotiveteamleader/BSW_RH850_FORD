AUTOSAR XML (schema 4-0-3)
package /MICROSAR
  module config CanNm_Pre: definition=CanNm
    CanNmGlobalConfig:
      CanNmBusLoadReductionEnabled = 0
      CanNmNodeDetectionEnabled = 0
      CanNmPassiveModeEnabled = 0
      CanNmPnEiraCalcEnabled = 0
      CanNmRepeatMsgIndEnabled = 0
      CanNmImmediateTxconfEnabled = 0
      CanNmCanIfRangeConfigDLCCheck = 1
      CanNmUserDataEnabled = 1
      CanNmComUserDataSupport = 0
  module config CanNm_Pre_Class1: definition=CanNm
    CanNmGlobalConfig
      CanNmChannelConfig:
        CanNmBusLoadReductionActive = 0
        CanNmMsgTimeoutTime = 0.9
        CanNmPduCbvPosition = CANNM_PDU_BYTE_1
        CanNmPduNidPosition = CANNM_PDU_BYTE_0
        CanNmRemoteSleepIndTime = 1.5
        CanNmRepeatMessageTime = 0
        CanNmUserDataLength = 6
        CanNmPnEnabled = 0
        CanNmPnEraCalcEnabled = 0
        CanNmPnHandleMultipleNetworkRequests = 0
        CanNmCarWakeUpRxEnabled = 0
        CanNmMsgCycleOffset = 0
        CanNmMsgCycleTime = 1
        CanNmMsgReducedTime = 0.8
  module config CanNm_Rec: definition=CanNm, implementation-config-variant=VARIANT-PRE-COMPILE
    CanNmGlobalConfig:
      CanNmBusSynchronizationEnabled = 0
      CanNmImmediateRestartEnabled = 0
      CanNmPduRxIndicationEnabled = 0
      CanNmStateChangeIndEnabled = 0
      CanNmRemoteSleepIndEnabled = 1
  module config CanNm_Rec_Class1: definition=CanNm
    CanNmGlobalConfig
      CanNmChannelConfig: CanNmTimeoutTime=3, CanNmWaitBusSleepTime=1.5, CanNmActiveWakeupBitEnabled=1
