AUTOSAR XML (schema 4-0-3)
package /MICROSAR
  module config Xcp_Rec: definition=Xcp
    XcpGeneral: XcpSafeBswChecks=1
