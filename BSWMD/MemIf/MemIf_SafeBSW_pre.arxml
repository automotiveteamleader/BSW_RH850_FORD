AUTOSAR XML (schema 4-0-3)
package /MICROSAR
  module config MemIf_Rec: definition=MemIf
    MemIfGeneral: MemIfSafeBswChecks=1
