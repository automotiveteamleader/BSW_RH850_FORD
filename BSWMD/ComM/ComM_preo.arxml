AUTOSAR XML (schema 4-0-3)
package /MICROSAR
  module config ComM_Pre: definition=ComM
    ComMGeneral: ComMWakeupInhibitionEnabled=0, ComMPncSupport=0, ComMPncGatewayEnabled=0, ComMModeLimitationEnabled=0, ComMEcuGroupClassification=0
    ComMConfigSet: ComMPncEnabled=0
  module config ComM_Rec: definition=ComM, implementation-config-variant=VARIANT-PRE-COMPILE
    ComMGeneral: ComMDevErrorDetect=1, ComMVersionInfoApi=0, ComMSynchronousWakeUp=0
  module config ComM_Pre_Class2: definition=ComM
    ComMConfigSet
      ComMChannel: ComMPncGatewayType=COMM_GATEWAY_TYPE_NONE, ComMNoWakeup=0, ComMNoCom=0
        ComMNetworkManagement: ComMPncNmRequest=0
