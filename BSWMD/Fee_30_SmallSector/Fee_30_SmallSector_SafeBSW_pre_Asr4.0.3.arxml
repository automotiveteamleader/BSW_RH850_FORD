AUTOSAR XML (schema 4-0-3)
package /MICROSAR/Fee_30_SmallSector
  module config Fee_30_SmallSector_Rec: definition=Fee
    FeeGeneral: FeeSafeBswChecks=1
