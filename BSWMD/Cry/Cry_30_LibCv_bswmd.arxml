AUTOSAR XML (schema 4-0-3)
# COPYRIGHT
# Copyright (c) 2017 by Vector Informatik GmbH. All rights reserved.
# This software is copyright protected and proprietary to Vector Informatik GmbH.
# Vector Informatik GmbH grants to you only those rights as set out in the license conditions.
package /MICROSAR/Cry_30_LibCv
  module definition Cry [0..1]: category=VENDOR_SPECIFIC_MODULE_DEFINITION, refined-module-def=Cry, variants pre-compile
    container CryGeneral
      boolean CryUseSyncJobProcessing: set at pre-compile, origin=Vector Informatik, default-value=true  # Pre-processor switch to enable and disable synchronous job processing.
      boolean CryVersionInfoApi: set at pre-compile, origin=Vector Informatik, default-value=false  # Pre-processor switch to enable and disable availability of the API Cry_GetVersionInfo(). True: API Cry_GetVersionInfo() is available. False: API Cry_GetVersionInfo() is not available.
    container CryAesEncrypt128 [0..1]
      container CryAesEncrypt128Config [1..32]
        enumeration CryAesEncrypt128BlockMode: set at pre-compile, origin=Vector Informatik, default-value=CRY_AESBLOCKMODE_CBC  # AES-128 Encryption Block Mode | The block mode describes how to handle data which exceeds the block length.
          CRY_AESBLOCKMODE_ECB  # Block Mode ECB
          CRY_AESBLOCKMODE_CBC  # Block Mode CBC
        enumeration CryAesEncrypt128PaddingMode: set at pre-compile, origin=Vector Informatik, default-value=CRY_AESPADDINGMODE_PKCS5  # AES-128 Encryption Padding Mode | To align the data length to the block size a padding mode is required.
          CRY_AESPADDINGMODE_PKCS5  # Padding Mode PKCS#5
    container CryAesDecrypt128 [0..1]
      container CryAesDecrypt128Config [1..32]
        enumeration CryAesDecrypt128BlockMode: set at pre-compile, origin=Vector Informatik, default-value=CRY_AESBLOCKMODE_CBC  # AES-128 Decryption Block Mode | The block mode describes how to handle data which exceeds the block length.
          CRY_AESBLOCKMODE_ECB  # Block Mode ECB
          CRY_AESBLOCKMODE_CBC  # Block Mode CBC
        enumeration CryAesDecrypt128PaddingMode: set at pre-compile, origin=Vector Informatik, default-value=CRY_AESPADDINGMODE_PKCS5  # AES-128 Decryption Padding Mode | To align the data length to the block size a padding mode is required.
          CRY_AESPADDINGMODE_PKCS5  # Padding Mode PKCS#5
    container CryFips186 [0..1]
      container CryFips186Config [1..32]
        boolean CrySaveState: set at pre-compile, origin=Vector Informatik, default-value=false  # Save Seed State | When the option Save State is enabled, the call of the Csm_RandomSeed service extends the existing entropy of an already initialized random number generator with the seed provided to the service. Disabling this feature will initialize the random number generator from scratch without regard to any existing entropy.
    container CryHmacSha1Verify [0..1]
      container CryHmacSha1VerifyConfig [1..32]
        boolean CryLengthInBytes: set at pre-compile, origin=Vector Informatik, default-value=true  # Interpret length as number of bytes | If TRUE, the given mac length is interpreted as the number of bytes to verify. Otherwise the length is interpreted as the number of bits, which are then verified from MSB to LSB. Example: If mac length in bit is 4, the 4 most significant bits are verified. The other 4 less significant bits are discarded.
    container CryCmacAes128Gen [0..1]
      container CryCmacAes128GenConfig [1..32]
    container CryCmacAes128Ver [0..1]
      container CryCmacAes128VerConfig [1..32]
        boolean CryLengthInBytes: set at pre-compile, origin=Vector Informatik, default-value=true  # Interpret length as number of bytes | If TRUE, the given mac length is interpreted as the number of bytes to verify. Otherwise the length is interpreted as the number of bits, which are then verified from MSB to LSB. Example: If mac length in bit is 4, the 4 most significant bits are verified. The other 4 less significant bits are discarded.
    container CryRsaDecrypt [0..1]
      container CryRsaDecryptConfig [1..32]
        boolean CryRsaDecryptUsePrivateKey: set at pre-compile, origin=Vector Informatik, default-value=false  # Use private key | Use the private key for the decryption instead of the public key.
    container CryRsaSha1SigVer [0..1]
      container CryRsaSha1SigVerConfig [1..32]
    container CryKdf2HmacSha1 [0..1]
      container CryKdf2HmacSha1Config [1..32]
    container CryHashSha256 [0..1]
      container CryHashSha256Config [1..32]
    container CryEcdsaSigGen [0..1]
      container CryEcdsaSigGenConfig [1..32]
        boolean CryEcdsaSigGenBerEncoding: set at pre-compile, origin=Vector Informatik, default-value=false  # BER Encoding?
    container CryHmacSha256Verify [0..1]
      container CryHmacSha256VerifyConfig [1..32]
        boolean CryHmacSha256VerifyLengthInBytes: set at pre-compile, origin=Vector Informatik, default-value=true  # Interpret length as number of bytes | If TRUE, the given mac length is interpreted as the number of bytes to verify. Otherwise the length is interpreted as the number of bits, which are then verified from MSB to LSB. Example: If mac length in bit is 4, the 4 most significant bits are verified. The other 4 less significant bits are discarded.
    container CryHmacSha256Generate [0..1]
      container CryHmacSha256GenerateConfig [1..32]
    container CryEcdsaSigVer [0..1]
      container CryEcdsaSigVerConfig [1..32]
        boolean CryEcdsaSigVerBerEncoding: set at pre-compile, origin=Vector Informatik, default-value=false  # BER Encoding?
    container CryEcdh [0..1]
      container CryEcdhConfig [1..32]
        integer CryEcdhPBKDF2IterationCount: 1.., set at pre-compile, default-value=1  # Iteration count of PBKDF2
    container CryHashSha1 [0..1]
      container CryHashSha1Config [1..32]
    container CryHashRipemd160 [0..1]
      container CryHashRipemd160Config [1..32]
  bsw implementation Cry_Impl: programming-language=C, sw-version=3.00.01, used-code-generator=DaVinci Configurator, vendor-id=30, ar-release-version=4.00.03, behavior=Behavior, preconfigured-configuration=Cry_Pre, recommended-configuration=Cry_Rec, vendor-api-infix=LibCv, vendor-specific-module-def=Cry
