AUTOSAR XML (schema 4-1-2)
# COPYRIGHT
# Copyright (c) 2014 by Vector Informatik GmbH. All rights reserved.
# This software is copyright protected and proprietary to Vector Informatik GmbH.
# Vector Informatik GmbH grants to you only those rights as set out in the license conditions.
package /MICROSAR
  bsw implementation Vsg_Impl: programming-language=C, sw-version=3.00.00, used-code-generator=DaVinci Configurator, vendor-id=30, ar-release-version=4.00.03, behavior=VsgBehavior, preconfigured-configuration=Vsg_Pre, recommended-configuration=Vsg_Rec, vendor-specific-module-def=Vsg
  module definition Vsg: category=VENDOR_SPECIFIC_MODULE_DEFINITION, variants pre-compile  # Confguration of the Vsg (Vehicle System Group) module.
    container VsgPool  # This container contains the VsgItems and their configuration parameters. This container exists once per configruation set.
      container VsgItem [1..*]  # This container contains the configuration for VsgItems. Note that this container definition does not explicitly define a symbolic name parameter. Instead, the short name of the container will be used in the Ecu Configuration Description to specify the symbolic name of the Vehicle System Group.
        integer VsgItemId: 0..65535, set at pre-compile, origin=Vector Informatik, symbolic-name-value=true, default-value=65535  # VsgItem Id | Unique identifier of a VsgItem. This parameter should not be changeable by user, because the Id should be generated by Vsg itself to prevent gaps and multiple use of an Id. The VsgItem Ids should be consecutively numbered starting with id 0.
        symbolic name reference VsgDemEventParameterRef [0..*]: set at pre-compile, origin=Vector Informatik, destination=DemEventParameter  # This reference contains the link to a DEM Event Parameter.
        symbolic name reference VsgDcmVehicleSystemGroupRef [0..1]: set at pre-compile, origin=Vector Informatik, destination=DcmDspVehicleSystemGroupRow  # This reference contains the link to a DCM Vehicle System Group.
    container VsgGeneral  # This container groups the constant configuration options, e.g. options that can not have different values in multiple configurations.
      boolean VsgDevErrorDetect: set at pre-compile, origin=Vector Informatik, default-value=true  # Development Error Detect | Activate/Deactivate the Development Error Detection and Notification. If this option is enabled, integration errors are reported to the DET module (e.g. calling APIs with invalid arguments that would cause a malfunction of the Vsg module). In a production system this option can be disabled as all code should be tested to correctly use the Vsg API.
      boolean VsgVersionInfoApi: set at pre-compile, origin=Vector Informatik, default-value=false  # Activate/Deactivate the version information API.
      boolean VsgUseDcm [0..1]: set at pre-compile, origin=Vector Informatik, default-value=false  # Use Dcm | Activate/Deactivate the DCM Vehicle System Group Support.
  module config Vsg_Pre: definition=Vsg
  module config Vsg_Rec: definition=Vsg
