AUTOSAR XML (schema 4-0-3)
package /MICROSAR
  module config Com_Pre: definition=Com
  module config Com_Rec: definition=Com, implementation-config-variant=VARIANT-PRE-COMPILE
