AUTOSAR XML (schema 4-1-2)
package /MICROSAR
  module config Dem_Pre: definition=Dem
    DemGeneral:
      DemAgingCycleCounterProcessing = DEM_PROCESS_AGINGCTR_INTERN
      DemGeneralInterfaceSupport = 0
      DemClearDTCLimitation = DEM_ALL_SUPPORTED_DTCS
      DemDataElementDefaultEndianness = LITTLE_ENDIAN
      DemAgingRequieresTestedCycle = 0
      DemMaxNumberEventEntryMirror = 0
      DemPTOSupport = 0
      DemTriggerMonitorInitBeforeClearOk = 1
      DemExtendedDataCapture = DEM_TRIGGER_EVENT_MEMORY_STORAGE
      DemFreezeFrameCapture = DEM_TRIGGER_EVENT_MEMORY_STORAGE
      DemOperationCycleProcessing = DEM_PROCESS_OPCYC_STATE
      DemMaxNumberTimeSeriesSnapshots = 0
      DemEventDisplacementStrategy = DEM_DISPLACEMENT_PRIO_OCC
      DemAgingBehavior = DEM_AGING_TYPE_6
      DemAgingCounterReporting = DEM_AGING_ZERO_AS_ONE_REPORTING
      DemTypeOfFreezeFrameRecordNumeration = DEM_FF_RECNUM_CONFIGURED
      DemEventDisplacementFallbackStrategy = DEM_FALLBACK_DISPLACE_OLDEST_EVENT
      DemAgingRetainEnvironmentalData = 0
      DemResetConfirmedBitOnOverflow = 0
    DemConfigSet
  module config Dem_Pre_Class1: definition=Dem
    DemConfigSet
      DemEventParameter
        DemCallbackClearEventAllowed: DemClearEventAllowedBehavior=DEM_NO_STATUS_BYTE_CHANGE
  module config Dem_Pre_Class2: definition=Dem
    DemGeneral
      DemGeneralOBD:
        DemOBDCentralizedPID21Handling = 0
        DemOBDCentralizedPID31Handling = 0
        DemOBDDestinationOfEvents = DEM_DTC_ORIGIN_PRIMARY_MEMORY
        DemOBDEventDisplacement = 1
  module config Dem_Pre_Class3: definition=Dem
    DemConfigSet
      DemEventParameter: DemEventTimeSeries=DEM_TIMESERIES_SNAPSHOT_NONE
  module config Dem_Pre_Class4: definition=Dem
    DemGeneral
      DemTimeSeriesSnapshot:
        DemTimeSeriesNormalRatePastSamples = 0
        DemTimeSeriesNormalRateFutureSamples = 0
        DemTimeSeriesFastRatePastSamples = 0
        DemTimeSeriesFastRateFutureSamples = 0
        DemTimeSeriesNormalRateTime = 0
        DemTimeSeriesFastRateTime = 0
        DemTimeSeriesNormalSampleBufferSize = 0
        DemTimeSeriesFastSampleBufferSize = 0
  module config Dem_Pre_Class6: definition=Dem
    DemConfigSet
      DemEventParameter
        DemEventClass
          DemIndicatorAttribute: DemIndicatorFailureCycleSource=DEM_FAILURE_CYCLE_EVENT
