AUTOSAR XML (schema 4-0-3)
# COPYRIGHT
# Copyright (c) 2016 by Vector Informatik GmbH. All rights reserved.
# This software is copyright protected and proprietary to Vector Informatik GmbH.
# Vector Informatik GmbH grants to you only those rights as set out in the license conditions.
package /MICROSAR/Cry_30_Rh850Icum
  module definition Cry [0..1]: category=VENDOR_SPECIFIC_MODULE_DEFINITION, refined-module-def=Cry, variants pre-compile
    container CryGeneral
      boolean CryUseSyncJobProcessing: set at pre-compile, origin=Vector Informatik, default-value=true  # Pre-processor switch to enable and disable synchronous job processing.
      boolean CryVersionInfoApi: set at pre-compile, origin=Vector Informatik, default-value=false  # Pre-processor switch to enable and disable availability of the API Cry_GetVersionInfo(). True: API Cry_GetVersionInfo() is available. False: API Cry_GetVersionInfo() is not available.
    container CryAesEncrypt128 [0..1]
      container CryAesEncrypt128Config [1..32]
        enumeration CryAesEncrypt128BlockMode: set at pre-compile, origin=Vector Informatik, default-value=CRY_AESBLOCKMODE_ECB  # AES-128 Encryption Block Mode | The block mode describes how to handle data which exceeds the block length.
          CRY_AESBLOCKMODE_ECB  # Block Mode ECB
          CRY_AESBLOCKMODE_CBC  # Block Mode CBC
        enumeration CryKeyIdType: {CRY_KEYIDTYPE_RAW, CRY_KEYIDTYPE_MAPPED}, set at pre-compile, origin=Vector Informatik, default-value=CRY_KEYIDTYPE_MAPPED
    container CryAesDecrypt128 [0..1]
      container CryAesDecrypt128Config [1..32]
        enumeration CryAesDecrypt128BlockMode: set at pre-compile, origin=Vector Informatik, default-value=CRY_AESBLOCKMODE_ECB  # AES-128 Decryption Block Mode | The block mode describes how to handle data which exceeds the block length.
          CRY_AESBLOCKMODE_ECB  # Block Mode ECB
          CRY_AESBLOCKMODE_CBC  # Block Mode CBC
        enumeration CryKeyIdType: {CRY_KEYIDTYPE_RAW, CRY_KEYIDTYPE_MAPPED}, set at pre-compile, origin=Vector Informatik, default-value=CRY_KEYIDTYPE_MAPPED
    container CryRng [0..1]
      container CryRngConfig [1..32]
    container CryCmacAes128Ver [0..1]
      container CryCmacAes128VerConfig [1..32]
        boolean CryLengthInBytes: set at pre-compile, origin=Vector Informatik, default-value=true
        enumeration CryKeyIdType: {CRY_KEYIDTYPE_RAW, CRY_KEYIDTYPE_MAPPED}, set at pre-compile, origin=Vector Informatik, default-value=CRY_KEYIDTYPE_MAPPED
    container CryCmacAes128Gen [0..1]
      container CryCmacAes128GenConfig [1..32]
        enumeration CryKeyIdType: {CRY_KEYIDTYPE_RAW, CRY_KEYIDTYPE_MAPPED}, set at pre-compile, origin=Vector Informatik, default-value=CRY_KEYIDTYPE_MAPPED
    container CryKeyWrapSym [0..1]
      container CryKeyWrapSymConfig [1..32]
        enumeration CryKeyIdType: {CRY_KEYIDTYPE_RAW, CRY_KEYIDTYPE_MAPPED}, set at pre-compile, origin=Vector Informatik, default-value=CRY_KEYIDTYPE_MAPPED
    container CryKeyExtract [0..1]
      container CryKeyExtractConfig [1..32]
        enumeration CryKeyIdType: {CRY_KEYIDTYPE_RAW, CRY_KEYIDTYPE_MAPPED}, set at pre-compile, origin=Vector Informatik, default-value=CRY_KEYIDTYPE_MAPPED
  bsw implementation Cry_Impl: programming-language=C, sw-version=1.00.00, used-code-generator=DaVinci Configurator, vendor-id=30, behavior=Behavior, preconfigured-configuration=Cry_Pre, recommended-configuration=Cry_Rec, vendor-api-infix=Rh850Icum, vendor-specific-module-def=Cry
