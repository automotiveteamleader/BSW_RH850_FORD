AUTOSAR XML (schema 4-0-3)
# COPYRIGHT
# Copyright (c) 2014 by Vector Informatik GmbH. All rights reserved.
# This software is copyright protected and proprietary to Vector Informatik GmbH.
# Vector Informatik GmbH grants to you only those rights as set out in the license conditions.
package /MICROSAR
  module definition Csm [0..1]: category=VENDOR_SPECIFIC_MODULE_DEFINITION, refined-module-def=Csm, variants pre-compile  # Configuration of the Csm (CryptoServiceManager) module.
    container CsmAsymDecrypt [0..1]  # This container incorporates all asymmetrical decryption primitives.
      integer CsmAsymDecryptMaxKeySize: 1..4294967295, set at pre-compile  # Max. Key Size | This is the maximum size over all key lengths used in all CRY primitives, which implement an asymmetrical decryption. Please note that the calling application has to provide the key buffer. So, it has to be ensured that the size of this buffer matches with the configured value here.
      container CsmAsymDecryptConfig [0..32]  # This container holds the configuration of one asymmetrical decryption service. The container name serves as a symbolic name for the identifier of a service configuration. An asymmetrical decryption service accumulates function pointers to the Start, Update and Finish functions and a pointer to the initialization structure of an asymmetrical decryption primitive. Usually, this primitive is provided by the CRY module. Up to 32 different asymmetrical decryption primitives are supported.
        function name CsmCallbackAsymDecrypt: set at pre-compile  # Callback Function | Callback function to be called if service has finished. This parameter is only needed if the CSM is in asynchronous mode.
        string CsmAsymDecryptInitConfiguration: set at pre-compile, origin=Vector Informatik  # Symbolic Name of Init Configuration Structure | This is the name of the C symbol, which contains the configuration of the underlying cryptographic primitive. Usually, this symbol represents a structure provided by the CRY module.
        string CsmAsymDecryptPrimitiveName: set at pre-compile, origin=Vector Informatik  # Name of Asymmetrical Decryption Primitive | This is the name of the cryptographic primitive to use. This name will be used to form the function pointers to the Start, Update and Finish functions of the corresponding cryptographic primitive according to the following rule: <name>[Start|Update|Finish] Usually these functions are provided by the CRY module. Name of the cryptographic primitive to use.
        string CsmAsymDecryptIncludeFile: set at pre-compile, origin=Vector Informatik  # Include file of specific Service | Name of the CRY header that shall be included for the specific service.
        boolean CsmAsymDecryptUseServicePorts: set at pre-compile, origin=Vector Informatik, default-value=true  # Use Service Ports | This parameter defines if this block is accessible via service ports. The PortName will be derived from the block name.
        choice reference CsmAsymDecryptCryRef [0..1]: set at pre-compile, origin=Vector Informatik, destination=CryRsaDecryptConfig
    container CsmAsymEncrypt [0..1]  # This container incorporates all asymmetrical encryption primitives.
      integer CsmAsymEncryptMaxKeySize: 1..4294967295, set at pre-compile  # Max. Context Buffer Size | This is the maximum size over all key lengths used in all CRY primitives, which implement an asymmetrical encryption. Please note that the calling application has to provide the key buffer. So, it has to be ensured that the size of this buffer matches with the configured value here.
      container CsmAsymEncryptConfig [0..32]  # This container holds the configuration of one asymmetrical encryption service. The container name serves as a symbolic name for the identifier of a service configuration. An asymmetrical encryption service accumulates function pointers to the Start, Update and Finish functions and a pointer to the initialization structure of an asymmetrical encryption primitive. Usually, this primitive is provided by the CRY module. Up to 32 different asymmetrical encryption primitives are supported.
        function name CsmCallbackAsymEncrypt: set at pre-compile  # Callback Function | Callback function to be called if service has finished. This parameter is only needed if the CSM is in asynchronous mode.
        string CsmAsymEncryptInitConfiguration: set at pre-compile, origin=Vector Informatik  # Symbolic Name of Init Configuration Structure | This is the name of the C symbol, which contains the configuration of the underlying cryptographic primitive. Usually, this symbol represents a structure provided by the CRY module.
        string CsmAsymEncryptPrimitiveName: set at pre-compile, origin=Vector Informatik  # Name of Asymmetrical Encryption Primitive | This is the name of the cryptographic primitive to use. This name will be used to form the function pointers to the Start, Update and Finish functions of the corresponding cryptographic primitive according to the following rule: <name>[Start|Update|Finish] Usually these functions are provided by the CRY module.
        string CsmAsymEncryptIncludeFile: set at pre-compile, origin=Vector Informatik  # Include file of specific Service | Header file of the underlying cryptographic service that shall be used.
        boolean CsmAsymEncryptUseServicePorts: set at pre-compile, origin=Vector Informatik, default-value=true  # Use Service Ports | This parameter defines if this block is accessible via service ports. The PortName will be derived from the block name.
    container CsmAsymPrivateKeyExtract [0..1]  # This container comprises all asymmetrical private key extraction primitives.
      integer CsmAsymPrivateKeyExtractMaxKeySize: 1..4294967295, set at pre-compile  # Max. Context Buffer Size | This is the maximum size over all context buffers used in all CRY primitives, which implement an asymmetrical private key extraction. Please note that the calling application has to provide the context buffer. So, it has to be ensured that the size of this buffer matches with the configured value here.
      container CsmAsymPrivateKeyExtractConfig [0..32]  # This container comprises the configuration of one asymmetrical private key extraction service. The container name serves as a symbolic name for the identifier of a service configuration. An asymmetrical private key extraction service accumulates function pointers to the Start, Update and Finish functions and a pointer to the initialization structure of an asymmetrical private key extraction primitive. Usually, this primitive is provided by the CRY module. Up to 32 different asymmetrical private key extraction primitives are supported. | The container name serves as a symbolic name for the identifier of a service configuration.
        function name CsmCallbackAsymPrivateKeyExtract: set at pre-compile  # Callback Function | Callback function to be called if service has finished. This parameter is only needed if the CSM is in asynchronous mode.
        string CsmAsymPrivateKeyExtractInitConfiguration: set at pre-compile  # Symbolic Name of Init Configuration Structure | This is the name of the C symbol, which contains the configuration of the underlying cryptographic primitive. Usually, this symbol represents a structure provided by the CRY module.
        string CsmAsymPrivateKeyExtractPrimitiveName: set at pre-compile  # Name of Asymmetrical Private Key Extraction Primitive | This is the name of the cryptographic primitive to use. This name will be used to form the function pointers to the Start, Update and Finish functions of the corresponding cryptographic primitive according to the following rule: <name>[Start|Update|Finish] Usually these functions are provided by the CRY module.
        string CsmAsymPrivateKeyExtractIncludeFile: set at pre-compile, origin=Vector Informatik  # Include file of specific Service | Header file of the underlying cryptographic service that shall be used.
        boolean CsmAsymPrivateKeyExtractUseServicePorts: set at pre-compile, origin=Vector Informatik, default-value=true  # Use Service Ports | This parameter defines if this block is accessible via service ports. The PortName will be derived from the block name.
    container CsmAsymPrivateKeyWrapAsym [0..1]  # This container comprises all asymmetrical private key wrapping primitives.
      integer CsmAsymPrivateKeyWrapAsymMaxPrivKeySize: 1..4294967295, set at pre-compile  # Max. Private Key Size | This is the maximum size over all private key types used in all CRY primitives, which implement an asymmetrical private key wrapping. Please note that the calling application has to provide the key type buffer. So, it has to be ensured that the size of this buffer matches with the configured value here.
      integer CsmAsymPrivateKeyWrapAsymMaxPubKeySize: 1..4294967295, set at pre-compile  # Max. Private Key Size | This is the maximum size over all public key types used in all CRY primitives, which implement an asymmetrical private key wrapping. Please note that the calling application has to provide the key type buffer. So, it has to be ensured that the size of this buffer matches with the configured value here.
      container CsmAsymPrivateKeyWrapAsymConfig [0..32]  # This container comprises the configuration of one asymmetrical private key wrapping service. The container name serves as a symbolic name for the identifier of a service configuration. An asymmetrical private key wrapping service accumulates function pointers to the Start, Update and Finish functions and a pointer to the initialization structure of an asymmetrical private key wrapping primitive. Usually, this primitive is provided by the CRY module. Up to 32 different asymmetrical private key wrapping primitives are supported.
        function name CsmCallbackAsymPrivateKeyWrapAsym: set at pre-compile  # Callback Function | Callback function to be called if service has finished. This parameter is only needed if the CSM is in asynchronous mode.
        string CsmAsymPrivateKeyWrapAsymInitConfiguration: set at pre-compile  # Symbolic Name of Init Configuration Structure | This is the name of the C symbol, which contains the configuration of the underlying cryptographic primitive. Usually, this symbol represents a structure provided by the CRY module.
        string CsmAsymPrivateKeyWrapAsymPrimitiveName: set at pre-compile  # Name of Asymmetrical Private Key Wrapping Primitive | This is the name of the cryptographic primitive to use. This name will be used to form the function pointers to the Start, Update and Finish functions of the corresponding cryptographic primitive according to the following rule: <name>[Start|Update|Finish] Usually these functions are provided by the CRY module.
        string CsmAsymPrivateKeyWrapAsymIncludeFile: set at pre-compile, origin=Vector Informatik  # Include file of specific Service | Header file of the underlying cryptographic service that shall be used.
        boolean CsmAsymPrivateKeyWrapAsymUseServicePorts: set at pre-compile, origin=Vector Informatik, default-value=true  # Use Service Ports | This parameter defines if this block is accessible via service ports. The PortName will be derived from the block name.
    container CsmAsymPrivateKeyWrapSym [0..1]  # This container comprises all symmetrical private key wrapping primitives.
      integer CsmAsymPrivateKeyWrapSymMaxPrivKeySize: 1..4294967295, set at pre-compile  # Max. Private Key Size | This is the maximum size over all private keys used in all CRY primitives, which implement an asymmetrical private key wrapping. Please note that the calling application has to provide the key buffer. So, it has to be ensured that the size of this buffer matches with the configured value here.
      integer CsmAsymPrivateKeyWrapSymMaxSymKeySize: 1..4294967295, set at pre-compile  # Max. Private Key Size | This is the maximum size over all symmetrical key lengths used in all CRY primitives, which implement an asymmetrical private key wrapping. Please note that the calling application has to provide the key buffer. So, it has to be ensured that the size of this buffer matches with the configured value here.
      container CsmAsymPrivateKeyWrapSymConfig [0..32]  # This container comprises the configuration of one asymmetrical private key wrapping service. The container name serves as a symbolic name for the identifier of a service configuration. An asymmetrical private key wrapping service accumulates function pointers to the Start, Update and Finish functions and a pointer to the initialization structure of an asymmetrical private key wrapping primitive. Usually, this primitive is provided by the CRY module. Up to 32 different asymmetrical private key wrapping primitives are supported.
        function name CsmCallbackAsymPrivateKeyWrapSym: set at pre-compile  # Callback Function | Callback function to be called if service has finished. This parameter is only needed if the CSM is in asynchronous mode.
        string CsmAsymPrivateKeyWrapSymInitConfiguration: set at pre-compile  # Symbolic Name of Init Configuration Structure | This is the name of the C symbol, which contains the configuration of the underlying cryptographic primitive. Usually, this symbol represents a structure provided by the CRY module.
        string CsmAsymPrivateKeyWrapSymPrimitiveName: set at pre-compile  # Name of Asymmetrical Private Key Wrapping Primitive | This is the name of the cryptographic primitive to use. This name will be used to form the function pointers to the Start, Update and Finish functions of the corresponding cryptographic primitive according to the following rule: <name>[Start|Update|Finish] Usually these functions are provided by the CRY module.
        string CsmAsymPrivateKeyWrapSymIncludeFile: set at pre-compile, origin=Vector Informatik  # Include file of specific Service | Header file of the underlying cryptographic service that shall be used.
        boolean CsmAsymPrivateKeyWrapSymUseServicePorts: set at pre-compile, origin=Vector Informatik, default-value=true  # Use Service Ports | This parameter defines if this block is accessible via service ports. The PortName will be derived from the block name.
    container CsmAsymPublicKeyExtract [0..1]  # This container comprises all asymmetrical public key extraction primitives.
      integer CsmAsymPublicKeyExtractMaxKeySize: 1..4294967295, set at pre-compile  # Max. Key Size | This is the maximum size over all key lengths used in all CRY primitives, which implement an asymmetrical public key extraction. Please note that the calling application has to provide the key buffer. So, it has to be ensured that the size of this buffer matches with the configured value here.
      container CsmAsymPublicKeyExtractConfig [0..32]  # This container comprises the configuration of one asymmetrical public key extraction service. The container name serves as a symbolic name for the identifier of a service configuration. An asymmetrical public key extraction service accumulates function pointers to the Start, Update and Finish functions and a pointer to the initialization structure of an asymmetrical public key extraction primitive. Usually, this primitive is provided by the CRY module. Up to 32 different asymmetrical public key extraction primitives are supported. | The container name serves as a symbolic name for the identifier of a service configuration.
        function name CsmCallbackAsymPublicKeyExtract: set at pre-compile  # Callback Function | Callback function to be called if service has finished. This parameter is only needed if the CSM is in asynchronous mode.
        string CsmAsymPublicKeyExtractInitConfiguration: set at pre-compile  # Symbolic Name of Init Configuration | This is the name of the C symbol, which contains the configuration of the underlying cryptographic primitive. Usually, this symbol represents a structure provided by the CRY module.
        string CsmAsymPublicKeyExtractPrimitiveName: set at pre-compile  # Name of Asymmetrical Public Key Extraction | This is the name of the cryptographic primitive to use. This name will be used to form the function pointers to the Start, Update and Finish functions of the corresponding cryptographic primitive according to the following rule: <name>[Start|Update|Finish] Usually these functions are provided by the CRY module.
        string CsmAsymPublicKeyExtractIncludeFile: set at pre-compile, origin=Vector Informatik  # Include file of specific Service | Header file of the underlying cryptographic service that shall be used.
        boolean CsmAsymPublicKeyExtractUseServicePorts: set at pre-compile, origin=Vector Informatik, default-value=true  # Use Service Ports | This parameter defines if this block is accessible via service ports. The PortName will be derived from the block name.
    container CsmChecksum [0..1]  # This container comprises all checksum primitives.
      container CsmChecksumConfig [0..32]  # This container comprises the configuration of one checksum computation service. The container name serves as a symbolic name for the identifier of a service configuration. A checksum computation service accumulates function pointers to the Start, Update and Finish functions and a pointer to the initialization structure of a checksum computation primitive. Usually, this primitive is provided by the CRY module. Up to 32 different checksum computation primitives are supported.
        function name CsmCallbackChecksum: set at pre-compile  # Callback Function | Callback function to be called if service has finished. This parameter is only needed if the CSM is in asynchronous mode.
        string CsmChecksumInitConfiguration: set at pre-compile  # Symbolic Name of Init Configuration | This is the name of the C symbol, which contains the configuration of the underlying cryptographic primitive. Usually, this symbol represents a structure provided by the CRY module.
        string CsmChecksumPrimitiveName: set at pre-compile  # Name of Checksum Primitive | This is the name of the cryptographic primitive to use. This name will be used to form the function pointers to the Start, Update and Finish functions of the corresponding cryptographic primitive according to the following rule: <name>[Start|Update|Finish] Usually these functions are provided by the CRY module.
        string CsmChecksumIncludeFile: set at pre-compile, origin=Vector Informatik  # Include file of specific Service | Header file of the underlying cryptographic service that shall be used.
        boolean CsmChecksumUseServicePorts: set at pre-compile, origin=Vector Informatik, default-value=true  # Use Service Ports | This parameter defines if this block is accessible via service ports. The PortName will be derived from the block name.
    container CsmDemEventParameterRefs [0..1]  # Container for the references to DemEventParameter elements which shall be invoked using the API Dem_ReportErrorStatus API in case the corresponding error occurs. The EventId is taken from the referenced DemEventParameter's DemEventId value. The standardized errors are provided in the container and can be extended by vendor specific error references.
      symbolic name reference CSM_E_INIT_FAILED [0..1]: set at pre-compile, destination=DemEventParameter  # Reference to the DemEventParameter which shall be issued when the error "Initialization of CSM module failed" has occured.
    container CsmGeneral  # Container for common configuration options.
      boolean CsmDevErrorDetect: set at pre-compile, default-value=true  # Pre-processor switch to enable and disable development error detection. | True: Development error detection enabled. False: Development error detection disabled
      string CsmMaxAlignScalarType: set at pre-compile, default-value=32  # The scalar type which has the maximum alignment restrictions on the given platform. Valid Values: 8, 16, 32 | This type can be e.g. uint8, uint16 or uint32.
      integer CsmMaximumBlockingTime: 1..4294967295, set at pre-compile, default-value=1  # If interruption is turned on with the configuration option CsmUseInterruption, this option configures the maximum time in microseconds the main function shall be allowed to run before it must interrupt itself. The lowest allowed value for the option is implementation dependent. NOT USED
      boolean CsmUseInterruption: set at pre-compile, default-value=false  # Pre-processor switch to enable and disable interruption of job processing. NOT USED | True: Interruption of job processing enabled False: Interruption of job processing disabled
      boolean CsmUseSyncJobProcessing: set at pre-compile, default-value=true  # Pre-processor switch to enable and disable synchronous job processing. | True: synchronous job processing enabled False: synchronous job processing disabled
      boolean CsmVersionInfoApi: set at pre-compile, default-value=false  # Pre-processor switch to enable and disable availability of the API Csm_GetVersionInfo(). True: API Csm_GetVersionInfo() is available. False: API Csm_GetVersionInfo() is not available.
      string CsmUserConfigFile [0..1]: set at pre-compile, origin=Vector Informatik  # User configuration file that shall be part of the Csm configuration. If you want to overwrite or provide own settings in the generated configuration file, you can specify a path to a user defined configuration file. The user defined configuration file will be included at the end of the generated file. Thus definitions in the user defined configuration file can overwrite definitions in the generated configuration file.
      boolean CsmDisableNotConfiguredApis: set at pre-compile, origin=Vector Informatik, default-value=true  # If enabled, APIs of not configured services will be disabled.
      float CsmMainFunctionPeriod [0..1]: 0.001..65.535, set at pre-compile, origin=Vector Informatik, default-value=0.01  # Specifies the period of main function Csm_MainFunction in seconds.
      integer CsmRteBufferSize: 1..4294967295, set at pre-compile, origin=Vector Informatik, default-value=128  # Specifies the size in bytes for the Rte Buffer types created by Csm.
    container CsmHash [0..1]  # This container comprises all hash primitives.
      container CsmHashConfig [0..32]  # This container comprises the configuration of one hash computation service. The container name serves as a symbolic name for the identifier of a service configuration. A hash computation service accumulates function pointers to the Start, Update and Finish functions and a pointer to the initialization structure of a hash primitive. Usually, this primitive is provided by the CRY module. Up to 32 different hash primitives are supported.
        function name CsmCallbackHash: set at pre-compile  # Callback Function | Callback function to be called if service has finished. This parameter is only needed if the CSM is in asynchronous mode.
        string CsmHashInitConfiguration: set at pre-compile  # Symbolic Name of Init Configuration Structure | This is the name of the C symbol, which contains the configuration of the underlying cryptographic primitive. Usually, this symbol represents a structure provided by the CRY module.
        string CsmHashPrimitiveName: set at pre-compile  # Name of Hash Primitive | This is the name of the cryptographic primitive to use. This name will be used to form the function pointers to the Start, Update and Finish functions of the corresponding cryptographic primitive according to the following rule: <name>[Start|Update|Finish] Usually these functions are provided by the CRY module.
        string CsmHashIncludeFile: set at pre-compile, origin=Vector Informatik  # Include file of specific Service | Header file of the underlying cryptographic service that shall be used.
        boolean CsmHashUseServicePorts: set at pre-compile, origin=Vector Informatik, default-value=true  # Use Service Ports | This parameter defines if this block is accessible via service ports. The PortName will be derived from the block name.
        choice reference CsmHashCryRef [0..1]: set at pre-compile, destination=[CryHashSha1Config, CryHashSha256Config, CryHashRipemd160Config, CryHashSha512Config]
    container CsmKeyDerive [0..1]  # This container comprises all key derivation primitives.
      integer CsmKeyDeriveMaxKeySize: 1..4294967295, set at pre-compile  # Max. Key Size | This is the maximum size over all key lengths used in all CRY primitives, which implement a key derivation. Please note that the calling application has to provide the key buffer. So, it has to be ensured that the size of this buffer matches with the configured value here.
      container CsmKeyDeriveConfig [0..32]  # This container comprises the configuration of one key derivation service. The container name serves as a symbolic name for the identifier of a service configuration. A key derivation service accumulates function pointers to the Start, Update and Finish functions and a pointer to the initialization structure of a key derivation primitive. Usually, this primitive is provided by the CRY module. Up to 32 different key derivation primitives are supported.
        function name CsmCallbackKeyDerive: set at pre-compile  # Callback Function | Callback function to be called if service has finished. This parameter is only needed if the CSM is in asynchronous mode.
        string CsmKeyDeriveInitConfiguration: set at pre-compile  # Symbolic Name of Init Configuration Structure | This is the name of the C symbol, which contains the configuration of the underlying cryptographic primitive. Usually, this symbol represents a structure provided by the CRY module.
        string CsmKeyDerivePrimitiveName: set at pre-compile  # Name of Key Derive Primitive | This is the name of the cryptographic primitive to use. This name will be used to form the function pointers to the Start, Update and Finish functions of the corresponding cryptographic primitive according to the following rule: <name>[Start|Update|Finish] Usually these functions are provided by the CRY module.
        string CsmKeyDeriveIncludeFile: set at pre-compile, origin=Vector Informatik  # Include file of specific Service | Header file of the underlying cryptographic service that shall be used.
        boolean CsmKeyDeriveUseServicePorts: set at pre-compile, origin=Vector Informatik, default-value=true  # Use Service Ports | This parameter defines if this block is accessible via service ports. The PortName will be derived from the block name.
    container CsmKeyDeriveSymKey [0..1]  # Container for incorporation of CsmKeyDeriveSymKey primitives.
      integer CsmKeyDeriveSymKeyMaxSymKeySize: 1..4294967295, set at pre-compile  # Max. Key Size | This is the maximum size over all key lengths used in all CRY primitives, which implement a key derivation. Please note that the calling application has to provide the key buffer. So, it has to be ensured that the size of this buffer matches with the configured value here.
      container CsmKeyDeriveSymKeyConfig [0..32]  # This container comprises the configuration of one sym key derivation service. The container name serves as a symbolic name for the identifier of a service configuration. A key derivation service accumulates function pointers to the Start, Update and Finish functions and a pointer to the initialization structure of a key derivation primitive. Usually, this primitive is provided by the CRY module. Up to 32 different key derivation primitives are supported.
        function name CsmCallbackKeyDeriveSymKey: set at pre-compile  # Callback Function | Callback function to be called if service has finished. This parameter is only needed if the CSM is in asynchronous mode.
        string CsmKeyDeriveSymKeyInitConfiguration: set at pre-compile  # This is the name of the C symbol, which contains the configuration of the underlying cryptographic primitive. Usually, this symbol represents a structure provided by the CRY module.
        string CsmKeyDeriveSymKeyPrimitiveName: set at pre-compile  # Name of Key Derive Primitive | This is the name of the cryptographic primitive to use. This name will be used to form the function pointers to the Start, Update and Finish functions of the corresponding cryptographic primitive according to the following rule: <name>[Start|Update|Finish] Usually these functions are provided by the CRY module.
        string CsmKeyDeriveSymKeyIncludeFile: set at pre-compile, origin=Vector Informatik  # Include file of specific Service | Header file of the underlying cryptographic service that shall be used.
        boolean CsmKeyDeriveSymKeyUseServicePorts: set at pre-compile, origin=Vector Informatik, default-value=true  # Use Service Ports | This parameter defines if this block is accessible via service ports. The PortName will be derived from the block name.
    container CsmKeyExchangeCalcPubVal [0..1]  # This container comprises all key exchange public value primitives.
      integer CsmKeyExchangeCalcPubValMaxBaseTypeSize: 1..4294967295, set at pre-compile  # Max. Base Type Size | The maximum length, in bytes, of all base types used in all CRY primitives which implement a public value calculation.
      integer CsmKeyExchangeCalcPubValMaxPrivateTypeSize: 1..4294967295, set at pre-compile  # Max. Private Type Size | The maximum length, in bytes, of all private information types used in all CRY primitives which implement a public value calculation.
      container CsmKeyExchangeCalcPubValConfig [0..32]  # This container comprises the configuration of one key exchange public value calculation service. The container name serves as a symbolic name for the identifier of a service configuration. A key exchange public value calculation service accumulates function pointers to the Start, Update and Finish functions and a pointer to the initialization structure of a key exchange public value calculation primitive. Usually, this primitive is provided by the CRY module. Up to 32 different key exchange public value calculation primitives are supported.
        function name CsmCallbackKeyExchangeCalcPubVal: set at pre-compile  # Callback Function | Callback function to be called if service has finished. This parameter is only needed if the CSM is in asynchronous mode.
        string CsmKeyExchangeCalcPubValInitConfiguration: set at pre-compile  # Symbolic Name of Init Configuration Structure | This is the name of the C symbol, which contains the configuration of the underlying cryptographic primitive. Usually, this symbol represents a structure provided by the CRY module.
        string CsmKeyExchangeCalcPubValPrimitiveName: set at pre-compile  # Name of Key Exchange Public Value Primitive | This is the name of the cryptographic primitive to use. This name will be used to form the function pointers to the Start, Update and Finish functions of the corresponding cryptographic primitive according to the following rule: <name>[Start|Update|Finish] Usually these functions are provided by the CRY module. Name of the cryptographic primitive to use.
        string CsmKeyExchangeCalcPubValIncludeFile: set at pre-compile, origin=Vector Informatik  # Include file of specific Service | Header file of the underlying cryptographic service that shall be used.
        boolean CsmKeyExchangeCalcPubValUseServicePorts: set at pre-compile, origin=Vector Informatik, default-value=true  # Use Service Ports | This parameter defines if this block is accessible via service ports. The PortName will be derived from the block name.
    container CsmKeyExchangeCalcSecret [0..1]  # This container comprises all key exchange secret calculation primitives.
      integer CsmKeyExchangeCalcSecretMaxBaseTypeSize: 1..4294967295, set at pre-compile  # Max. Base Type Size | The maximum length, in bytes, of all base types used in all CRY primitives which implement a shared secret calculation.
      integer CsmKeyExchangeCalcSecretMaxPrivateTypeSize: 1..4294967295, set at pre-compile  # Max. Private Type Size | The maximum length, in bytes, of all private information types used in all CRY primitives which implement a shared secret calculation.
      container CsmKeyExchangeCalcSecretConfig [0..32]  # This container comprises the configuration of one key exchange secret calculation service. The container name serves as a symbolic name for the identifier of a service configuration. A key exchange secret calculation service accumulates function pointers to the Start, Update and Finish functions and a pointer to the initialization structure of a key exchange secret calculation primitive. Usually, this primitive is provided by the CRY module. Up to 32 different key exchange secret calculation primitives are supported.
        function name CsmCallbackKeyExchangeCalcSecret: set at pre-compile  # Callback Function | Callback function to be called if service has finished. This parameter is only needed if the CSM is in asynchronous mode.
        string CsmKeyExchangeCalcSecretInitConfiguration: set at pre-compile  # Symbolic Name of Init Configuration Structure | This is the name of the C symbol, which contains the configuration of the underlying cryptographic primitive. Usually, this symbol represents a structure provided by the CRY module.
        string CsmKeyExchangeCalcSecretPrimitiveName: set at pre-compile  # Name of Key Exchange Secret Calculation Primitive | This is the name of the cryptographic primitive to use. This name will be used to form the function pointers to the Start, Update and Finish functions of the corresponding cryptographic primitive according to the following rule: <name>[Start|Update|Finish] Usually these functions are provided by the CRY module.
        string CsmKeyExchangeCalcSecretIncludeFile: set at pre-compile, origin=Vector Informatik  # Include file of specific Service | Header file of the underlying cryptographic service that shall be used.
        boolean CsmKeyExchangeCalcSecretUseServicePorts: set at pre-compile, origin=Vector Informatik, default-value=true  # Use Service Ports | This parameter defines if this block is accessible via service ports. The PortName will be derived from the block name.
    container CsmKeyExchangeCalcSymKey [0..1]  # Container for incorporation of KeyExchangeCalcSymKey primitives.
      integer CsmKeyExchangeCalcSymKeyMaxBaseTypeSize: 1..4294967295, set at pre-compile  # Max. Base Type Size | The maximum length, in bytes, of all base types used in all CRY primitives which implement a symmetrical key calculation.
      integer CsmKeyExchangeCalcSymKeyMaxPrivateTypeSize: 1..4294967295, set at pre-compile  # The maximum length, in bytes, of all private information types used in all CRY primitives which implement a symmetrical key calculation.
      integer CsmKeyExchangeCalcSymKeyMaxSymKeySize: 1..4294967295, set at pre-compile  # The maximum, in bytes, of all key lengths used in all CRY primitives which implement a symmetrical key calculation.
      container CsmKeyExchangeCalcSymKeyConfig [0..32]  # This container comprises the configuration of one key exchange secret sym. calculation service. The container name serves as a symbolic name for the identifier of a service configuration. A key exchange secret calculation service accumulates function pointers to the Start, Update and Finish functions and a pointer to the initialization structure of a key exchange secret calculation primitive. Usually, this primitive is provided by the CRY module. Up to 32 different key exchange secret calculation primitives are supported.
        function name CsmCallbackKeyExchangeCalcSymKey: set at pre-compile  # Callback Function | Callback function to be called if service has finished. This parameter is only needed if the CSM is in asynchronous mode.
        string CsmKeyExchangeCalcSymKeyInitConfiguration: set at pre-compile  # Symbolic Name of Init Configuration Structure | This is the name of the C symbol, which contains the configuration of the underlying cryptographic primitive. Usually, this symbol represents a structure provided by the CRY module.
        string CsmKeyExchangeCalcSymKeyPrimitiveName: set at pre-compile  # Name of SymKey Exchange Calculation Primitive | This is the name of the cryptographic primitive to use. This name will be used to form the function pointers to the Start, Update and Finish functions of the corresponding cryptographic primitive according to the following rule: <name>[Start|Update|Finish] Usually these functions are provided by the CRY module.
        string CsmKeyExchangeCalcSymKeyIncludeFile: set at pre-compile, origin=Vector Informatik  # Include file of specific Service | Header file of the underlying cryptographic service that shall be used.
        boolean CsmKeyExchangeCalcSymKeyUseServicePorts: set at pre-compile, origin=Vector Informatik, default-value=true  # Use Service Ports | This parameter defines if this block is accessible via service ports. The PortName will be derived from the block name.
    container CsmMacGenerate [0..1]  # This container comprises all MAC generation primitives.
      integer CsmMacGenerateMaxKeySize: 1..4294967295, set at pre-compile  # Max. Key Size | This is the maximum size over all key lengths used in all CRY primitives, which implement a MAC generation. Please note that the calling application has to provide the key buffer. So, it has to be ensured that the size of this buffer matches with the configured value here.
      container CsmMacGenerateConfig [0..32]  # This container comprises the configuration of one MAC generation service. The container name serves as a symbolic name for the identifier of a service configuration. A MAC generation service accumulates function pointers to the Start, Update and Finish functions and a pointer to the initialization structure of a MAC generation primitive. Usually, this primitive is provided by the CRY module. Up to 32 different MAC generation primitives are supported.
        function name CsmCallbackMacGenerate: set at pre-compile  # Callback Function | Callback function to be called if service has finished. This parameter is only needed if the CSM is in asynchronous mode.
        string CsmMacGenerateInitConfiguration: set at pre-compile  # Symbolic Name of Init Configuration Structure | This is the name of the C symbol, which contains the configuration of the underlying cryptographic primitive. Usually, this symbol represents a structure provided by the CRY module.
        string CsmMacGeneratePrimitiveName: set at pre-compile  # Name of MAC Generation Primitive | This is the name of the cryptographic primitive to use. This name will be used to form the function pointers to the Start, Update and Finish functions of the corresponding cryptographic primitive according to the following rule: <name>[Start|Update|Finish] Usually these functions are provided by the CRY module.
        string CsmMacGenerateIncludeFile: set at pre-compile, origin=Vector Informatik  # Include file of specific Service | Header file of the underlying cryptographic service that shall be used.
        boolean CsmMacGenerateUseServicePorts: set at pre-compile, origin=Vector Informatik, default-value=true  # Use Service Ports | This parameter defines if this block is accessible via service ports. The PortName will be derived from the block name.
        choice reference CsmMacGenerateCryRef [0..1]: set at pre-compile, destination=CryCmacAes128GenConfig
    container CsmMacVerify [0..1]  # This container comprises all MAC verification primitives.
      integer CsmMacVerifyMaxKeySize: 1..4294967295, set at pre-compile  # Max. Key Size | This is the maximum size over all key lengths used in all CRY primitives, which implement a MAC verification. Please note that the calling application has to provide the key buffer. So, it has to be ensured that the size of this buffer matches with the configured value here.
      container CsmMacVerifyConfig [0..32]  # This container comprises the configuration of one MAC verification service. The container name serves as a symbolic name for the identifier of a service configuration. A MAC verification service accumulates function pointers to the Start, Update and Finish functions and a pointer to the initialization structure of a MAC verification primitive. Usually, this primitive is provided by the CRY module. Up to 32 different MAC verification primitives are supported.
        function name CsmCallbackMacVerify: set at pre-compile  # Callback Function | Callback function to be called if service has finished. This parameter is only needed if the CSM is in asynchronous mode.
        string CsmMacVerifyInitConfiguration: set at pre-compile  # Symbolic Name of Init Configuration Structure | This is the name of the C symbol, which contains the configuration of the underlying cryptographic primitive. Usually, this symbol represents a structure provided by the CRY module.
        string CsmMacVerifyPrimitiveName: set at pre-compile  # Name of MAC Verification Primitive | This is the name of the cryptographic primitive to use. This name will be used to form the function pointers to the Start, Update and Finish functions of the corresponding cryptographic primitive according to the following rule: <name>[Start|Update|Finish] Usually these functions are provided by the CRY module.
        string CsmMacVerifyIncludeFile: set at pre-compile, origin=Vector Informatik  # Include file of specific Service | Header file of the underlying cryptographic service that shall be used.
        boolean CsmMacVerifyUseServicePorts: set at pre-compile, origin=Vector Informatik, default-value=true  # Use Service Ports | This parameter defines if this block is accessible via service ports. The PortName will be derived from the block name.
        choice reference CsmMacVerifyCryRef [0..1]: set at pre-compile, origin=Vector Informatik, destination=[CryHmacSha1VerifyConfig, CryCmacAes128VerConfig]
    container CsmRandomGenerate [0..1]  # This container comprises all random generation primitives.
      container CsmRandomGenerateConfig [0..32]  # This container comprises the configuration of one random generation service. The container name serves as a symbolic name for the identifier of a service configuration. A random generation service accumulates function pointers to the Start, Update and Finish functions and a pointer to the initialization structure of a random generation primitive. Usually, this primitive is provided by the CRY module. Up to 32 different random generation primitives are supported.
        function name CsmCallbackRandomGenerate: set at pre-compile  # Callback Function | Callback function to be called if service has finished. This parameter is only needed if the CSM is in asynchronous mode.
        string CsmRandomGenerateInitConfiguration: set at pre-compile  # Symbolic Name of Init Configuration Structure | This is the name of the C symbol, which contains the configuration of the underlying cryptographic primitive. Usually, this symbol represents a structure provided by the CRY module.
        string CsmRandomGeneratePrimitiveName: set at pre-compile  # Name of Random Generation Primitive | This is the name of the cryptographic primitive to use. This name will be used to form the function pointers to the Start, Update and Finish functions of the corresponding cryptographic primitive according to the following rule: <name>[Start|Update|Finish] Usually these functions are provided by the CRY module.
        string CsmRandomGenerateIncludeFile: set at pre-compile, origin=Vector Informatik  # Include file of specific Service | Header file of the underlying cryptographic service that shall be used.
        boolean CsmRandomGenerateUseServicePorts: set at pre-compile, origin=Vector Informatik, default-value=true  # Use Service Ports | This parameter defines if this block is accessible via service ports. The PortName will be derived from the block name.
        choice reference CsmRandomGenerateCryRef [0..1]: set at pre-compile, origin=Vector Informatik, destination=[CryFips186Config, CryRngConfig]
    container CsmRandomSeed [0..1]  # This container comprises all random number seeding primitives.
      container CsmRandomSeedConfig [0..32]  # This container comprises the configuration of one random number seeding service. The container name serves as a symbolic name for the identifier of a service configuration. A random number seeding service accumulates function pointers to the Start, Update and Finish functions and a pointer to the initialization structure of a random number seeding primitive. Usually, this primitive is provided by the CRY module. Up to 32 different random number seeding primitives are supported.
        function name CsmCallbackRandomSeed: set at pre-compile  # Callback Function | Callback function to be called if service has finished. This parameter is only needed if the CSM is in asynchronous mode.
        string CsmRandomSeedInitConfiguration: set at pre-compile  # Symbolic Name of Init Configuration Structure | This is the name of the C symbol, which contains the configuration of the underlying cryptographic primitive. Usually, this symbol represents a structure provided by the CRY module.
        string CsmRandomSeedPrimitiveName: set at pre-compile  # Name of Random Seed Primitive | This is the name of the cryptographic primitive to use. This name will be used to form the function pointers to the Start, Update and Finish functions of the corresponding cryptographic primitive according to the following rule: <name>[Start|Update|Finish] Usually these functions are provided by the CRY module.
        string CsmRandomSeedIncludeFile: set at pre-compile, origin=Vector Informatik  # Include file of specific Service | Header file of the underlying cryptographic service that shall be used.
        boolean CsmRandomSeedUseServicePorts: set at pre-compile, origin=Vector Informatik, default-value=true  # Use Service Ports | This parameter defines if this block is accessible via service ports. The PortName will be derived from the block name.
        choice reference CsmRandomSeedCryRef [0..1]: set at pre-compile, origin=Vector Informatik, destination=[CryFips186Config, CryRngConfig]
    container CsmSignatureGenerate [0..1]  # This container comprises all signature generation primitives.
      integer CsmSignatureGenerateMaxKeySize: 1..4294967295, set at pre-compile  # Max. Key Size | This is the maximum size over all key lengths used in all CRY primitives, which implement a signature generation. Please note that the calling application has to provide the key buffer. So, it has to be ensured that the size of this buffer matches with the configured value here.
      container CsmSignatureGenerateConfig [0..32]  # This container comprises the configuration of one signature generation service. The container name serves as a symbolic name for the identifier of a service configuration. A signature generation service accumulates function pointers to the Start, Update and Finish functions and a pointer to the initialization structure of a signature generation primitive. Usually, this primitive is provided by the CRY module. Up to 32 different signature generation primitives are supported.
        function name CsmCallbackSignatureGenerate: set at pre-compile  # Callback Function | Callback function to be called if service has finished. This parameter is only needed if the CSM is in asynchronous mode.
        string CsmSignatureGenerateInitConfiguration: set at pre-compile  # Symbolic Name of Init Configuration Structure | This is the name of the C symbol, which contains the configuration of the underlying cryptographic primitive. Usually, this symbol represents a structure provided by the CRY module.
        string CsmSignatureGeneratePrimitiveName: set at pre-compile  # Name of Signature Primitive | This is the name of the cryptographic primitive to use. This name will be used to form the function pointers to the Start, Update and Finish functions of the corresponding cryptographic primitive according to the following rule: <name>[Start|Update|Finish] Usually these functions are provided by the CRY module.
        string CsmSignatureGenerateIncludeFile: set at pre-compile, origin=Vector Informatik  # Include file of specific Service | Header file of the underlying cryptographic service that shall be used.
        boolean CsmSignatureGenerateUseServicePorts: set at pre-compile, origin=Vector Informatik, default-value=true  # Use Service Ports | This parameter defines if this block is accessible via service ports. The PortName will be derived from the block name.
        choice reference CsmSignatureGenerateCryRef [0..1]: set at pre-compile, origin=Vector Informatik, destination=[CryEcdsaSigGenConfig, CryEd25519SigGenConfig]
    container CsmSignatureVerify [0..1]  # This container comprises all signature verification primitives.
      integer CsmSignatureVerifyMaxKeySize: 1..4294967295, set at pre-compile  # Max. Key Size | This is the maximum size over all key lengths used in all CRY primitives, which implement a signature verification. Please note that the calling application has to provide the key buffer. So, it has to be ensured that the size of this buffer matches with the configured value here.
      container CsmSignatureVerifyConfig [0..32]  # This container comprises the configuration of one signature verification service. The container name serves as a symbolic name for the identifier of a service configuration. A signature verification service accumulates function pointers to the Start, Update and Finish functions and a pointer to the initialization structure of a signature verification primitive. Usually, this primitive is provided by the CRY module. Up to 32 different signature verification primitives are supported.
        function name CsmCallbackSignatureVerify: set at pre-compile  # Callback Function | Callback function to be called if service has finished. This parameter is only needed if the CSM is in asynchronous mode.
        string CsmSignatureVerifyInitConfiguration: set at pre-compile  # Symbolic Name of Init Configuration Structure | This is the name of the C symbol, which contains the configuration of the underlying cryptographic primitive. Usually, this symbol represents a structure provided by the CRY module.
        string CsmSignatureVerifyPrimitiveName: set at pre-compile  # Name of Signature Verification Primitive | This is the name of the cryptographic primitive to use. This name will be used to form the function pointers to the Start, Update and Finish functions of the corresponding cryptographic primitive according to the following rule: <name>[Start|Update|Finish] Usually these functions are provided by the CRY module.
        string CsmSignatureVerifyIncludeFile: set at pre-compile, origin=Vector Informatik  # Include file of specific Service | Header file of the underlying cryptographic service that shall be used.
        boolean CsmSignatureVerifyUseServicePorts: set at pre-compile, origin=Vector Informatik, default-value=true  # Use Service Ports | This parameter defines if this block is accessible via service ports. The PortName will be derived from the block name.
        choice reference CsmSignatureVerifyCryRef [0..1]: set at pre-compile, origin=Vector Informatik, destination=[CryRsaSha1SigVerConfig, CryEd25519SigVerConfig]
    container CsmSymBlockDecrypt [0..1]  # This container comprises all symmetrical block decryption primitives.
      integer CsmSymBlockDecryptMaxKeySize: 1..4294967295, set at pre-compile  # Max. Context Buffer Size | This is the maximum size over all key lengths used in all CRY primitives, which implement a symmetrical block decryption. Please note that the calling application has to provide the key buffer. So, it has to be ensured that the size of this buffer matches with the configured value here.
      container CsmSymBlockDecryptConfig [0..32]  # This container comprises the configuration of one symmetrical block decryption service. The container name serves as a symbolic name for the identifier of a service configuration. A symmetrical block decryption service accumulates function pointers to the Start, Update and Finish functions and a pointer to the initialization structure of a symmetrical block decryption primitive. Usually, this primitive is provided by the CRY module. Up to 32 different symmetrical block decryption primitives are supported.
        function name CsmCallbackSymBlockDecrypt: set at pre-compile  # Callback Function | Callback function to be called if service has finished. This parameter is only needed if the CSM is in asynchronous mode.
        string CsmSymBlockDecryptInitConfiguration: set at pre-compile  # Symbolic Name of Init Configuration Structure | This is the name of the C symbol, which contains the configuration of the underlying cryptographic primitive. Usually, this symbol represents a structure provided by the CRY module.
        string CsmSymBlockDecryptPrimitiveName: set at pre-compile  # Name of Symmetrical Block Decryption Primitive | This is the name of the cryptographic primitive to use. This name will be used to form the function pointers to the Start, Update and Finish functions of the corresponding cryptographic primitive according to the following rule: <name>[Start|Update|Finish] Usually these functions are provided by the CRY module.
        string CsmSymBlockDecryptIncludeFile: set at pre-compile, origin=Vector Informatik  # Include file of specific Service | Header file of the underlying cryptographic service that shall be used.
        boolean CsmSymBlockDecryptUseServicePorts: set at pre-compile, origin=Vector Informatik, default-value=true  # Use Service Ports | This parameter defines if this block is accessible via service ports. The PortName will be derived from the block name.
    container CsmSymBlockEncrypt [0..1]  # This container comprises all symmetrical block encryption primitives.
      integer CsmSymBlockEncryptMaxKeySize: 1..4294967295, set at pre-compile  # Max. Key Size | This is the maximum size over all key lengths used in all CRY primitives, which implement a symmetrical block encryption. Please note that the calling application has to provide the key buffer. So, it has to be ensured that the size of this buffer matches with the configured value here.
      container CsmSymBlockEncryptConfig [0..32]  # This container comprises the configuration of one symmetrical block encryption service. The container name serves as a symbolic name for the identifier of a service configuration. A symmetrical block encryption service accumulates function pointers to the Start, Update and Finish functions and a pointer to the initialization structure of a symmetrical block encryption primitive. Usually, this primitive is provided by the CRY module. Up to 32 different symmetrical block encryption primitives are supported.
        function name CsmCallbackSymBlockEncrypt: set at pre-compile  # Callback Function | Callback function to be called if service has finished. This parameter is only needed if the CSM is in asynchronous mode.
        string CsmSymBlockEncryptInitConfiguration: set at pre-compile  # Symbolic Name of Init Configuration Structure | This is the name of the C symbol, which contains the configuration of the underlying cryptographic primitive. Usually, this symbol represents a structure provided by the CRY module.
        string CsmSymBlockEncryptPrimitiveName: set at pre-compile  # Name of Symmetrical Block Encryption Primitive | This is the name of the cryptographic primitive to use. This name will be used to form the function pointers to the Start, Update and Finish functions of the corresponding cryptographic primitive according to the following rule: <name>[Start|Update|Finish] Usually these functions are provided by the CRY module.
        string CsmSymBlockEncryptIncludeFile: set at pre-compile, origin=Vector Informatik  # Include file of specific Service | Header file of the underlying cryptographic service that shall be used.
        boolean CsmSymBlockEncryptUseServicePorts: set at pre-compile, origin=Vector Informatik, default-value=true  # Use Service Ports | This parameter defines if this block is accessible via service ports. The PortName will be derived from the block name.
    container CsmSymDecrypt [0..1]  # This container comprises all symmetrical decryption primitives.
      integer CsmSymDecryptMaxKeySize: 1..4294967295, set at pre-compile  # Max. Key Size | This is the maximum size over all key lengths used in all CRY primitives, which implement a symmetrical decryption. Please note that the calling application has to provide the key buffer. So, it has to be ensured that the size of this buffer matches with the configured value here.
      container CsmSymDecryptConfig [0..32]  # This container comprises the configuration of one symmetrical decryption service. The container name serves as a symbolic name for the identifier of a service configuration. A symmetrical decryption service accumulates function pointers to the Start, Update and Finish functions and a pointer to the initialization structure of a symmetrical decryption primitive. Usually, this primitive is provided by the CRY module. Up to 32 different symmetrical decryption primitives are supported. | The container name serves as a symbolic name for the identifier of a service configuration.
        function name CsmCallbackSymDecrypt: set at pre-compile  # Callback Function | Callback function to be called if service has finished. This parameter is only needed if the CSM is in asynchronous mode.
        string CsmSymDecryptInitConfiguration: set at pre-compile  # Symbolic Name of Init Configuration Structure | This is the name of the C symbol, which contains the configuration of the underlying cryptographic primitive. Usually, this symbol represents a structure provided by the CRY module.
        string CsmSymDecryptPrimitiveName: set at pre-compile  # Name of Symmetrical Decryption Primitive | This is the name of the cryptographic primitive to use. This name will be used to form the function pointers to the Start, Update and Finish functions of the corresponding cryptographic primitive according to the following rule: <name>[Start|Update|Finish] Usually these functions are provided by the CRY module.
        string CsmSymDecryptIncludeFile: set at pre-compile, origin=Vector Informatik  # Include file of specific Service | Header file of the underlying cryptographic service that shall be used.
        boolean CsmSymDecryptUseServicePorts: set at pre-compile, origin=Vector Informatik, default-value=true  # Use Service Ports | This parameter defines if this block is accessible via service ports. The PortName will be derived from the block name.
        choice reference CsmSymDecryptCryRef [0..1]: set at pre-compile, origin=Vector Informatik, destination=CryAesDecrypt128Config
    container CsmSymEncrypt [0..1]  # This container comprises all symmetrical encryption primitives.
      integer CsmSymEncryptMaxKeySize: 1..4294967295, set at pre-compile  # Max. Key Size | This is the maximum size over all key lengths used in all CRY primitives, which implement a symmetrical encryption. Please note that the calling application has to provide the key buffer. So, it has to be ensured that the size of this buffer matches with the configured value here.
      container CsmSymEncryptConfig [0..32]  # This container comprises the configuration of one symmetrical encryption service. The container name serves as a symbolic name for the identifier of a service configuration. A symmetrical encryption service accumulates function pointers to the Start, Update and Finish functions and a pointer to the initialization structure of a symmetrical encryption primitive. Usually, this primitive is provided by the CRY module. Up to 32 different symmetrical encryption primitives are supported.
        function name CsmCallbackSymEncrypt: set at pre-compile  # Callback Function | Callback function to be called if service has finished. This parameter is only needed if the CSM is in asynchronous mode.
        string CsmSymEncryptPrimitiveName: set at pre-compile  # Name of Symmetrical Encryption Primitive | This is the name of the cryptographic primitive to use. This name will be used to form the function pointers to the Start, Update and Finish functions of the corresponding cryptographic primitive according to the following rule: <name>[Start|Update|Finish] Usually these functions are provided by the CRY module.
        string CsmSymEncryptIncludeFile: set at pre-compile, origin=Vector Informatik  # Include file of specific Service | Header file of the underlying cryptographic service that shall be used.
        string CsmSymEncryptInitConfiguration: set at pre-compile  # Symbolic Name of Init Configuration Structure | This is the name of the C symbol, which contains the configuration of the underlying cryptographic primitive. Usually, this symbol represents a structure provided by the CRY module.
        boolean CsmSymEncryptUseServicePorts: set at pre-compile, origin=Vector Informatik, default-value=true  # Use Service Ports | This parameter defines if this block is accessible via service ports. The PortName will be derived from the block name.
        choice reference CsmSymEncryptCryRef [0..1]: set at pre-compile, origin=Vector Informatik, destination=CryAesEncrypt128Config
    container CsmSymKeyExtract [0..1]  # This container comprises all symmetrical key extraction primitives.
      integer CsmSymKeyExtractMaxKeySize: 1..4294967295, set at pre-compile  # Max. Key Size | This is the maximum size over all key lengths used in all CRY primitives, which implement a symmetrical key extraction. Please note that the calling application has to provide the key buffer. So, it has to be ensured that the size of this buffer matches with the configured value here.
      container CsmSymKeyExtractConfig [0..32]  # This container comprises the configuration of one symmetrical key extraction service. The container name serves as a symbolic name for the identifier of a service configuration. A symmetrical key extraction service accumulates function pointers to the Start, Update and Finish functions and a pointer to the initialization structure of a symmetrical key extraction primitive. Usually, this primitive is provided by the CRY module. Up to 32 different symmetrical key extraction primitives are supported.
        function name CsmCallbackSymKeyExtract: set at pre-compile  # Callback Function | Callback function to be called if service has finished. This parameter is only needed if the CSM is in asynchronous mode.
        string CsmSymKeyExtractInitConfiguration: set at pre-compile  # Symbolic Name of Init Configuration Structure | This is the name of the C symbol, which contains the configuration of the underlying cryptographic primitive. Usually, this symbol represents a structure provided by the CRY module.
        string CsmSymKeyExtractPrimitiveName: set at pre-compile  # Name of Symmetrical Key Extraction Primitive | This is the name of the cryptographic primitive to use. This name will be used to form the function pointers to the Start, Update and Finish functions of the corresponding cryptographic primitive according to the following rule: <name>[Start|Update|Finish] Usually these functions are provided by the CRY module.
        string CsmSymKeyExtractIncludeFile: set at pre-compile, origin=Vector Informatik  # Include file of specific Service | Header file of the underlying cryptographic service that shall be used.
        boolean CsmSymKeyExtractUseServicePorts: set at pre-compile, origin=Vector Informatik, default-value=true  # Use Service Ports | This parameter defines if this block is accessible via service ports. The PortName will be derived from the block name.
        choice reference CsmSymKeyExtractCryRef [0..1]: set at pre-compile, origin=Vector Informatik, destination=CryKeyExtractConfig
    container CsmSymKeyWrapAsym [0..1]  # Container for incorporation of SymKeyWrapAsym primitives.
      integer CsmSymKeyWrapAsymMaxPubKeySize: 1..4294967295, set at pre-compile  # Max. Public Key Size | This is the maximum size over all public key types used in all CRY primitives, which implement a symmetrical key wrapping. Please note that the calling application has to provide the key type buffer. So, it has to be ensured that the size of this buffer matches with the configured value here.
      integer CsmSymKeyWrapAsymMaxSymKeySize: 1..4294967295, set at pre-compile  # Max. Key Size | This is the maximum size over all key types used in all CRY primitives, which implement a symmetrical key wrapping. Please note that the calling application has to provide the key type buffer. So, it has to be ensured that the size of this buffer matches with the configured value here.
      container CsmSymKeyWrapAsymConfig [0..32]  # This container comprises the configuration of one symmetrical key wrapping service. The container name serves as a symbolic name for the identifier of a service configuration. A symmetrical key wrapping service accumulates function pointers to the Start, Update and Finish functions and a pointer to the initialization structure of a symmetrical key wrapping primitive. Usually, this primitive is provided by the CRY module. Up to 32 different symmetrical key wrapping primitives are supported.
        function name CsmCallbackSymKeyWrapAsym: set at pre-compile  # Callback Function | Callback function to be called if service has finished. This parameter is only needed if the CSM is in asynchronous mode.
        string CsmSymKeyWrapAsymInitConfiguration: set at pre-compile  # Symbolic Name of Init Configuration Structure | This is the name of the C symbol, which contains the configuration of the underlying cryptographic primitive. Usually, this symbol represents a structure provided by the CRY module.
        string CsmSymKeyWrapAsymPrimitiveName: set at pre-compile  # Name of Symmetrical Key Wrapping Primitive | This is the name of the cryptographic primitive to use. This name will be used to form the function pointers to the Start, Update and Finish functions of the corresponding cryptographic primitive according to the following rule: <name>[Start|Update|Finish] Usually these functions are provided by the CRY module.
        string CsmSymKeyWrapAsymIncludeFile: set at pre-compile, origin=Vector Informatik  # Include file of specific Service | Header file of the underlying cryptographic service that shall be used.
        boolean CsmSymKeyWrapAsymUseServicePorts: set at pre-compile, origin=Vector Informatik, default-value=true  # Use Service Ports | This parameter defines if this block is accessible via service ports. The PortName will be derived from the block name.
    container CsmSymKeyWrapSym [0..1]  # Container for incorporation of SymKeyWrapSym primitives.
      integer CsmSymKeyWrapSymMaxSymKeySize: 1..4294967295, set at pre-compile  # Max. Key Size | This is the maximum size over all key types used in all CRY primitives, which implement a symmetrical key wrapping. Please note that the calling application has to provide the key type buffer. So, it has to be ensured that the size of this buffer matches with the configured value here.
      container CsmSymKeyWrapSymConfig [0..32]  # This container comprises the configuration of one symmetrical key wrapping service. The container name serves as a symbolic name for the identifier of a service configuration. A symmetrical key wrapping service accumulates function pointers to the Start, Update and Finish functions and a pointer to the initialization structure of a symmetrical key wrapping primitive. Usually, this primitive is provided by the CRY module. Up to 32 different symmetrical key wrapping primitives are supported.
        function name CsmCallbackSymKeyWrapSym: set at pre-compile  # Callback Function | Callback function to be called if service has finished. This parameter is only needed if the CSM is in asynchronous mode.
        string CsmSymKeyWrapSymInitConfiguration: set at pre-compile  # Symbolic Name of Init Configuration Structure | This is the name of the C symbol, which contains the configuration of the underlying cryptographic primitive. Usually, this symbol represents a structure provided by the CRY module.
        string CsmSymKeyWrapSymPrimitiveName: set at pre-compile  # Name of Symmetrical Key Wrapping Primitive | This is the name of the cryptographic primitive to use. This name will be used to form the function pointers to the Start, Update and Finish functions of the corresponding cryptographic primitive according to the following rule: <name>[Start|Update|Finish] Usually these functions are provided by the CRY module. .
        string CsmSymKeyWrapSymIncludeFile: set at pre-compile, origin=Vector Informatik  # Include file of specific Service | Header file of the underlying cryptographic service that shall be used.
        boolean CsmSymKeyWrapSymUseServicePorts: set at pre-compile, origin=Vector Informatik, default-value=true  # Use Service Ports | This parameter defines if this block is accessible via service ports. The PortName will be derived from the block name.
        choice reference CsmSymKeyWrapSymCryRef [0..1]: set at pre-compile, origin=Vector Informatik, destination=CryKeyWrapSymConfig
  bsw implementation Csm_Impl: programming-language=C, sw-version=3.00.02, used-code-generator=DaVinci Configurator, ar-release-version=4.00.03, behavior=BswMBehavior, vendor-specific-module-def=Csm
