AUTOSAR XML (schema 4-2-1)
package /MICROSAR
  module config Os_Pre: definition=Os
    OsPublishedInformation
      RH850P1HC (OsDerivativeInformation):
        OsMpuAlignment = 4
        OsStackAlignment = 4
        OsExceptionVectorTableAlignment = 512
        OsInterruptVectorTableAlignment = 512
        OsHardwareManuals = RH850/P1x-C Group Users Manual: Hardware Rev.1.10 Jul 2016 RH850G3M Users Manual: Software Rev.1.30 Jun 2016
        CORE0 (OsPhysicalCore):
          OsPhysicalCoreId = 0
          OsPhysicalCoreDefaultEntrySymbol = RESET_CORE0
          OsPhysicalCoreType = G3M
          OsPhysicalCoreExceptionSources = 16
          OsPhysicalCoreIsAutostart = 1
          OsPhysicalCoreMasterStartAllowed = 0
          OsPhysicalCorePrivelegedHwAccess = 1
          OsPhysicalCoreStackProtectionUnit = MPU_CORE0
          MPU_CORE0 (OsPhysicalCoreMpu): OsPhysicalCoreMpuId=0, OsPhysicalCoreMpuMaxRegions=16, OsPhysicalCoreMpuType=CoreMpu
        STM0 (OsHardwareTimer): OsHardwareTimerBaseAddress=4292706304, OsHardwareTimerUnit=FRT, OsHardwareTimerSize=32, OsHardwareTimerId=0, OsHardwareTimerType=STM
          3 x OsHardwareTimerChannel:
            STM0_CH1: OsHardwareTimerChannelIntSource=14, OsHardwareTimerChannelOffset=1, OsHardwareTimerChannelId=1
            STM0_CH2: OsHardwareTimerChannelIntSource=15, OsHardwareTimerChannelOffset=2, OsHardwareTimerChannelId=2
            STM0_CH3: OsHardwareTimerChannelIntSource=135, OsHardwareTimerChannelOffset=3, OsHardwareTimerChannelId=3
        STM1 (OsHardwareTimer): OsHardwareTimerBaseAddress=4292710400, OsHardwareTimerUnit=FRT, OsHardwareTimerSize=32, OsHardwareTimerId=1, OsHardwareTimerType=STM
          3 x OsHardwareTimerChannel:
            STM1_CH1: OsHardwareTimerChannelIntSource=137, OsHardwareTimerChannelOffset=1, OsHardwareTimerChannelId=1
            STM1_CH2: OsHardwareTimerChannelIntSource=138, OsHardwareTimerChannelOffset=2, OsHardwareTimerChannelId=2
            STM1_CH3: OsHardwareTimerChannelIntSource=139, OsHardwareTimerChannelOffset=3, OsHardwareTimerChannelId=3
        INTC (OsSystemIntCtrl): OsSystemIntCtrlBaseAddress=4294896128, OsSystemIntCtrlMaxPrios=16, OsSystemIntCtrlMaxSources=512, OsSystemIntCtrlPrioOrder=DESC
          5 x OsSystemIntCtrlAddress:
            INTC1: OsSystemIntCtrlAddressValue=4294896128
            INTC2: OsSystemIntCtrlAddressValue=4294946816
            EIBD1: OsSystemIntCtrlAddressValue=4294896384
            EIBD2: OsSystemIntCtrlAddressValue=4294948864
            IPIR: OsSystemIntCtrlAddressValue=4294896768
        CORE1 (OsPhysicalCore):
          OsPhysicalCoreId = 1
          OsPhysicalCoreDefaultEntrySymbol = RESET_CORE1
          OsPhysicalCoreType = G3M
          OsPhysicalCoreExceptionSources = 16
          OsPhysicalCoreIsAutostart = 1
          OsPhysicalCoreMasterStartAllowed = 0
          OsPhysicalCorePrivelegedHwAccess = 1
          OsPhysicalCoreStackProtectionUnit = MPU_CORE1
          MPU_CORE1 (OsPhysicalCoreMpu): OsPhysicalCoreMpuId=1, OsPhysicalCoreMpuMaxRegions=16, OsPhysicalCoreMpuType=CoreMpu
        MPAT (OsMemoryRegionSpecifics)
          6 x OsMemoryRegionAccess:
            SR: OsMemoryRegionAccessRights=R, OsMemoryRegionAccessType=SUPERVISOR
            SW: OsMemoryRegionAccessRights=W, OsMemoryRegionAccessType=SUPERVISOR
            SX: OsMemoryRegionAccessRights=X, OsMemoryRegionAccessType=SUPERVISOR
            UR: OsMemoryRegionAccessRights=R, OsMemoryRegionAccessType=USER
            UW: OsMemoryRegionAccessRights=W, OsMemoryRegionAccessType=USER
            UX: OsMemoryRegionAccessRights=X, OsMemoryRegionAccessType=USER
        OsMemoryRegionDefault_AppT (OsMemoryRegionDefaults): OsMemoryRegionDefAccessRights=SR, OsMemoryRegionDefAccessRights=SW, OsMemoryRegionDefType=APPLICATION_TRUSTED
        OsMemoryRegionDefault_AppNT (OsMemoryRegionDefaults):
          OsMemoryRegionDefAccessRights = UR
          OsMemoryRegionDefAccessRights = UW
          OsMemoryRegionDefAccessRights = SR
          OsMemoryRegionDefAccessRights = SW
          OsMemoryRegionDefType = APPLICATION_NONTRUSTED
        DEFAULT (OsInterruptSupportedType): OsInterruptSupportedTypeSeparateSources=0
