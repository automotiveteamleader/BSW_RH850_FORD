AUTOSAR XML (schema 4-2-1)
package /MICROSAR
  module config Os_Pre: definition=Os
    OsPublishedInformation
      RH850E1xFCC2 (OsDerivativeInformation):
        OsMpuAlignment = 4
        OsStackAlignment = 4
        OsExceptionVectorTableAlignment = 512
        OsInterruptVectorTableAlignment = 512
        OsHardwareManuals = RH850/E1x-FCC2 Users Manual: Hardware Rev.1.00 Jun 2016 RH850G3MH Users Manual: Software Rev.1.00 Mar 2015 RH850G3K Users Manual: Software Rev.1.20 Apr 2016
        CORE0 (OsPhysicalCore):
          OsPhysicalCoreId = 0
          OsPhysicalCoreDefaultEntrySymbol = RESET_CORE0
          OsPhysicalCoreType = G3MH
          OsPhysicalCoreExceptionSources = 16
          OsPhysicalCoreIsAutostart = 1
          OsPhysicalCoreMasterStartAllowed = 0
          OsPhysicalCorePrivelegedHwAccess = 1
          OsPhysicalCoreStackProtectionUnit = MPU_CORE0
          MPU_CORE0 (OsPhysicalCoreMpu): OsPhysicalCoreMpuId=0, OsPhysicalCoreMpuMaxRegions=16, OsPhysicalCoreMpuType=CoreMpu
        OSTM0 (OsHardwareTimer): OsHardwareTimerBaseAddress=4293656576, OsHardwareTimerUnit=FRTPIT, OsHardwareTimerSize=32, OsHardwareTimerId=0, OsHardwareTimerType=OSTM
          OSTM0 (OsHardwareTimerChannel): OsHardwareTimerChannelIntSource=25, OsHardwareTimerChannelOffset=0, OsHardwareTimerChannelId=0
        OSTM1 (OsHardwareTimer): OsHardwareTimerBaseAddress=4293660672, OsHardwareTimerUnit=FRTPIT, OsHardwareTimerSize=32, OsHardwareTimerId=1, OsHardwareTimerType=OSTM
          OSTM1 (OsHardwareTimerChannel): OsHardwareTimerChannelIntSource=26, OsHardwareTimerChannelOffset=0, OsHardwareTimerChannelId=0
        INTC (OsSystemIntCtrl): OsSystemIntCtrlBaseAddress=4294896128, OsSystemIntCtrlMaxPrios=16, OsSystemIntCtrlMaxSources=512, OsSystemIntCtrlPrioOrder=DESC
          5 x OsSystemIntCtrlAddress:
            INTC1: OsSystemIntCtrlAddressValue=4294896128
            INTC2: OsSystemIntCtrlAddressValue=4294946816
            EIBD1: OsSystemIntCtrlAddressValue=4294896384
            EIBD2: OsSystemIntCtrlAddressValue=4294948864
            IPIR: OsSystemIntCtrlAddressValue=4294896768
        CORE1 (OsPhysicalCore):
          OsPhysicalCoreId = 1
          OsPhysicalCoreDefaultEntrySymbol = RESET_CORE1
          OsPhysicalCoreType = G3MH
          OsPhysicalCoreExceptionSources = 16
          OsPhysicalCoreIsAutostart = 1
          OsPhysicalCoreMasterStartAllowed = 0
          OsPhysicalCorePrivelegedHwAccess = 0
          OsPhysicalCoreStackProtectionUnit = MPU_CORE1
          MPU_CORE1 (OsPhysicalCoreMpu): OsPhysicalCoreMpuId=1, OsPhysicalCoreMpuMaxRegions=16, OsPhysicalCoreMpuType=CoreMpu
        MPAT (OsMemoryRegionSpecifics)
          6 x OsMemoryRegionAccess:
            SR: OsMemoryRegionAccessRights=R, OsMemoryRegionAccessType=SUPERVISOR
            SW: OsMemoryRegionAccessRights=W, OsMemoryRegionAccessType=SUPERVISOR
            SX: OsMemoryRegionAccessRights=X, OsMemoryRegionAccessType=SUPERVISOR
            UR: OsMemoryRegionAccessRights=R, OsMemoryRegionAccessType=USER
            UW: OsMemoryRegionAccessRights=W, OsMemoryRegionAccessType=USER
            UX: OsMemoryRegionAccessRights=X, OsMemoryRegionAccessType=USER
        OSTM2 (OsHardwareTimer): OsHardwareTimerBaseAddress=4293664768, OsHardwareTimerUnit=FRTPIT, OsHardwareTimerSize=32, OsHardwareTimerId=2, OsHardwareTimerType=OSTM
          OSTM2 (OsHardwareTimerChannel): OsHardwareTimerChannelIntSource=27, OsHardwareTimerChannelOffset=0, OsHardwareTimerChannelId=0
        OSTM3 (OsHardwareTimer):
          OsHardwareTimerBaseAddress = 4293668864
          OsHardwareTimerHighResPossible = 1
          OsHardwareTimerUnit = FRTPIT
          OsHardwareTimerSize = 32
          OsHardwareTimerId = 3
          OsHardwareTimerType = OSTM
          OSTM3 (OsHardwareTimerChannel): OsHardwareTimerChannelIntSource=28, OsHardwareTimerChannelOffset=0, OsHardwareTimerChannelId=0
        DEFAULT (OsInterruptSupportedType): OsInterruptSupportedTypeSeparateSources=0
