AUTOSAR XML (schema 4-2-1)
package /MICROSAR
  module config Os_Pre: definition=Os
    OsPublishedInformation
      RH850F1L (OsDerivativeInformation):
        OsMpuAlignment = 4
        OsStackAlignment = 4
        OsExceptionVectorTableAlignment = 512
        OsInterruptVectorTableAlignment = 512
        OsHardwareManuals = RH850/F1L Group Users Manual: Hardware Rev.1.33 Apr 2016 RH850G3K Users Manual: Software Rev.1.20 Apr 2016
        CORE0 (OsPhysicalCore):
          OsPhysicalCoreId = 0
          OsPhysicalCoreDefaultEntrySymbol = RESET_CORE0
          OsPhysicalCoreType = G3K
          OsPhysicalCoreExceptionSources = 16
          OsPhysicalCoreIsAutostart = 1
          OsPhysicalCoreMasterStartAllowed = 0
          OsPhysicalCorePrivelegedHwAccess = 1
          OsPhysicalCoreStackProtectionUnit = MPU_CORE0
          MPU_CORE0 (OsPhysicalCoreMpu): OsPhysicalCoreMpuId=0, OsPhysicalCoreMpuMaxRegions=4, OsPhysicalCoreMpuType=CoreMpu
        3 x OsHardwareTimer, all with OsHardwareTimerSize=32:
          OSTM0: OsHardwareTimerBaseAddress=4293656576, OsHardwareTimerUnit=FRTPIT, OsHardwareTimerId=0, OsHardwareTimerType=OSTM
            OSTM0 (OsHardwareTimerChannel): OsHardwareTimerChannelIntSource=76, OsHardwareTimerChannelOffset=0, OsHardwareTimerChannelId=0
          TAUJ0: OsHardwareTimerBaseAddress=4293197824, OsHardwareTimerUnit=PIT, OsHardwareTimerId=0, OsHardwareTimerType=TAUJ
            4 x OsHardwareTimerChannel:
              TAUJ0_CH0: OsHardwareTimerChannelIntSource=72, OsHardwareTimerChannelOffset=0, OsHardwareTimerChannelId=0
              TAUJ0_CH1: OsHardwareTimerChannelIntSource=73, OsHardwareTimerChannelOffset=1, OsHardwareTimerChannelId=1
              TAUJ0_CH2: OsHardwareTimerChannelIntSource=74, OsHardwareTimerChannelOffset=2, OsHardwareTimerChannelId=2
              TAUJ0_CH3: OsHardwareTimerChannelIntSource=75, OsHardwareTimerChannelOffset=3, OsHardwareTimerChannelId=3
          TAUJ1: OsHardwareTimerBaseAddress=4293201920, OsHardwareTimerUnit=PIT, OsHardwareTimerId=1, OsHardwareTimerType=TAUJ
            4 x OsHardwareTimerChannel:
              TAUJ1_CH0: OsHardwareTimerChannelIntSource=160, OsHardwareTimerChannelOffset=0, OsHardwareTimerChannelId=0
              TAUJ1_CH1: OsHardwareTimerChannelIntSource=161, OsHardwareTimerChannelOffset=1, OsHardwareTimerChannelId=1
              TAUJ1_CH2: OsHardwareTimerChannelIntSource=162, OsHardwareTimerChannelOffset=2, OsHardwareTimerChannelId=2
              TAUJ1_CH3: OsHardwareTimerChannelIntSource=163, OsHardwareTimerChannelOffset=3, OsHardwareTimerChannelId=3
        INTC (OsSystemIntCtrl): OsSystemIntCtrlBaseAddress=4294938624, OsSystemIntCtrlMaxPrios=8, OsSystemIntCtrlMaxSources=512, OsSystemIntCtrlPrioOrder=DESC
          5 x OsSystemIntCtrlAddress:
            INTC1: OsSystemIntCtrlAddressValue=4294938624
            INTC2: OsSystemIntCtrlAddressValue=4294942720
            EIBD1: OsSystemIntCtrlAddressValue=0
            EIBD2: OsSystemIntCtrlAddressValue=0
            IPIR: OsSystemIntCtrlAddressValue=0
        MPAT (OsMemoryRegionSpecifics)
          3 x OsMemoryRegionAccess, all with OsMemoryRegionAccessType=USER:
            UR: OsMemoryRegionAccessRights=R
            UW: OsMemoryRegionAccessRights=W
            UX: OsMemoryRegionAccessRights=X
        DEFAULT (OsInterruptSupportedType): OsInterruptSupportedTypeSeparateSources=0
