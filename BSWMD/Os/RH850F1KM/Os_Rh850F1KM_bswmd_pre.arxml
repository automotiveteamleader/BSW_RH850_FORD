AUTOSAR XML (schema 4-2-1)
package /MICROSAR
  module config Os_Pre: definition=Os
    OsPublishedInformation
      RH850F1KM (OsDerivativeInformation):
        OsMpuAlignment = 4
        OsStackAlignment = 4
        OsExceptionVectorTableAlignment = 512
        OsInterruptVectorTableAlignment = 512
        OsHardwareManuals = RH850/F1KM Group Users Manual: Hardware Rev.0.50 Jan 2017 RH850G3KH Users Manual: Software Rev.1.10 Jul 2016
        CORE0 (OsPhysicalCore):
          OsPhysicalCoreId = 0
          OsPhysicalCoreDefaultEntrySymbol = RESET_CORE0
          OsPhysicalCoreType = G3KH
          OsPhysicalCoreExceptionSources = 16
          OsPhysicalCoreIsAutostart = 1
          OsPhysicalCoreMasterStartAllowed = 0
          OsPhysicalCorePrivelegedHwAccess = 1
          OsPhysicalCoreStackProtectionUnit = MPU_CORE0
          MPU_CORE0 (OsPhysicalCoreMpu): OsPhysicalCoreMpuId=0, OsPhysicalCoreMpuMaxRegions=16, OsPhysicalCoreMpuType=CoreMpu
        3 x OsHardwareTimer, all with OsHardwareTimerSize=32:
          OSTM0: OsHardwareTimerBaseAddress=4292280320, OsHardwareTimerUnit=FRTPIT, OsHardwareTimerId=0, OsHardwareTimerType=OSTM
            OSTM0 (OsHardwareTimerChannel): OsHardwareTimerChannelIntSource=84, OsHardwareTimerChannelOffset=0, OsHardwareTimerChannelId=0
          TAUJ0: OsHardwareTimerBaseAddress=4293197824, OsHardwareTimerUnit=PIT, OsHardwareTimerId=0, OsHardwareTimerType=TAUJ
            4 x OsHardwareTimerChannel:
              TAUJ0_CH0: OsHardwareTimerChannelIntSource=80, OsHardwareTimerChannelOffset=0, OsHardwareTimerChannelId=0
              TAUJ0_CH1: OsHardwareTimerChannelIntSource=81, OsHardwareTimerChannelOffset=1, OsHardwareTimerChannelId=1
              TAUJ0_CH2: OsHardwareTimerChannelIntSource=82, OsHardwareTimerChannelOffset=2, OsHardwareTimerChannelId=2
              TAUJ0_CH3: OsHardwareTimerChannelIntSource=83, OsHardwareTimerChannelOffset=3, OsHardwareTimerChannelId=3
          TAUJ1: OsHardwareTimerBaseAddress=4293201920, OsHardwareTimerUnit=PIT, OsHardwareTimerId=1, OsHardwareTimerType=TAUJ
            4 x OsHardwareTimerChannel:
              TAUJ1_CH0: OsHardwareTimerChannelIntSource=168, OsHardwareTimerChannelOffset=0, OsHardwareTimerChannelId=0
              TAUJ1_CH1: OsHardwareTimerChannelIntSource=169, OsHardwareTimerChannelOffset=1, OsHardwareTimerChannelId=1
              TAUJ1_CH2: OsHardwareTimerChannelIntSource=170, OsHardwareTimerChannelOffset=2, OsHardwareTimerChannelId=2
              TAUJ1_CH3: OsHardwareTimerChannelIntSource=171, OsHardwareTimerChannelOffset=3, OsHardwareTimerChannelId=3
        INTC (OsSystemIntCtrl): OsSystemIntCtrlBaseAddress=4294896128, OsSystemIntCtrlMaxPrios=16, OsSystemIntCtrlMaxSources=512, OsSystemIntCtrlPrioOrder=DESC
          5 x OsSystemIntCtrlAddress:
            INTC1: OsSystemIntCtrlAddressValue=4294896128
            INTC2: OsSystemIntCtrlAddressValue=4294946816
            EIBD1: OsSystemIntCtrlAddressValue=0
            EIBD2: OsSystemIntCtrlAddressValue=0
            IPIR: OsSystemIntCtrlAddressValue=0
        MPAT (OsMemoryRegionSpecifics)
          6 x OsMemoryRegionAccess:
            SR: OsMemoryRegionAccessRights=R, OsMemoryRegionAccessType=SUPERVISOR
            SW: OsMemoryRegionAccessRights=W, OsMemoryRegionAccessType=SUPERVISOR
            SX: OsMemoryRegionAccessRights=X, OsMemoryRegionAccessType=SUPERVISOR
            UR: OsMemoryRegionAccessRights=R, OsMemoryRegionAccessType=USER
            UW: OsMemoryRegionAccessRights=W, OsMemoryRegionAccessType=USER
            UX: OsMemoryRegionAccessRights=X, OsMemoryRegionAccessType=USER
        TAUJ2 (OsHardwareTimer): OsHardwareTimerBaseAddress=4293198080, OsHardwareTimerUnit=PIT, OsHardwareTimerSize=32, OsHardwareTimerId=2, OsHardwareTimerType=TAUJ
          4 x OsHardwareTimerChannel:
            TAUJ2_CH0: OsHardwareTimerChannelIntSource=277, OsHardwareTimerChannelOffset=0, OsHardwareTimerChannelId=0
            TAUJ2_CH1: OsHardwareTimerChannelIntSource=278, OsHardwareTimerChannelOffset=1, OsHardwareTimerChannelId=1
            TAUJ2_CH2: OsHardwareTimerChannelIntSource=279, OsHardwareTimerChannelOffset=2, OsHardwareTimerChannelId=2
            TAUJ2_CH3: OsHardwareTimerChannelIntSource=280, OsHardwareTimerChannelOffset=3, OsHardwareTimerChannelId=3
        TAUJ3 (OsHardwareTimer): OsHardwareTimerBaseAddress=4293202176, OsHardwareTimerUnit=PIT, OsHardwareTimerSize=32, OsHardwareTimerId=3, OsHardwareTimerType=TAUJ
          4 x OsHardwareTimerChannel:
            TAUJ3_CH0: OsHardwareTimerChannelIntSource=281, OsHardwareTimerChannelOffset=0, OsHardwareTimerChannelId=0
            TAUJ3_CH1: OsHardwareTimerChannelIntSource=282, OsHardwareTimerChannelOffset=1, OsHardwareTimerChannelId=1
            TAUJ3_CH2: OsHardwareTimerChannelIntSource=283, OsHardwareTimerChannelOffset=2, OsHardwareTimerChannelId=2
            TAUJ3_CH3: OsHardwareTimerChannelIntSource=284, OsHardwareTimerChannelOffset=3, OsHardwareTimerChannelId=3
        DEFAULT (OsInterruptSupportedType): OsInterruptSupportedTypeSeparateSources=0
