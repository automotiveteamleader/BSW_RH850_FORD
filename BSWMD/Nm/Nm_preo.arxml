AUTOSAR XML (schema 4-0-3)
package /MICROSAR
  module config Nm_Pre: definition=Nm
    NmGlobalConfig
      NmGlobalFeatures: NmCarWakeUpRxEnabled=0, NmUserDataEnabled=1, NmComUserDataSupport=0
  module config Nm_Rec: definition=Nm, implementation-config-variant=VARIANT-PRE-COMPILE
    NmGlobalConfig
      NmGlobalFeatures:
        NmRemoteSleepIndEnabled = 1
        NmRepeatMsgIndEnabled = 0
        NmStateChangeIndEnabled = 1
        NmNodeDetectionEnabled = 0
        NmBusSynchronizationEnabled = 1
        NmNodeIdEnabled = 0
  module config Nm_Pre_Class1: definition=Nm
    NmChannelConfig: NmPassiveModeEnabled=0, NmShutdownDelayTimer=0, NmStateReportEnabled=0, NmChannelSleepMaster=0
