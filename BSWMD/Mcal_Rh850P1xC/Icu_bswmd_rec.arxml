AUTOSAR XML (schema 4-0-3)
package /Renesas/EcucDefs_Icu
  module config Icu_Rec: definition=Icu, implementation-config-variant=VARIANT-POST-BUILD
    IcuGeneral: IcuVersionCheckExternalModules=0
  bsw implementation Icu_Impl: programming-language=C, used-code-generator=EXTERNAL, behavior=IcuBehavior, recommended-configuration=Icu_Rec, vendor-specific-module-def=Icu
