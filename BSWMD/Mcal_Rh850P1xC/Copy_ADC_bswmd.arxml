AUTOSAR XML (schema 4-0-3)
# COPYRIGHT
# Copyright(c) 2015-2017 Renesas Electronics Corporation
package /Renesas/EcucDefs_Adc
  ecuc definition collection RenesasParameterDefinition_Adc: module=Adc
  module definition Adc: refined-module-def=Adc, variants post-build  # Configuration of ADC (Analog Digital Conversion) module.
    container AdcDemEventParameterRefs [0..1]  # Container for the references to DemEventParameter elements which shall be invoked using the API Dem_ReportErrorStatus in case the corresponding error occurs. The EventId is taken from the referenced DemEventParameter's DemEventId value. | The standardized errors are provided in the container and can be extended by vendor-specific error references.
      symbolic name reference ADC_E_ID_FAILURE [0..1]: set at pre-compile, origin=Renesas_v1.0.0, destination=DemEventParameter  # This parameter specifies the reference to the DemEventParameter which shall be issued when the ID error is generated.
      symbolic name reference ADC_E_PARITY_FAILURE [0..1]: set at pre-compile, origin=Renesas_v1.0.0, destination=DemEventParameter  # This parameter specifies the reference to the DemEventParameter which shall be issued when the parity error is generated.
      symbolic name reference ADC_E_ULE_FAILURE [0..1]: set at pre-compile, origin=Renesas_v1.0.0, destination=DemEventParameter  # This parameter specifies the reference to the DemEventParameter which shall be issued when the upper limit lower limit error is generated.
      symbolic name reference ADC_E_DMA_FAILURE [0..1]: set at pre-compile, origin=Renesas_v1.0.1, destination=DemEventParameter  # This parameter specifies the reference to the DemEventParameter which shall be issued when the DMA transfer error is generated.
      symbolic name reference ADC_E_INT_INCONSISTENT [0..1]: set at pre-compile, origin=Renesas_v1.0.1, destination=DemEventParameter  # This parameter specifies the reference to the DemEventParameter which shall be issued when interrupt inconsistency is detected.
      symbolic name reference ADC_E_REG_WRITE_VERIFY [0..1]: set at pre-compile, origin=Renesas_v1.0.1, destination=DemEventParameter  # This parameter specifies the reference to the DemEventParameter which shall be issued when register write verification is failed.
    container AdcPublishedInformation  # Additional published parameters not covered by CommonPublishedInformation container. | Note that these parameters do not have any configuration class setting, since they are published information.
      boolean AdcChannelValueSigned: set at published-information, default-value=false  # Information whether the result value of the ADC driver has sign information (true) or not (false). If the result shall be interpreted as signed value it shall apply to C-language rules. | true: The result value of the ADC driver has sign information. false: The result value of the ADC driver does not have sign information.
      boolean AdcGroupFirstChannelFixed: set at published-information, default-value=false  # Information whether the first channel of an ADC Channel group can be configured (false) or is fixed (true) to a value determined by the ADC HW Unit. | true: The first channel of an ADC Channel group is fixed. false: The first channel of an ADC Channel group can be configured.
      integer AdcMaxChannelResolution: 12..12, set at published-information, default-value=12  # Maximum Channel resolution in bits (does not specify accuracy).
    container AdcGeneral  # General configuration (parameters) of the ADC Driver software module.
      boolean AdcVersionCheckExternalModules: set at pre-compile, origin=Renesas_v1.0.0, default-value=true  # Enable / disable AUTOSAR Version check for inter-module dependencies. | true: AUTOSAR Version check for inter-module dependencies is enabled. false: AUTOSAR Version check for inter-module dependencies is disabled.
      boolean AdcDeInitApi: set at pre-compile, default-value=false  # Adds / removes the service Adc_DeInit() from the code. | true: Adc_DeInit() can be used. false: Adc_DeInit() cannot be used.
      boolean AdcDevErrorDetect: set at pre-compile, default-value=false  # Switches the Development Error Detection and Notification ON or OFF. | true: Enables the Development Error Detection and Notification. false: Disables the Development Error Detection and Notification.
      boolean AdcEnableLimitCheck: set at pre-compile, default-value=false  # Enables or disables limit checking feature in the ADC driver. | true: Enables limit checking feature. false: Disables limit checking feature.
      boolean AdcEnableSelfDiag: set at pre-compile, origin=Renesas_v1.0.1, default-value=false  # Enables or disables Self diagnostic in the ADC driver. | true: Enables Self diagnostic feature. false: Disables Self diagnostic feature.
      boolean AdcEnableQueuing: set at pre-compile, default-value=false  # Determines, if the queuing mechanism is active in case of priority mechanism disabled. | Note: If priority mechanism is enabled, queuing mechanism is always active and the parameter ADC_ENABLE_QUEUING is not evaluated. true: The queuing mechanism is active in case of priority mechanism enabled. false: The queuing mechanism is not active in case of priority mechanism disabled.
      boolean AdcEnableStartStopGroupApi: set at pre-compile, default-value=true  # Adds / removes the services Adc_StartGroupConversion() and Adc_StopGroupConversion() from the code. | true: Adc_StartGroupConversion() and Adc_StopGroupConversion() can be used. false: Adc_StartGroupConversion() and Adc_StopGroupConversion() cannot be used.
      boolean AdcGrpNotifCapability: set at pre-compile, default-value=false  # Determines, if the group notification mechanism (the functions to enable and disable the notifications) is available at runtime. | true: Group notification mechanism is available at runtime. false: Group notification mechanism is not available at runtime.
      boolean AdcHwTriggerApi: set at pre-compile, default-value=false  # Adds / removes the services Adc_EnableHardwareTrigger() and Adc_DisableHardwareTrigger() from the code. | true: Adc_EnableHardwareTrigger() and Adc_DisableHardwareTrigger() can be used. false: Adc_EnableHardwareTrigger() and Adc_DisableHardwareTrigger() cannot be used.
      enumeration AdcPriorityImplementation: {ADC_PRIORITY_HW, ADC_PRIORITY_HW_SW, ADC_PRIORITY_NONE}, set at pre-compile, default-value=ADC_PRIORITY_NONE  # This parameter specifies the Priority implementation | ADC_PRIORITY_NONE: No priority mechanism. ADC_PRIORITY_HW_SW: Priority is handled by Hardware and software. ADC_PRIORITY_HW: Priority is handled by hardware.
      enumeration AdcFunctionalityMode: {ADC_INTERRUPT_MODE, ADC_POLLING_MODE, ADC_POLLING_INTERRUPT_MODE}, set at pre-compile, origin=Renesas_v1.0.0, default-value=ADC_POLLING_INTERRUPT_MODE  # This parameter provides the selection of functionality mode. | ADC_INTERRUPT_MODE: All the groups will work in interrupt mode.(The value configured for parameter AdcSgProcessingMode in the container AdcHwScanGroup will be ignored if it is configured other than ADC_INTERRUPT_MODE) ADC_POLLING_MODE: All the groups will work in polling mode.(The value configured for parameter AdcSgProcessingMode in the container AdcHwScanGroup will be ignored if it is configured other than ADC_POLLING_MODE) ADC_POLLING_INTERRUPT_MODE: Groups configured as ADC_POLLING_MODE will work in polling mode and Groups configured as ADC_INTERRUPT_MODE will work in interrupt mode based on the configuration of parameter AdcSgProcessingMode in the container AdcHwScanGroup
      boolean AdcReadGroupApi: set at pre-compile, default-value=false  # Adds / removes the service Adc_ReadGroup() from the code. | true: Adc_ReadGroup() can be used. false: Adc_ReadGroup() cannot be used.
      boolean AdcEnableAdTimer: set at pre-compile, origin=Renesas_v1.0.1, default-value=false  # Adds / removes the AD timer functionality from the code. | true: AD timer functionality can be used. false: AD timer functionality cannot be used.
      boolean AdcGetStreamLastPointerApi: set at pre-compile, origin=Renesas_v1.0.0, default-value=false  # Adds / removes the service Adc_GetStreamLastPointer() from the code. | true: Adc_GetStreamLastPointer() can be used. false: Adc_GetStreamLastPointer() cannot be used.
      boolean AdcDmaMode: set at pre-compile, origin=Renesas_v1.0.0, default-value=false  # This parameter enables / disables the DMA functionality of the ADC driver. | true: Enable the DMA functionality of the ADC driver. false: Disable the DMA functionality of the ADC driver.
      boolean AdcCriticalSectionProtection: set at pre-compile, origin=Renesas_v1.0.0, default-value=true  # This parameter specifies if the ADC driver CPU load can be reduced by disabling the enter/exit critical section functionality by adding a precompiled configuration parameter to the ADC driver configuration. | true: Enables the critical section functionality for the restricted area. false: Disables the critical section functionality for the restricted area.
      enumeration AdcResultAlignment: {ADC_ALIGN_LEFT, ADC_ALIGN_RIGHT}, set at pre-compile, default-value=ADC_ALIGN_RIGHT  # This parameter is used for alignment of ADC Conversion results either Right alignment or Left Alignment. | ADC_ALIGN_RIGHT: Result will be stored in the bits 11-0. ADC_ALIGN_LEFT: Result will be stored in the bits 14-3.
      enumeration AdcDeviceName: {R7F701370A, R7F701371, R7F701372, R7F701373, R7F701374}, set at pre-compile, origin=Renesas_v1.0.0, default-value=R7F701372  # This parameter contains the supported device name to identify the device specific C header file.
      boolean AdcVersionInfoApi: set at pre-compile, default-value=false  # Adds / removes the service Adc_GetVersionInfo() from the code. | true: Adc_GetVersionInfo() can be used. false: Adc_GetVersionInfo() cannot be used.
      boolean AdcExternalMuxSupport: set at pre-compile, origin=Renesas_v1.0.0, default-value=false  # Enables or disables external multiplexer functionality. | true: Enables external multiplexer functionality. false: Disables external multiplexer functionality.
      boolean AdcEnableDisableChSupport: set at pre-compile, origin=Renesas_v1.0.0, default-value=false  # Adds / removes the services Adc_EnableChannel() and Adc_DisableChannel() from the code. | true: Adc_EnableChannel() and Adc_DisableChannel() can be used. false: Adc_EnableChannel() and Adc_DisableChannel() cannot be used.
      boolean AdcAlreadyInitDetCheck: set at pre-compile, origin=Renesas_v1.0.0, default-value=true  # This parameter enables / disables the ADC_E_ALREADY_INITIALIZED Det check in Adc_Init API. | true: Enables the ADC_E_ALREADY_INITIALIZED Det check in Adc_Init API. false: Disables the ADC_E_ALREADY_INITIALIZED Det check in Adc_Init API. For re-initialization of Driver, this parameter is to be set as false to suppress the check for ADC_E_ALREADY_INITIALIZED Det error. This parameter has no impact when DET is disabled.
      boolean AdcEnableBufferAllocation: set at pre-compile, origin=Renesas_v1.0.1, default-value=false  # Enables / disables the RAM allocation for result data. | true: Driver allocates the result buffer without calling the Adc_SetupResultBuffer API. false: Driver allocates the result buffer by calling the Adc_SetupResultBuffer API.
      enumeration AdcHwUnitVirtualChannel: {ADC_36_36}, set at pre-compile, origin=Renesas_v1.0.0, default-value=ADC_36_36  # This parameter specifies the number of virtual channels supported by hardware unit. | ADC_36_36: The maximum virtual channels supported by hardware unit 0 is 36 and hardware unit 1 is 36
      boolean AdcEnableStreaming: set at pre-compile, origin=Renesas_v1.0.0, default-value=false  # This parameter enables / disables the streaming functionality. This parameter can be set to false if all groups in the configuration sets are set as AdcGroupAccessMode = ADC_ACCESS_MODE_SINGLE. This will speed up the Driver runtime | true: Streaming functionality is enabled. false: Streaming functionality is disabled.
      boolean AdcInterruptConsistencyCheck: set at pre-compile, origin=Renesas_v1.0.1, default-value=false  # This parameter enables / disables the Interrupt Consistency Check functionality. | true: Interrupt Consistency Checks are enabled. false: Interrupt Consistency Checks are disabled.
      enumeration AdcWriteVerify: {ADC_WV_DISABLED, ADC_WV_INIT_ONLY, ADC_WV_INIT_AND_RUNTIME}, set at pre-compile, origin=Renesas_v1.0.1, default-value=ADC_WV_DISABLED  # This parameter enables selection and support of INIT_ONLY or INIT_AND_RUNTIME register read-back functionality of Adc registers. | ADC_WV_INIT_ONLY: Enables read-back functionality on static registers. ADC_WV_INIT_AND_RUNTIME: Enables read-back functionality on static and dynamic registers. ADC_WV_DISABLED: Disables the register read back functionality for Adc registers.
      enumeration AdcDmacWriteVerify: {ADC_DMAC_WV_DISABLED, ADC_DMAC_WV_INIT_ONLY, ADC_DMAC_WV_INIT_AND_RUNTIME}, set at pre-compile, origin=Renesas_v1.0.1, default-value=ADC_DMAC_WV_DISABLED  # This parameter enables selection and support of INIT_ONLY or INIT_AND_RUNTIME register read-back functionality of Dmac registers. | ADC_DMAC_WV_INIT_ONLY: Enables read-back functionality on static registers. ADC_DMAC_WV_INIT_AND_RUNTIME: Enables read-back functionality on static and dynamic registers. ADC_DMAC_WV_DISABLED: Disables the register read back functionality for Dma registers.
      enumeration AdcPic2cWriteVerify: {ADC_PIC2C_WV_DISABLED, ADC_PIC2C_WV_INIT_ONLY, ADC_PIC2C_WV_INIT_AND_RUNTIME}, set at pre-compile, origin=Renesas_v1.0.1, default-value=ADC_PIC2C_WV_DISABLED  # This parameter enables selection and support of INIT_ONLY or INIT_AND_RUNTIME register read-back functionality of Pic registers. | ADC_PIC2C_WV_INIT_ONLY: Enables read-back functionality on static registers. ADC_PIC2C_WV_INIT_AND_RUNTIME: Enables read-back functionality on static and dynamic registers. ADC_PIC2C_WV_DISABLED: Disables the register read back functionality for Pic registers.
      boolean AdcUseWriteVerifyErrorInterface: set at pre-compile, origin=Renesas_v1.0.1, default-value=false  # This parameter specifies whether user can configure error notification interface instead of DEM error for Write-Verify functionality. | true: user can configure error notification interface via AdcWriteVerifyErrorInterface parameter. false: Error notification for Write-Verify functionality shall be handled via DEM error.
      function name AdcWriteVerifyErrorInterface [0..1]: set at post-build, origin=Renesas_v1.0.1, default-value=NULL, regular-expression=[a-zA-Z][a-zA-Z0-9_]*  # This parameter is used to configure the name of the error notification which shall be called with the ApiID and ErrorId when there is a Write Verify error.
    container AdcConfigSet: multiple-configuration-container=true  # This is the base container that contains the post-build selectable configuration parameters.
      container AdcHwUnit [1..2]  # This container contains the Driver configuration (parameters) depending on grouping of channels. | This container could contain HW specific parameters which are not defined in the Standardized Module Definition. They must be added in the Vendor Specific Module Definition.
        enumeration AdcClockSource [0..1]: {NOT_USED}, set at post-build, default-value=NOT_USED  # The ADC module specific clock input for the conversion unit can statically be configured to select different clock sources. Hardware does not support any clock source. Hence this parameter is not used for implementation. | Enumeration literals are defined vendor specific.
        enumeration AdcHwUnitId: {ADC_HWUNIT_0, ADC_HWUNIT_1}, set at post-build, default-value=ADC_HWUNIT_0  # Numeric ID of the HW Unit. This symbolic name allows accessing HW Unit data. Enumeration literals are defined vendor specific. | ADC_HWUNIT_0: ADC Hardware Unit 0. ADC_HWUNIT_1: ADC Hardware Unit 1.
        integer AdcPrescale [0..1]: 0..65535, set at post-build, default-value=0  # Optional ADC module specific clock prescale factor. Hardware does not support prescale settings. Hence this parameter is not used for implementation. | ImplementationType: Adc_PrescaleType.
        enumeration AdcHwUnitResolution: {ADC_12_BIT}, set at post-build, origin=Renesas_v1.0.0, default-value=ADC_12_BIT  # This parameter specifies the channel resolution for all the channels within the HW unit. | ADC_12_BIT: HW Unit Resolution is selected as 12 bits.
        enumeration AdcSuspendMode [0..1]: {ADC_SYNCHRONOUS_SUSPEND, ADC_ASYNCHRONOUS_SUSPEND}, set at post-build, origin=Renesas_v1.0.0, default-value=ADC_SYNCHRONOUS_SUSPEND  # This parameter specifies the suspend method used when a higher-priority scan group interrupts a lower-priority scan group. | ADC_SYNCHRONOUS_SUSPEND: ADC channel group transition from lower priority SGm conversion to higher priority SGm group after current A/D channel conversion is finished. ADC_ASYNCHRONOUS_SUSPEND: ADC channel group transition from lower priority SGm conversion to higher priority SGm group immediately.
        boolean AdcEnableInterruptError [0..1]: set at pre-compile, origin=Renesas_v1.0.0, default-value=false  # This parameter enables / disables the error interrupt.
        boolean AdcIdErrIntEnable: set at pre-compile, origin=Renesas_v1.0.1, default-value=false  # Switches the ID Error Interrupt ON or OFF. | true: Enables ID Error Interrupt. false: Disables ID Error Interrupt. Parameter AdcEnableInterruptError should be configured as True when this parameter is configured as True.
        boolean AdcParityErrIntEnable: set at pre-compile, origin=Renesas_v1.0.1, default-value=false  # Switches the Parity Error Interrupt ON or OFF. | true: Enables the Parity Error Interrupt. false: Disables the Parity Error Interrupt. Parameter AdcEnableInterruptError should be configured as True when this parameter is configured as True.
        boolean AdcUlmtLlmtErrIntEnable: set at pre-compile, origin=Renesas_v1.0.1, default-value=false  # Switches the Upper-Limit / Lower-Limit Error Interrupt ON or OFF. | true: Enables the Upper-Limit / Lower-Limit Error Interrupt. false: Disables the Upper-Limit / Lower-Limit Error Interrupt. Parameter AdcEnableInterruptError should be configured as True when this parameter is configured as True. Parameter AdcEnableLimitCheck should be configured as true when this parameter is configured as true.
        function name AdcErrorNotification [0..1]: set at post-build, origin=Renesas_v1.0.1, default-value=NULL, regular-expression=[a-zA-Z][a-zA-Z0-9_]*  # Callback function for each HW unit.
        container AdcHwScanGroup [1..5]  # This container contains the Scan Group configuration (parameters) depending on the hardware capability.
          integer AdcSgQueueSize [0..1]: 0..255, set at post-build, origin=Renesas_v1.0.0, default-value=0  # This parameter specifies configuration of queue size. It is based on the Software trigger groups.
          enumeration AdcSgDmaChannel [0..1]: {DMA00, DMA01, DMA02, DMA03, DMA04, DMA05, DMA06, DMA07, DMA08, DMA09, DMA10, DMA11, DMA12, DMA13, DMA14, DMA15}, set at pre-compile, origin=Renesas_v1.0.0, default-value=DMA00  # This parameter specifies the DMA channel to transfer the conversion results of channel groups mapped to SG units. | DMA00: DMA Channel Id 0. DMA01: DMA Channel Id 1. DMA02: DMA Channel Id 2. DMA03: DMA Channel Id 3. DMA04: DMA Channel Id 4. DMA05: DMA Channel Id 5. DMA06: DMA Channel Id 6. DMA07: DMA Channel Id 7. DMA08: DMA Channel Id 8. DMA09: DMA Channel Id 9. DMA10: DMA Channel Id 10. DMA11: DMA Channel Id 11. DMA12: DMA Channel Id 12. DMA13: DMA Channel Id 13. DMA14: DMA Channel Id 14. DMA15: DMA Channel Id 15. NOTE: DMA channel ID's DMA00 to DMA07 is for Hardware unit 0. DMA channel ID's DMA08 to DMA15 is for Hardware unit 1.
          enumeration AdcSgProcessingMode: {ADC_INTERRUPT_MODE, ADC_POLLING_MODE}, set at post-build, origin=Renesas_v1.0.0, default-value=ADC_INTERRUPT_MODE  # This parameter selects the mode of HW unit conversion. | ADC_INTERRUPT_MODE: Groups mapped to SG Unit, will work in interrupt mode. ADC_POLLING_MODE: Groups mapped to SG Unit, will work in polling mode. NOTE: The value configured for this parameter will be considered when the value of the parameter AdcFunctionalityMode in AdcGeneral container is configured as ADC_POLLING_INTERRUPT_MODE. Otherwise the value configured for this parameter will be ignored if the parameter AdcFunctionalityMode in AdcGeneral container is configured as ADC_INTERRUPT_MODE or ADC_POLLING_MODE.
          integer AdcSgId: 0..4, set at pre-compile, origin=Renesas_v1.0.0, default-value=0  # This parameter selects the Scan Group ID. | 0: Scan Group ID selected is 0. 1: Scan Group ID selected is 1. 2: Scan Group ID selected is 2. 3: Scan Group ID selected is 3. 4: Scan Group ID selected is 4.
        container AdcChannel [1..256]  # This container contains the channel configuration (parameters) depending on the hardware capability. | The organization of this data structure could contain dependencies to the microcontroller so this is left up to the implementer and its location is left up to the configuration. Note: Since a AdcChannel can be part of several AdcGroups, this container is not realized as a subcontainer of AdcGroup but instead as a subcontainer of AdcHwUnit.
          integer AdcChannelConvTime [0..1]: 0..18446744073709551615, set at post-build, default-value=0  # Configuration of conversion time, i.e. the time during which the analogue value is converted into digital representation, (in clock cycles) for each channel. Conversion time for each channel is not supported as per hardware. Hence this parameter is not used for implementation. | ImplementationType: Adc_ConversionTimeType
          integer AdcChannelHighLimit [0..1]: 0..4095, set at pre-compile, default-value=4095  # High limit - used for limit checking.
          integer AdcChannelId: 0..19, set at post-build, default-value=0  # This parameter defines the assignment of the channel to the physical ADC hardware channel. | ImplementationType: Adc_ChannelType. The Minimum and Maximum values of the Channel Id varies w.r.t AdcHwUnit under which it is configured like follows: If AdcHwUnitId value = 0, then AdcChannelId Minimum Value = 0 and AdcChannelId Maximum Value = 19. Channel Id 11 is used for diagnostic channel. If AdcHwUnitId value = 1, then AdcChannelId Minimum Value = 0 and AdcChannelId Maximum Value = 19. Channel Id 12 is used for diagnostic channel.
          boolean AdcChannelLimitCheck [0..1]: set at pre-compile, default-value=false  # Enables or disables limit checking for an ADC channel. true: Enables limit checking for an ADC channel. false: Disables limit checking for an ADC channel. | true: Enables limit checking for an ADC channel. false: Disables limit checking for an ADC channel.
          integer AdcChannelLowLimit [0..1]: 0..4095, set at pre-compile, default-value=0  # Low limit - used for limit checking.
          enumeration AdcChannelRangeSelect [0..1]: {ADC_RANGE_ALWAYS, ADC_RANGE_BETWEEN, ADC_RANGE_NOT_OVER_HIGH, ADC_RANGE_NOT_UNDER_LOW, ADC_RANGE_OVER_HIGH, ADC_RANGE_UNDER_LOW}, set at pre-compile, default-value=ADC_RANGE_ALWAYS  # In case of active limit checking: defines which conversion values are taken into account related to the boarders defined with AdcChannelLowLimit and AdcChannelHighLimit. Implementation Type: Adc_ChannelRangeSelectType ADC_RANGE_ALWAYS: Complete range - independent from channel limit settings. ADC_RANGE_BETWEEN: Range between low limit and high limit - high limit value included. ADC_RANGE_NOT_OVER_HIGH: Range below high limit -high limit value included. ADC_RANGE_NOT_UNDER_LOW: Range above low limit. ADC_RANGE_OVER_HIGH: Range above high limit. ADC_RANGE_UNDER_LOW: Range below limit - low limit value included.
          enumeration AdcChannelRefVoltsrcHigh [0..1]: {NOT_USED}, set at post-build, default-value=NOT_USED  # Upper reference voltage source for each channel. | Enumeration literals are defined vendor specific. This parameter is not used for implementation since hardware does not provide flexibility to select reference voltage and user needs to take precaution to set reference voltage.
          enumeration AdcChannelRefVoltsrcLow [0..1]: {NOT_USED}, set at post-build, default-value=NOT_USED  # Lower reference voltage source for each channel. | Enumeration literals are defined vendor specific. Hardware does not support reference voltage for each channel. Hence this parameter is not used for implementation.
          integer AdcChannelResolution [0..1]: 1..63, set at post-build, default-value=1  # Channel resolution in bits. | ImplementationType: Adc_ResolutionType. This parameter is not used for implementation since resolution is based on Hardware unit.
          integer AdcChannelSampTime [0..1]: 0..18446744073709551615, set at post-build, default-value=0  # Configuration of sampling time, i.e. the time during which the value is sampled, (in clock cycles) for each channel. Hardware does not support Sampling time for each channel. Hence this parameter is not used for implementation | ImplementationType: Adc_SamplingTimeType
          integer AdcExtMuxValue [0..8]: 0..7, set at post-build, origin=Renesas_v1.0.1, default-value=0  # Configuration of external multiplexer input lines that should be converted.
          integer AdcExtMuxDelayCounter [0..1]: 0..4294967295, set at post-build, origin=Renesas_v1.0.1, default-value=0  # This Parameter specify delay (in Tick) required before selecting a new External Mux line.
          boolean AdcEnableChSelfDiag [0..1]: set at pre-compile, origin=Renesas_v1.0.1, default-value=false  # Enables or disables Self-Diagnostic for Adc Channel. | true: Self-diag enabled for the channel. false: Self-diag disabled for the channel (default setting)
          enumeration AdcSelfDiagConvCktRef [0..1]: {AVREFH_MUL_BY_0, AVREFH_MUL_3_DIV_BY_4, AVREFH_DIV_BY_2, AVREFH_DIV_BY_4, AVREFH_MUL_BY_1}, set at post-build, origin=Renesas_v1.0.0, default-value=AVREFH_MUL_BY_0  # This parameter configuration specifies the setting for reference used in conversion circuit self diagnosis. This parameter is used when the parameter AdcEnableChSelfDiag is enabled. | AVREFH_MUL_BY_0: AVREF * 0. AVREFH_MUL_3_DIV_BY_4: AVREF * 3/4. AVREFH_DIV_BY_2: AVREF * 1/2. AVREFH_DIV_BY_4: AVREF * 1/4. AVREFH_MUL_BY_1: AVREF * 1.
          enumeration AdcEnablePullUpPullDown [0..1]: {PULL_UP_DOWN_OFF, PULL_UP, PULL_DOWN}, set at pre-compile, origin=Renesas_v1.0.1, default-value=PULL_UP_DOWN_OFF  # This parameter configuration specifies the setting for Self diagnosis of wire breaking supported by a ADC channel. | PULL_UP_DOWN_OFF: Pull up/down disabled mode. PULL_UP: Pull Up enabled. PULL_DOWN: Pull Down enabled. This parameter has no effect when Wiring-break detection mode 1 is selected.
        container AdcGroup [1..256]  # This container contains the Group configuration (parameters).
          enumeration AdcGroupAccessMode: {ADC_ACCESS_MODE_SINGLE, ADC_ACCESS_MODE_STREAMING}, set at post-build, default-value=ADC_ACCESS_MODE_SINGLE  # Type of access mode to group conversion results. | ImplementationType: Adc_GroupAccessModeType ADC_ACCESS_MODE_SINGLE: Single value access mode. ADC_ACCESS_MODE_STREAMING: Streaming access mode.
          enumeration AdcGroupConversionMode: {ADC_CONV_MODE_CONTINUOUS, ADC_CONV_MODE_ONESHOT}, set at post-build, default-value=ADC_CONV_MODE_ONESHOT  # Type of conversion mode supported by the driver. | ImplementationType: Adc_GroupConvModeType ADC_CONV_MODE_CONTINUOUS: The Conversions of an ADC Channel group are performed continuously after a software API call (start) or Hardware API call (start) if the channel group is mapped to TG0. The conversions itself are running automatically (no additional software or hardware trigger needed). ADC_CONV_MODE_ONESHOT: The Conversions of an ADC Channel group is performed once after a trigger.
          integer AdcGroupId: 0..255, set at pre-compile, symbolic-name-value=true, default-value=0  # This parameter specifies Numeric ID of the group. This parameter is the symbolic name to be used on the API. This symbolic name allows accessing Channel Group data. This value will be assigned to the symbolic name derived of the AdcGroup container shortname. | ImplementationType: Adc_GroupType
          integer AdcScanGroup: 0..4, set at pre-compile, origin=Renesas_v1.0.0, default-value=0  # This parameter specifies the Scan group selection. | 0: logic group is mapped to Scan group 0. 1: logic group is mapped to Scan group 1. 2: logic group is mapped to Scan group 2. 3: logic group is mapped to Scan group 3. 4: logic group is mapped to Scan group 4.
          enumeration AdcSelfDiagMode [0..1]: {ADC_SELF_DIAG_OFF, ADC_SELF_DIAG_PIN_LVL, ADC_SELF_DIAG_CONV_CKT, ADC_SELF_DIAG_WIRE_BRK_MODE2}, set at post-build, origin=Renesas_v1.0.0, default-value=ADC_SELF_DIAG_OFF  # This parameter provides the selection self diagnostics. | ADC_SELF_DIAG_OFF: Normal Group (default setting). ADC_SELF_DIAG_PIN_LVL: Pin Level Self diagnosis. ADC_SELF_DIAG_CONV_CKT: A/D conversion circuit Self diagnosis. ADC_SELF_DIAG_WIRE_BRK_MODE2: wiring-break detection by pull-down or pull-up resistance.
          integer AdcPullDownPulseWidth [0..1]: 4..20, set at post-build, origin=Renesas_v1.0.1, default-value=4  # This parameter specifies the width of pull-down pulse to be generated in wiring-break detection mode1.
          enumeration AdcSelfDiagPinLevel [0..1]: {LEVEL_1, LEVEL_2, LEVEL_3, LEVEL_4}, set at post-build, origin=Renesas_v1.0.0, default-value=LEVEL_1  # This parameter configuration specifies the setting for Pin level self diagnosis level supported by hardware unit. | LEVEL_1: TDLV = 0, Even numbers of physical channel groups are discharged to AVSS, and odd numbers of physical channel groups are charged to AVCC. LEVEL_2: TDLV = 1, Even numbers of physical channel groups are charged to AVCC, and odd numbers of physical channel groups are discharged to AVSS. LEVEL_3: TDLV = 2, Even numbers of physical channel groups are discharged to AVSS, and odd numbers of physical channel groups are charged to 1/2*AVCC. LEVEL_4: TDLV = 3, Even numbers of physical channel groups are charged to 1/2*AVCC, and odd numbers of physical channel groups are discharged to AVSS.
          integer AdcGroupPriority [0..1]: 0..255, set at post-build, default-value=0  # Priority level of the AdcGroup. | ImplementationType: Adc_GroupPriorityType
          enumeration AdcGroupReplacement [0..1]: {ADC_GROUP_REPL_ABORT_RESTART, ADC_GROUP_REPL_SUSPEND_RESUME}, set at post-build, default-value=ADC_GROUP_REPL_ABORT_RESTART  # Replacement mechanism, which is used on ADC group level, if a group conversion is interrupted by a group which has a higher priority. | ImplementationType: Adc_GroupReplacementType ADC_GROUP_REPL_ABORT_RESTART: Abort/Restart mechanism is used on group level, if a group is interrupted by a higher priority group. The complete conversion round of the interrupted group (all group channels) is restarted after the higher priority group conversion is finished. If the group is configured in streaming access mode, only the results of the interrupted conversion round are discarded. Results of previous conversion rounds which are already written to the result buffer are not affected. ADC_GROUP_REPL_SUSPEND_RESUME: Suspend/Resume mechanism is used on group level, if a group is interrupted by a higher priority group. The conversions round of the interrupted group is completed after the higher priority group conversion is finished.
          enumeration AdcHwTrigSignal [0..1]: {ADC_HW_TRIG_RISING_EDGE, ADC_HW_TRIG_FALLING_EDGE, ADC_HW_TRIG_BOTH_EDGES}, set at post-build, default-value=ADC_HW_TRIG_RISING_EDGE  # Configures on which edge of the hardware trigger signal the driver should react, i.e. start the conversion. | ImplementationType: Adc_HwTriggerSignalType ADC_HW_TRIG_RISING_EDGE: React on rising edges of the hardware trigger signal (only if supported by the ADC hardware). ADC_HW_TRIG_FALLING_EDGE: React on the falling edge of the hardware trigger signal (only if supported by the ADC hardware). ADC_HW_TRIG_BOTH_EDGES: React on both edges of the hardware trigger signal (only if supported by the ADC hardware).
          enumeration AdcGroupTriggSrc: {ADC_TRIGG_SRC_HW, ADC_TRIGG_SRC_SW}, set at post-build, default-value=ADC_TRIGG_SRC_SW  # Type of source event that starts a group conversion. | ImplementationType: Adc_TriggerSourceType ADC_TRIGG_SRC_HW: Group is triggered by a hardware event. ADC_TRIGG_SRC_SW: Group is triggered by a software API call.
          boolean AdcEnableAdTimerTriggMode [0..1]: set at pre-compile, origin=Renesas_v1.0.1, default-value=false  # Enables or disables AD timer trigger mode for a logical group. | true: AD timer trigger feature is enabled. false: AD timer trigger feature is disabled.
          integer AdcTimerPeriod [0..1]: 0..52429, set at pre-compile, origin=Renesas_v1.0.1, default-value=0  # This parameter is used to set AdcTimerPeriod value. | The value written to the ADCFnADTPRRy register will be (AdcTimerPeriod * 40) micro seconds.
          integer AdcTimerPhaseDelay [0..1]: 0..52429, set at pre-compile, origin=Renesas_v1.0.1, default-value=0  # This parameter is used to set AdcTimerPhaseDelay value. | The value written to the ADCFnADTIPRy register will be (AdcTimerPhaseDelay * 40) micro seconds.
          integer AdcHwTrigTimer [0..1]: 0..18446744073709551615, set at post-build, default-value=0  # Reload value of the ADC module embedded timer (only if supported by ADC hardware). Reference parameter "AdcGroupHwTriggerSource" is used for trigger selection. Hence this parameter is not used for implementation. | ImplementationType: Adc_HwTriggerTimerType
          function name AdcNotification [0..1]: set at post-build, default-value=NULL, regular-expression=[a-zA-Z][a-zA-Z0-9_]*  # Callback function for each group.
          enumeration AdcStreamingBufferMode: {ADC_STREAM_BUFFER_CIRCULAR, ADC_STREAM_BUFFER_LINEAR}, set at post-build, default-value=ADC_STREAM_BUFFER_LINEAR  # Configure streaming buffer as "linear buffer" (i.e. the ADC Driver stops the conversion as soon as the stream buffer is full) or as "ring buffer" (wraps around if the end of the stream buffer is reached). | ImplementationType: Adc_StreamBufferModeType ADC_STREAM_BUFFER_CIRCULAR: The ADC Driver continues the conversion even if the stream buffer is full (number of samples reached) by wrapping around the stream buffer itself. ADC_STREAM_BUFFER_LINEAR: The ADC Driver stops the conversion as soon as the stream buffer is null (number of samples reached).
          integer AdcStreamingNumSamples: 1..255, set at post-build, default-value=1  # Number of ADC values to be acquired per channel in streaming access mode. | Note: in single access mode this parameter assumes value 1, since only one sample per channel is processed. ImplementationType: Adc_StreamNumSampleType
          enumeration AdcResultAccessMode: {ADC_DMA_ACCESS, ADC_ISR_ACCESS, ADC_POLLING_ACCESS}, set at post-build, origin=Renesas_v1.0.0, default-value=ADC_ISR_ACCESS  # This parameter specifies if DMA or ISR should be used to transfer the conversion results from the corresponding registers to the software buffers. | ADC_DMA_ACCESS: DMA is used to transfer the conversion results from the corresponding registers to the software buffers. ADC_ISR_ACCESS: ISR is used to transfer the conversion results from the corresponding registers to the software buffers. ADC_POLLING_ACCESS: POLLING is used to transfer the conversion results from the corresponding registers to the software buffers.
          reference AdcGroupDefinition [1..256]: set at post-build, destination=AdcChannel  # Assignment of AdcChannels to a AdcGroups. | ImplementationType: Adc_GroupDefType
          reference AdcGroupHwTriggerSource [0..51]: set at post-build, origin=Renesas_v1.0.0, destination=AdcHwTriggerConfig  # Assignment of AdcHwTriggerConfig to AdcGroup.
        container AdcHwTriggerConfig [0..51]  # This container contains value of the ADC module hardware triggers for Trigger config.
          enumeration AdcHwTrigger: {EXTERNAL_ADTRGx, TIM0_IRQ_0, TIM0_IRQ_1, TIM0_IRQ_2, TIM0_IRQ_3, TIM0_IRQ_4, TIM0_IRQ_5, TIM0_IRQ_6, TIM0_IRQ_7, TIM1_IRQ_0, TIM1_IRQ_1, TIM1_IRQ_2, TIM1_IRQ_3, TIM1_IRQ_4, TIM1_IRQ_5, TIM1_IRQ_6, TIM1_IRQ_7, ATOM0_OUT_0, ATOM0_OUT_0_N, ATOM0_OUT_1, ATOM0_OUT_1_N, ATOM0_OUT_2, ATOM0_OUT_2_N, ATOM0_OUT_3, ATOM0_OUT_3_N, ATOM0_OUT_4, ATOM0_OUT_5, ATOM0_OUT_6, ATOM0_OUT_7, ATOM1_OUT_0, ATOM1_OUT_0_N, ATOM1_OUT_1, ATOM1_OUT_1_N, ATOM1_OUT_2, ATOM1_OUT_2_N, ATOM1_OUT_3, ATOM1_OUT_3_N, ATOM1_OUT_4, ATOM1_OUT_5, ATOM1_OUT_6, ATOM1_OUT_7, ATOM2_OUT_0, ATOM2_OUT_0_N, ATOM2_OUT_1, ATOM2_OUT_1_N, ATOM2_OUT_2, ATOM2_OUT_2_N, ATOM2_OUT_3, ATOM2_OUT_3_N, ATOM2_OUT_4, MCS0_IRQ_0, MCS0_IRQ_1, MCS0_IRQ_2, MCS0_IRQ_3, MCS0_IRQ_4, MCS0_IRQ_5, MCS0_IRQ_6, MCS0_IRQ_7, MCS0_IRQ_8, MCS1_IRQ_0, MCS1_IRQ_1, MCS1_IRQ_2, MCS1_IRQ_3, MCS1_IRQ_4, MCS1_IRQ_5}, set at post-build, origin=Renesas_v1.0.0, default-value=TIM0_IRQ_0  # This parameter contains Hardware Trigger value selection to a AdcGroup. | TIM0_IRQ_0 to TIM0_IRQ_7. TIM1_IRQ_0 to TIM1_IRQ_7. ATOM0_OUT_0 to ATOM0_OUT_7. ATOM1_OUT_0 to ATOM1_OUT_7. ATOM2_OUT_0 to ATOM2_OUT_4. MCS0_IRQ_0 to MCS0_IRQ_8. MCS1_IRQ_0 to MCS1_IRQ_5. EXTERNAL_ADTRGx.
