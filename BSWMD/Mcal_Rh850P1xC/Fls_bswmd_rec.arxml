AUTOSAR XML (schema 4-0-3)
package /Renesas/EcucDefs_Fls
  module config Fls_Rec: definition=Fls, implementation-config-variant=VARIANT-POST-BUILD
    FlsGeneral: FlsVersionCheckExternalModules=0
  bsw implementation Fls_Impl: programming-language=C, used-code-generator=EXTERNAL, behavior=FlsBehavior, recommended-configuration=Fls_Rec, vendor-specific-module-def=Fls
