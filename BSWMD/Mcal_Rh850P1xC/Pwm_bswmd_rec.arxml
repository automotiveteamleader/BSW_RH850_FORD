AUTOSAR XML (schema 4-0-3)
package /Renesas/EcucDefs_Pwm
  module config Pwm_Rec: definition=Pwm, implementation-config-variant=VARIANT-POST-BUILD
    PwmGeneral: PwmVersionCheckExternalModules=0
  bsw implementation Pwm_Impl: programming-language=C, used-code-generator=EXTERNAL, behavior=PwmBehavior, recommended-configuration=Pwm_Rec, vendor-specific-module-def=Pwm
