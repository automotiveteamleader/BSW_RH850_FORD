AUTOSAR XML (schema 4-0-3)
package /Renesas/EcucDefs_FlsTst
  module config FlsTst_Rec: definition=FlsTst
  bsw implementation FlsTst_Impl: programming-language=C, used-code-generator=EXTERNAL, behavior=FlsTstBehavior, recommended-configuration=FlsTst_Rec, vendor-specific-module-def=FlsTst
