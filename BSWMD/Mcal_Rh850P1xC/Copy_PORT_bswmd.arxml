[part 1 of 5: package /Renesas/EcucDefs_Port]
AUTOSAR XML (schema 4-0-3)
# COPYRIGHT
# Copyright(c) 2015 - 2017 Renesas Electronics Corporation
package /Renesas/EcucDefs_Port
  ecuc definition collection RenesasParameterDefinition_Port: module=Port
  module definition Port: refined-module-def=Port, variants post-build  # Configuration of the Port module.
    container PortConfigSet: multiple-configuration-container=true  # This container is the base of a multiple configuration set.
      container PortContainer  # Container collecting the PortPins. This container is not used for implementation.
        integer PortNumberOfPortPins: 1..65535, set at pre-compile, default-value=1  # The number of specified PortPins in this PortContainer. This parameter is not used for implementation.
        container PortPin  # Configuration of the individual port pins. This container is not used for implementation.
          enumeration PortPinDirection: {PORT_PIN_IN, PORT_PIN_OUT}, set at post-build, default-value=PORT_PIN_IN  # The initial direction of the pin (IN or OUT). If the direction is not changeable, the value configured here is fixed. This parameter is not used for implementation The direction must match the pin mode. E.g. a pin used for an ADC must be configured to be an in port. Implementation Type: Port_PinDirectionType.
          boolean PortPinDirectionChangeable: set at post-build, default-value=false  # Parameter to indicate if the direction is changeable on a port pin during runtime. This parameter is not used for implementation. true: Port Pin direction changeable enabled. false: Port Pin direction changeable disabled.
          integer PortPinId: 1..65535, set at pre-compile, symbolic-name-value=true, default-value=1  # Pin Id of the port pin. This value will be assigned to the symbolic name derived from the port pin container short name. This parameter is not used for implementation.
          enumeration PortPinInitialMode: {PORT_PIN_MODE_ADC, PORT_PIN_MODE_CAN, PORT_PIN_MODE_DIO, PORT_PIN_MODE_DIO_GPT, PORT_PIN_MODE_DIO_WDG, PORT_PIN_MODE_FLEXRAY, PORT_PIN_MODE_ICU, PORT_PIN_MODE_LIN, PORT_PIN_MODE_MEM, PORT_PIN_MODE_PWM, PORT_PIN_MODE_SPI}, set at post-build, default-value=PORT_PIN_MODE_ADC  # Port pin mode from mode list for use with Port_Init() function. This parameter is not used for implementation.
          enumeration PortPinLevelValue: {PORT_PIN_LEVEL_HIGH, PORT_PIN_LEVEL_LOW}, set at post-build, default-value=PORT_PIN_LEVEL_HIGH  # Port Pin Level value from Port pin list. This parameter is not used for implementation.
          enumeration PortPinMode: {PORT_PIN_MODE_ADC, PORT_PIN_MODE_CAN, PORT_PIN_MODE_DIO, PORT_PIN_MODE_DIO_GPT, PORT_PIN_MODE_DIO_WDG, PORT_PIN_MODE_FLEXRAY, PORT_PIN_MODE_ICU, PORT_PIN_MODE_LIN, PORT_PIN_MODE_MEM, PORT_PIN_MODE_PWM, PORT_PIN_MODE_SPI}, set at post-build, default-value=PORT_PIN_MODE_ADC  # Port pin mode from mode list. This parameter is not used for implementation.
          boolean PortPinModeChangeable: set at post-build, default-value=false  # Parameter to indicate if the mode of a port pin is changeable during runtime by API function Port_SetPinMode. Including this API is controlled by PortSetPinModeApi. true: Port Pin mode is changeable. false: Port Pin mode is not changeable.
      container PortFilterGroupConfig  # This container contains configuration for the Port Filter Functionality.
        symbolic name reference PortDigitalFilterClockSelection0 [0..1]: set at post-build, origin=Renesas_v1.0.2, destination=McuClockSettingConfig0  # This parameter specifies the reference to the MCU Low Speed Peripheral Clock(CLK_LSB). Mandatory if any of the the digital filter is enabled.
        symbolic name reference PortDigitalFilterClockSelection1 [0..1]: set at post-build, origin=Renesas_v1.0.2, destination=McuClockSettingConfig0  # This parameter specifies the reference to the MCU CPU Clock(CLK_CPU). Mandatory if any of the the digital filter is enabled.
        container PortAnalogFilterGroup0 [0..1]  # This container contains Analog Filter Functionality for the signal NMI.
          enumeration PortAnalogFilterBypass: {NOT_SUPPORTED}, set at post-build, origin=Renesas_v1.0.0, default-value=NOT_SUPPORTED  # This parameter enables/disables bypass control. | NOT_SUPPORTED: Bypass functionality is not available for this analog filter.
          enumeration PortEdgeOrLevelControl: {BOTH_EDGES_DISABLED, FALLING_EDGE_FCLA0CTL0, RISING_EDGE_FCLA0CTL0, BOTH_EDGES_FCLA0CTL0}, set at post-build, origin=Renesas_v1.0.0, default-value=BOTH_EDGES_DISABLED  # This parameter specifies the mode selection. | FALLING_EDGE_FCLA<Instance>_CTL<Instance>: Falling edge detection enabled. RISING_EDGE_FCLA<Instance>_CTL<Instance>: Rising edge detection enabled. BOTH_EDGES_FCLA<Instance>_CTL<Instance>: Both falling and rising edges enabled BOTH_EDGES_DISABLED: Both falling and rising edges disabled.
        container PortAnalogFilterGroup1 [0..1]  # This container contains Analog Filter Functionality for the signal INTP0.
          enumeration PortAnalogFilterBypass: {NOT_SUPPORTED}, set at post-build, origin=Renesas_v1.0.0, default-value=NOT_SUPPORTED  # This parameter enables/disables bypass control. | NOT_SUPPORTED: Bypass functionality is not available for this analog filter.
          enumeration PortEdgeOrLevelControl: {BOTH_EDGES_DISABLED, FALLING_EDGE_FCLA0CTL1, RISING_EDGE_FCLA0CTL1, BOTH_EDGES_FCLA0CTL1}, set at post-build, origin=Renesas_v1.0.0, default-value=BOTH_EDGES_DISABLED  # This parameter specifies the mode selection. | FALLING_EDGE_FCLA<Instance>_CTL<Instance>: Falling edge detection enabled. RISING_EDGE_FCLA<Instance>_CTL<Instance>: Rising edge detection enabled. BOTH_EDGES_FCLA<Instance>_CTL<Instance>: Both falling and rising edges enabled. BOTH_EDGES_DISABLED: Both falling and rising edges disabled.
        container PortAnalogFilterGroup2 [0..1]  # This container contains Analog Filter Functionality for the signal INTP1.
          enumeration PortAnalogFilterBypass: {NOT_SUPPORTED}, set at post-build, origin=Renesas_v1.0.0, default-value=NOT_SUPPORTED  # This parameter enables/disables bypass control. | NOT_SUPPORTED: Bypass functionality is not available for this analog filter.
          enumeration PortEdgeOrLevelControl: {BOTH_EDGES_DISABLED, FALLING_EDGE_FCLA0CTL2, RISING_EDGE_FCLA0CTL2, BOTH_EDGES_FCLA0CTL2}, set at post-build, origin=Renesas_v1.0.0, default-value=BOTH_EDGES_DISABLED  # This parameter specifies the mode selection. | FALLING_EDGE_FCLA<Instance>_CTL<Instance>: Falling edge detection enabled. RISING_EDGE_FCLA<Instance>_CTL<Instance>: Rising edge detection enabled. BOTH_EDGES_FCLA<Instance>_CTL<Instance>: Both falling and rising edges enabled. BOTH_EDGES_DISABLED: Both falling and rising edges disabled.
        container PortAnalogFilterGroup3 [0..1]  # This container contains Analog Filter Functionality for the signal INTP2.
          enumeration PortAnalogFilterBypass: {NOT_SUPPORTED}, set at post-build, origin=Renesas_v1.0.0, default-value=NOT_SUPPORTED  # This parameter enables/disables bypass control. | NOT_SUPPORTED: Bypass functionality is not available for this analog filter.
          enumeration PortEdgeOrLevelControl: {BOTH_EDGES_DISABLED, FALLING_EDGE_FCLA0CTL3, RISING_EDGE_FCLA0CTL3, BOTH_EDGES_FCLA0CTL3}, set at post-build, origin=Renesas_v1.0.0, default-value=BOTH_EDGES_DISABLED  # This parameter specifies the mode selection. | FALLING_EDGE_FCLA<Instance>_CTL<Instance>: Falling edge detection enabled. RISING_EDGE_FCLA<Instance>_CTL<Instance>: Rising edge detection enabled. BOTH_EDGES_FCLA<Instance>_CTL<Instance>: Both falling and rising edges enabled. BOTH_EDGES_DISABLED : Both falling and rising edges disabled
        container PortAnalogFilterGroup4 [0..1]  # This container contains Analog Filter Functionality for the signal INTP3.
          enumeration PortAnalogFilterBypass: {NOT_SUPPORTED}, set at post-build, origin=Renesas_v1.0.0, default-value=NOT_SUPPORTED  # This parameter enables/disables bypass control. | NOT_SUPPORTED: Bypass functionality is not available for this analog filter.
          enumeration PortEdgeOrLevelControl: {BOTH_EDGES_DISABLED, FALLING_EDGE_FCLA0CTL4, RISING_EDGE_FCLA0CTL4, BOTH_EDGES_FCLA0CTL4}, set at post-build, origin=Renesas_v1.0.0, default-value=BOTH_EDGES_DISABLED  # This parameter specifies the mode selection. | FALLING_EDGE_FCLA<Instance>_CTL<Instance>: Falling edge detection enabled. RISING_EDGE_FCLA<Instance>_CTL<Instance>: Rising edge detection enabled. BOTH_EDGES_FCLA<Instance>_CTL<Instance>: Both falling and rising edges enabled. BOTH_EDGES_DISABLED: Both falling and rising edges disabled.
        container PortAnalogFilterGroup5 [0..1]  # This container contains Analog Filter Functionality for the signal INTP4.
          enumeration PortAnalogFilterBypass: {NOT_SUPPORTED}, set at post-build, origin=Renesas_v1.0.0, default-value=NOT_SUPPORTED  # This parameter enables/disables bypass control. | NOT_SUPPORTED: Bypass functionality is not available for this analog filter.
          enumeration PortEdgeOrLevelControl: {BOTH_EDGES_DISABLED, FALLING_EDGE_FCLA0CTL5, RISING_EDGE_FCLA0CTL5, BOTH_EDGES_FCLA0CTL5}, set at post-build, origin=Renesas_v1.0.0, default-value=BOTH_EDGES_DISABLED  # This parameter specifies the mode selection. | FALLING_EDGE_FCLA<Instance>_CTL<Instance>: Falling edge detection enabled. RISING_EDGE_FCLA<Instance>_CTL<Instance>: Rising edge detection enabled. BOTH_EDGES_FCLA<Instance>_CTL<Instance>: Both falling and rising edges enabled. BOTH_EDGES_DISABLED: Both falling and rising edges disabled.
        container PortAnalogFilterGroup6 [0..1]  # This container contains Analog Filter Functionality for the signal INTP5.
          enumeration PortAnalogFilterBypass: {NOT_SUPPORTED}, set at post-build, origin=Renesas_v1.0.0, default-value=NOT_SUPPORTED  # This parameter enables/disables bypass control. | NOT_SUPPORTED: Bypass functionality is not available for this analog filter.
          enumeration PortEdgeOrLevelControl: {BOTH_EDGES_DISABLED, FALLING_EDGE_FCLA0CTL6, RISING_EDGE_FCLA0CTL6, BOTH_EDGES_FCLA0CTL6}, set at post-build, origin=Renesas_v1.0.0, default-value=BOTH_EDGES_DISABLED  # This parameter specifies the mode selection. | FALLING_EDGE_FCLA<Instance>_CTL<Instance>: Falling edge detection enabled. RISING_EDGE_FCLA<Instance>_CTL<Instance>: Rising edge detection enabled. BOTH_EDGES_FCLA<Instance>_CTL<Instance>: Both falling and rising edges enabled. BOTH_EDGES_DISABLED: Both falling and rising edges disabled.
        container PortAnalogFilterGroup7 [0..1]  # This container contains Analog Filter Functionality for the signal INTP6.
          enumeration PortAnalogFilterBypass: {NOT_SUPPORTED}, set at post-build, origin=Renesas_v1.0.0, default-value=NOT_SUPPORTED  # This parameter enables/disables bypass control. | NOT_SUPPORTED: Bypass functionality is not available for this analog filter.
          enumeration PortEdgeOrLevelControl: {BOTH_EDGES_DISABLED, FALLING_EDGE_FCLA0CTL7, RISING_EDGE_FCLA0CTL7, BOTH_EDGES_FCLA0CTL7}, set at post-build, origin=Renesas_v1.0.0, default-value=BOTH_EDGES_DISABLED  # This parameter specifies the mode selection. | FALLING_EDGE_FCLA<Instance>_CTL<Instance>: Falling edge detection enabled. RISING_EDGE_FCLA<Instance>_CTL<Instance>: Rising edge detection enabled. BOTH_EDGES_FCLA<Instance>_CTL<Instance>: Both falling and rising edges enabled. BOTH_EDGES_DISABLED: Both falling and rising edges disabled.
        container PortAnalogFilterGroup8 [0..1]  # This container contains Analog Filter Functionality for the signal INTP7.
          enumeration PortAnalogFilterBypass: {NOT_SUPPORTED}, set at post-build, origin=Renesas_v1.0.0, default-value=NOT_SUPPORTED  # This parameter enables/disables bypass control. | NOT_SUPPORTED: Bypass functionality is not available for this analog filter.
          enumeration PortEdgeOrLevelControl: {BOTH_EDGES_DISABLED, FALLING_EDGE_FCLA1CTL0, RISING_EDGE_FCLA1CTL0, BOTH_EDGES_FCLA1CTL0}, set at post-build, origin=Renesas_v1.0.0, default-value=BOTH_EDGES_DISABLED  # This parameter specifies the mode selection. | FALLING_EDGE_FCLA<Instance>_CTL<Instance>: Falling edge detection enabled. RISING_EDGE_FCLA<Instance>_CTL<Instance>: Rising edge detection enabled. BOTH_EDGES_FCLA<Instance>_CTL<Instance>: Both falling and rising edges enabled. BOTH_EDGES_DISABLED: Both falling and rising edges enabled.
        container PortAnalogFilterGroup9 [0..1]  # This container contains Analog Filter Functionality for the signal INTP8.
          enumeration PortAnalogFilterBypass: {NOT_SUPPORTED}, set at post-build, origin=Renesas_v1.0.0, default-value=NOT_SUPPORTED  # This parameter enables/disables bypass control. | NOT_SUPPORTED: Bypass functionality is not available for this analog filter.
          enumeration PortEdgeOrLevelControl: {BOTH_EDGES_DISABLED, FALLING_EDGE_FCLA1CTL1, RISING_EDGE_FCLA1CTL1, BOTH_EDGES_FCLA1CTL1}, set at post-build, origin=Renesas_v1.0.0, default-value=BOTH_EDGES_DISABLED  # This parameter specifies the mode selection. | FALLING_EDGE_FCLA<Instance>_CTL<Instance>: Falling edge detection enabled. RISING_EDGE_FCLA<Instance>_CTL<Instance>: Rising edge detection enabled. BOTH_EDGES_FCLA<Instance>_CTL<Instance>: Both falling and rising edges enabled. BOTH_EDGES_DISABLED: Both falling and rising edges enabled.
        container PortAnalogFilterGroup10 [0..1]  # This container contains Analog Filter Functionality for the signal INTP9.
          enumeration PortAnalogFilterBypass: {NOT_SUPPORTED}, set at post-build, origin=Renesas_v1.0.0, default-value=NOT_SUPPORTED  # This parameter enables/disables bypass control. | NOT_SUPPORTED: Bypass functionality is not available for this analog filter.
          enumeration PortEdgeOrLevelControl: {BOTH_EDGES_DISABLED, FALLING_EDGE_FCLA1CTL2, RISING_EDGE_FCLA1CTL2, BOTH_EDGES_FCLA1CTL2}, set at post-build, origin=Renesas_v1.0.0, default-value=BOTH_EDGES_DISABLED  # This parameter specifies the mode selection. | FALLING_EDGE_FCLA<Instance>_CTL<Instance>: Falling edge detection enabled. RISING_EDGE_FCLA<Instance>_CTL<Instance>: Rising edge detection enabled. BOTH_EDGES_FCLA<Instance>_CTL<Instance>: Both falling and rising edges enabled. BOTH_EDGES_DISABLED: Both falling and rising edges enabled.
        container PortAnalogFilterGroup11 [0..1]  # This container contains Analog Filter Functionality for the signal INTP10.
          enumeration PortAnalogFilterBypass: {NOT_SUPPORTED}, set at post-build, origin=Renesas_v1.0.0, default-value=NOT_SUPPORTED  # This parameter enables/disables bypass control. | NOT_SUPPORTED: Bypass functionality is not available for this analog filter.
          enumeration PortEdgeOrLevelControl: {BOTH_EDGES_DISABLED, FALLING_EDGE_FCLA1CTL3, RISING_EDGE_FCLA1CTL3, BOTH_EDGES_FCLA1CTL3}, set at post-build, origin=Renesas_v1.0.0, default-value=BOTH_EDGES_DISABLED  # This parameter specifies the mode selection. | FALLING_EDGE_FCLA<Instance>_CTL<Instance>: Falling edge detection enabled. RISING_EDGE_FCLA<Instance>_CTL<Instance>: Rising edge detection enabled. BOTH_EDGES_FCLA<Instance>_CTL<Instance>: Both falling and rising edges enabled. BOTH_EDGES_DISABLED: Both falling and rising edges enabled.
        container PortAnalogFilterGroup12 [0..1]  # This container contains Analog Filter Functionality for the signal INTP11.
          enumeration PortAnalogFilterBypass: {NOT_SUPPORTED}, set at post-build, origin=Renesas_v1.0.0, default-value=NOT_SUPPORTED  # This parameter enables/disables bypass control. | NOT_SUPPORTED: Bypass functionality is not available for this analog filter.
          enumeration PortEdgeOrLevelControl: {BOTH_EDGES_DISABLED, FALLING_EDGE_FCLA1CTL4, RISING_EDGE_FCLA1CTL4, BOTH_EDGES_FCLA1CTL4}, set at post-build, origin=Renesas_v1.0.0, default-value=BOTH_EDGES_DISABLED  # This parameter specifies the mode selection. | FALLING_EDGE_FCLA<Instance>_CTL<Instance>: Falling edge detection enabled. RISING_EDGE_FCLA<Instance>_CTL<Instance>: Rising edge detection enabled. BOTH_EDGES_FCLA<Instance>_CTL<Instance>: Both falling and rising edges enabled. BOTH_EDGES_DISABLED: Both falling and rising edges enabled.
        container PortDigitalFilterGroup0 [0..1]  # This container contains the Port Digital Filter Functionality for the signal RLIN30RX, RLIN31RX.
          enumeration PortDigitalFilterModeSelection: {ALTERNATIVE_MODE, INTERRUPT_MODE}, set at post-build, origin=Renesas_v1.0.2, default-value=ALTERNATIVE_MODE  # This parameter sets the interval to elapse after the digital filter is enabled. ALTERNATIVE_MODE: When Output signal from the digital filter is set to an input for an alternative function. INTERRUPT_MODE : When digital filter is used with an interrupt acting as an event output signal.
          enumeration PortSameLevelSamples: {TWO_SAMPLES, THREE_SAMPLES, FOUR_SAMPLES, FIVE_SAMPLES}, set at post-build, origin=Renesas_v1.0.0, default-value=TWO_SAMPLES  # This parameter specifies the number of same level samples, i.e. the number of samples with the same level to judge an external signal pulse as valid. | TWO_SAMPLES: Two samples are enabled. THREE_SAMPLES: Three samples are enabled. FOUR_SAMPLES: Four samples are enabled. FIVE_SAMPLES: Five samples are enabled.
          enumeration PortSamplingClockFrequency: {DNFATCKI_DIV_BY_1, DNFATCKI_DIV_BY_2, DNFATCKI_DIV_BY_4, DNFATCKI_DIV_BY_8, DNFATCKI_DIV_BY_16, DNFATCKI_DIV_BY_32, DNFATCKI_DIV_BY_64, DNFATCKI_DIV_BY_128}, set at post-build, origin=Renesas_v1.0.0, default-value=DNFATCKI_DIV_BY_1  # This parameter specifies the Digital filter sampling clock frequency. | DNFATCKI_DIV_BY_1: DNFATCKI / 1 clock frequency is enabled. DNFATCKI_DIV_BY_2: DNFATCKI / 2 clock frequency is enabled. DNFATCKI_DIV_BY_4: DNFATCKI / 4 clock frequency is enabled. DNFATCKI_DIV_BY_8: DNFATCKI / 8 clock frequency is enabled. DNFATCKI_DIV_BY_16: DNFATCKI / 16 clock frequency is enabled. DNFATCKI_DIV_BY_32: DNFATCKI / 32 clock frequency is enabled. DNFATCKI_DIV_BY_64: DNFATCKI / 64 clock frequency is enabled. DNFATCKI_DIV_BY_128: DNFATCKI / 128 clock frequency is enabled.
          enumeration PortDigitalFilterEnableInput0: {BYPASSED_FCLA2CTL0, FIXED_LOW_LEVEL}, set at post-build, origin=Renesas_v1.0.0, default-value=FIXED_LOW_LEVEL  # This parameter enables/disables for the signal RLIN30RX. BYPASSED;_CTL<Instance>: Filter is enabled. FIXED_LOW_LEVEL: Filter is disabled.
          enumeration PortDigitalFilterEdgeControl0: {RISING_FCLA2CTL0, FALLING_FCLA2CTL0, BOTH_EDGES_FCLA2CTL0, DISABLED}, set at post-build, origin=Renesas_v1.0.0, default-value=DISABLED  # This parameter enables/disables for the signal RLIN30RX. | DISABLED: Digital noise elimination disabled. RISING_FCLA<Instance>_CTL<Instance>: Enables rising edge. FALLING_FCLA<Instance>_CTL<Instance>: Enables falling edge. BOTH_EDGES_FCLA<Instance>_CTL<Instance>: Enables falling and rising edge.
          enumeration PortDigitalFilterEnableInput1: {BYPASSED_FCLA2CTL1, FIXED_LOW_LEVEL}, set at post-build, origin=Renesas_v1.0.0, default-value=FIXED_LOW_LEVEL  # This parameter enables/disables for the signal RLIN31RX. BYPASSED;_CTL<Instance>: Filter is enabled. FIXED_LOW_LEVEL: Filter is disabled.
          enumeration PortDigitalFilterEdgeControl1: {RISING_FCLA2CTL1, FALLING_FCLA2CTL1, BOTH_EDGES_FCLA2CTL1, DISABLED}, set at post-build, origin=Renesas_v1.0.0, default-value=DISABLED  # This parameter enables/disables for the signal RLIN31RX. | DISABLED: Digital noise elimination disabled. RISING_FCLA<Instance>_CTL<Instance>: Enables rising edge. FALLING_FCLA<Instance>_CTL<Instance>: Enables falling edge. BOTH_EDGES_FCLA<Instance>_CTL<Instance>: Enables falling and rising edge.
        container PortDigitalFilterGroup1 [0..1]  # This container contains the Port Digital Filter Functionality for the signal MTTCAN0RX, MCAN0RX.
          enumeration PortDigitalFilterModeSelection: {ALTERNATIVE_MODE, INTERRUPT_MODE}, set at post-build, origin=Renesas_v1.0.2, default-value=ALTERNATIVE_MODE  # This parameter sets the interval to elapse after the digital filter is enabled. ALTERNATIVE_MODE: When Output signal from the digital filter is set to an input for an alternative function. INTERRUPT_MODE : When digital filter is used with an interrupt acting as an event output signal.
          enumeration PortSameLevelSamples: {TWO_SAMPLES, THREE_SAMPLES, FOUR_SAMPLES, FIVE_SAMPLES}, set at post-build, origin=Renesas_v1.0.0, default-value=TWO_SAMPLES  # This parameter specifies the number of same level samples, i.e. the number of samples with the same level to judge an external signal pulse as valid. | TWO_SAMPLES: Two samples are enabled. THREE_SAMPLES: Three samples are enabled. FOUR_SAMPLES: Four samples are enabled. FIVE_SAMPLES: Five samples are enabled.
          enumeration PortSamplingClockFrequency: {DNFATCKI_DIV_BY_1, DNFATCKI_DIV_BY_2, DNFATCKI_DIV_BY_4, DNFATCKI_DIV_BY_8, DNFATCKI_DIV_BY_16, DNFATCKI_DIV_BY_32, DNFATCKI_DIV_BY_64, DNFATCKI_DIV_BY_128}, set at post-build, origin=Renesas_v1.0.0, default-value=DNFATCKI_DIV_BY_1  # This parameter specifies the Digital filter sampling clock frequency. | DNFATCKI_DIV_BY_1: DNFATCKI / 1 clock frequency is enabled. DNFATCKI_DIV_BY_2: DNFATCKI / 2 clock frequency is enabled. DNFATCKI_DIV_BY_4: DNFATCKI / 4 clock frequency is enabled. DNFATCKI_DIV_BY_8: DNFATCKI / 8 clock frequency is enabled. DNFATCKI_DIV_BY_16: DNFATCKI / 16 clock frequency is enabled. DNFATCKI_DIV_BY_32: DNFATCKI / 32 clock frequency is enabled. DNFATCKI_DIV_BY_64: DNFATCKI / 64 clock frequency is enabled. DNFATCKI_DIV_BY_128: DNFATCKI / 128 clock frequency is enabled.
          enumeration PortDigitalFilterEnableInput0: {BYPASSED_FCLA3CTL0, FIXED_LOW_LEVEL}, set at post-build, origin=Renesas_v1.0.0, default-value=FIXED_LOW_LEVEL  # This parameter enables/disables for the signal MTTCAN0RX. BYPASSED;_CTL<Instance>: Filter is enabled. FIXED_LOW_LEVEL: Filter is disabled.
          enumeration PortDigitalFilterEdgeControl0: {RISING_FCLA3CTL0, FALLING_FCLA3CTL0, BOTH_EDGES_FCLA3CTL, DISABLED}, set at post-build, origin=Renesas_v1.0.0, default-value=DISABLED  # This parameter enables/disables for the signal MTTCAN0RX. | DISABLED: Digital noise elimination disabled. RISING_FCLA<Instance>_CTL<Instance>: Enables rising edge. FALLING_FCLA<Instance>_CTL<Instance>: Enables falling edge. BOTH_EDGES_FCLA<Instance>_CTL<Instance>: Enables falling and rising edge.
          enumeration PortDigitalFilterEnableInput1: {BYPASSED_FCLA3CTL1, FIXED_LOW_LEVEL}, set at post-build, origin=Renesas_v1.0.0, default-value=FIXED_LOW_LEVEL  # This parameter enables/disables for the signal MCAN0RX. BYPASSED;_CTL<Instance>: Filter is enabled. FIXED_LOW_LEVEL: Filter is disabled.
          enumeration PortDigitalFilterEdgeControl1: {RISING_FCLA3CTL1, FALLING_FCLA3CTL1, BOTH_EDGES_FCLA3CTL1, DISABLED}, set at post-build, origin=Renesas_v1.0.0, default-value=DISABLED  # This parameter enables/disables for the signal MCAN0RX. | DISABLED: Digital noise elimination disabled. RISING_FCLA<Instance>_CTL<Instance>: Enables rising edge. FALLING_FCLA<Instance>_CTL<Instance>: Enables falling edge. BOTH_EDGES_FCLA<Instance>_CTL<Instance>: Enables falling and rising edge.
        container PortDigitalFilterGroup2 [0..1]  # This container contains the Port Digital Filter Functionality for the signal FLX0RXDA, FLX1RXDA.
          enumeration PortDigitalFilterModeSelection: {ALTERNATIVE_MODE, INTERRUPT_MODE}, set at post-build, origin=Renesas_v1.0.2, default-value=ALTERNATIVE_MODE  # This parameter sets the interval to elapse after the digital filter is enabled. ALTERNATIVE_MODE: When Output signal from the digital filter is set to an input for an alternative function. INTERRUPT_MODE : When digital filter is used with an interrupt acting as an event output signal.
          enumeration PortSameLevelSamples: {TWO_SAMPLES, THREE_SAMPLES, FOUR_SAMPLES, FIVE_SAMPLES}, set at post-build, origin=Renesas_v1.0.0, default-value=TWO_SAMPLES  # This parameter specifies the number of same level samples, i.e. the number of samples with the same level to judge an external signal pulse as valid. | TWO_SAMPLES: Two samples are enabled. THREE_SAMPLES: Three samples are enabled. FOUR_SAMPLES: Four samples are enabled. FIVE_SAMPLES: Five samples are enabled.
          enumeration PortSamplingClockFrequency: {DNFATCKI_DIV_BY_1, DNFATCKI_DIV_BY_2, DNFATCKI_DIV_BY_4, DNFATCKI_DIV_BY_8, DNFATCKI_DIV_BY_16, DNFATCKI_DIV_BY_32, DNFATCKI_DIV_BY_64, DNFATCKI_DIV_BY_128}, set at post-build, origin=Renesas_v1.0.0, default-value=DNFATCKI_DIV_BY_1  # This parameter specifies the Digital filter sampling clock frequency. | DNFATCKI_DIV_BY_1: DNFATCKI / 1 clock frequency is enabled. DNFATCKI_DIV_BY_2: DNFATCKI / 2 clock frequency is enabled. DNFATCKI_DIV_BY_4: DNFATCKI / 4 clock frequency is enabled. DNFATCKI_DIV_BY_8: DNFATCKI / 8 clock frequency is enabled. DNFATCKI_DIV_BY_16: DNFATCKI / 16 clock frequency is enabled. DNFATCKI_DIV_BY_32: DNFATCKI / 32 clock frequency is enabled. DNFATCKI_DIV_BY_64: DNFATCKI / 64 clock frequency is enabled. DNFATCKI_DIV_BY_128: DNFATCKI / 128 clock frequency is enabled.
          enumeration PortDigitalFilterEnableInput0: {BYPASSED_FCLA4CTL0, FIXED_LOW_LEVEL}, set at post-build, origin=Renesas_v1.0.0, default-value=FIXED_LOW_LEVEL  # This parameter enables/disables for the signal FLX0RXDA. BYPASSED;_CTL<Instance>: Filter is enabled. FIXED_LOW_LEVEL: Filter is disabled.
          enumeration PortDigitalFilterEdgeControl0: {RISING_FCLA4CTL0, FALLING_FCLA4CTL0, BOTH_EDGES_FCLA4CTL0, DISABLED}, set at post-build, origin=Renesas_v1.0.0, default-value=DISABLED  # This parameter enables/disables for the signal MTTCAN0RX. | DISABLED: Digital noise elimination disabled. RISING_FCLA<Instance>_CTL<Instance>: Enables rising edge. FALLING_FCLA<Instance>_CTL<Instance>: Enables falling edge. BOTH_EDGES_FCLA<Instance>_CTL<Instance>: Enables falling and rising edge.
          enumeration PortDigitalFilterEnableInput1: {BYPASSED_FCLA4CTL1, FIXED_LOW_LEVEL}, set at post-build, origin=Renesas_v1.0.0, default-value=FIXED_LOW_LEVEL  # This parameter enables/disables for the signal FLX1RXDA. BYPASSED;_CTL<Instance>: Filter is enabled. FIXED_LOW_LEVEL: Filter is disabled.
          enumeration PortDigitalFilterEdgeControl1: {RISING_FCLA4CTL0, FALLING_FCLA4CTL0, BOTH_EDGES_FCLA4CTL0, DISABLED}, set at post-build, origin=Renesas_v1.0.0, default-value=DISABLED  # This parameter enables/disables for the signal MTTCAN0RX. | DISABLED: Digital noise elimination disabled. RISING_FCLA<Instance>_CTL<Instance>: Enables rising edge. FALLING_FCLA<Instance>_CTL<Instance>: Enables falling edge. BOTH_EDGES_FCLA<Instance>_CTL<Instance>: Enables falling and rising edge.
        container PortDigitalFilterGroup3 [0..1]  # This container contains the Port Digital Filter Functionality for the signal SENT0RX, SENT1RX, SENT2RX, SENT4RX, SENT5RX, SENT6RX, SENT7RX.
          enumeration PortDigitalFilterModeSelection: {ALTERNATIVE_MODE, INTERRUPT_MODE}, set at post-build, origin=Renesas_v1.0.2, default-value=ALTERNATIVE_MODE  # This parameter sets the interval to elapse after the digital filter is enabled. ALTERNATIVE_MODE: When Output signal from the digital filter is set to an input for an alternative function. INTERRUPT_MODE : When digital filter is used with an interrupt acting as an event output signal.
          enumeration PortDigitalFilterBypass{0..7}: {BYPASS_ENABLED_FCLA5CTL{0..7}, DISABLED}, set at post-build, origin=Renesas_v1.0.0, default-value=DISABLED  # This parameter enables/disables bypass control. | BYPASS_ENABLED: Bypass functionality enabled. DISABLED: Bypass functionality disabled.
          enumeration PortSameLevelSamples: {TWO_SAMPLES, THREE_SAMPLES, FOUR_SAMPLES, FIVE_SAMPLES}, set at post-build, origin=Renesas_v1.0.0, default-value=TWO_SAMPLES  # This parameter specifies the number of same level samples, i.e. the number of samples with the same level to judge an external signal pulse as valid. | TWO_SAMPLES: Two samples are enabled. THREE_SAMPLES: Three samples are enabled. FOUR_SAMPLES: Four Samples are enabled. FIVE_SAMPLES: Five Samples are enabled.
          enumeration PortSamplingClockFrequency: {DNFATCKI_DIV_BY_1, DNFATCKI_DIV_BY_2, DNFATCKI_DIV_BY_4, DNFATCKI_DIV_BY_8, DNFATCKI_DIV_BY_16, DNFATCKI_DIV_BY_32, DNFATCKI_DIV_BY_64, DNFATCKI_DIV_BY_128}, set at post-build, origin=Renesas_v1.0.0, default-value=DNFATCKI_DIV_BY_1  # This parameter specifies the Digital filter sampling clock frequency. | DNFATCKI_DIV_BY_1: DNFATCKI / 1 clock frequency is enabled. DNFATCKI_DIV_BY_2: NFATCKI / 2 clock frequency is enabled. DNFATCKI_DIV_BY_4: NFATCKI / 4 clock frequency is enabled. DNFATCKI_DIV_BY_8: NFATCKI / 8 clock frequency is enabled. DNFATCKI_DIV_BY_16: DNFATCKI / 16 clock frequency is enabled. DNFATCKI_DIV_BY_32: DNFATCKI / 32 clock frequency is enabled. DNFATCKI_DIV_BY_64: DNFATCKI / 64 clock frequency is enabled. DNFATCKI_DIV_BY_128 DNFATCKI / 128 clock frequency is enabled.
          enumeration PortDigitalFilterEnableInput0: {BYPASSED_FCLA5CTL0, FIXED_LOW_LEVEL}, set at post-build, origin=Renesas_v1.0.0, default-value=FIXED_LOW_LEVEL  # This parameter enables/disables for the signal SENT0RX. BYPASSED;_CTL<Instance>Filter signal is bypassed through Analog. FIXED_LOW_LEVEL: Filter is signal is bypassed through Digital.
          enumeration PortDigitalFilterEdgeControl0: {RISING_FCLA5CTL0, FALLING_FCLA5CTL0, BOTH_EDGES_FCLA5CTL0, DISABLED}, set at post-build, origin=Renesas_v1.0.0, default-value=DISABLED  # This parameter enables/disables for the signal SENT0RX. | DISABLED: Digital noise elimination disabled. RISING_FCLA<Instance>_CTL<Instance>: Enables rising edge. FALLING_FCLA<Instance>_CTL<Instance>: Enables falling edge. BOTH_EDGES_FCLA<Instance>_CTL<Instance>: Enables falling and rising edge.
          enumeration PortDigitalFilterEnableInput1: {BYPASSED_FCLA5CTL1, FIXED_LOW_LEVEL}, set at post-build, origin=Renesas_v1.0.0, default-value=FIXED_LOW_LEVEL  # This parameter enables/disables for the signal SENT1RX. BYPASSED;_CTL<Instance>Filter signal is bypassed through Analog. FIXED_LOW_LEVEL: Filter is signal is bypassed through Digital.
          enumeration PortDigitalFilterEdgeControl1: {RISING_FCLA5CTL1, FALLING_FCLA5CTL1, BOTH_EDGES_FCLA5CTL1, DISABLED}, set at post-build, origin=Renesas_v1.0.0, default-value=DISABLED  # This parameter enables/disables for the signal SENT1RX. | DISABLED: Digital noise elimination disabled. RISING_FCLA<Instance>_CTL<Instance>: Enables rising edge. FALLING_FCLA<Instance>_CTL<Instance>: Enables falling edge. BOTH_EDGES_FCLA<Instance>_CTL<Instance>: Enables falling and rising edge.
          enumeration PortDigitalFilterEnableInput2: {BYPASSED_FCLA5CTL2, FIXED_LOW_LEVEL}, set at post-build, origin=Renesas_v1.0.0, default-value=FIXED_LOW_LEVEL  # This parameter enables/disables for the signal SENT2RX. BYPASSED;_CTL<Instance>Filter signal is bypassed through Analog. FIXED_LOW_LEVEL: Filter is signal is bypassed through Digital.
          enumeration PortDigitalFilterEdgeControl2: {RISING_FCLA5CTL2, FALLING_FCLA5CTL2, BOTH_EDGES_FCLA5CTL2, DISABLED}, set at post-build, origin=Renesas_v1.0.0, default-value=DISABLED  # This parameter enables/disables for the signal SENT2RX. | DISABLED: Digital noise elimination disabled. RISING_FCLA<Instance>_CTL<Instance>: Enables rising edge. FALLING_FCLA<Instance>_CTL<Instance>: Enables falling edge. BOTH_EDGES_FCLA<Instance>_CTL<Instance>: Enables falling and rising edge.
          enumeration PortDigitalFilterEnableInput3: {BYPASSED_FCLA5CTL3, FIXED_LOW_LEVEL}, set at post-build, origin=Renesas_v1.0.0, default-value=FIXED_LOW_LEVEL  # This parameter enables/disables for the signal SENT3RX. BYPASSED;_CTL<Instance>Filter signal is bypassed through Analog. FIXED_LOW_LEVEL: Filter is signal is bypassed through Digital.
          enumeration PortDigitalFilterEdgeControl3: {RISING_FCLA5CTL3, FALLING_FCLA5CTL3, BOTH_EDGES_FCLA5CTL3, DISABLED}, set at post-build, origin=Renesas_v1.0.0, default-value=DISABLED  # This parameter enables/disables for the signal SENT3RX. | DISABLED: Digital noise elimination disabled. RISING_FCLA<Instance>_CTL<Instance>: Enables rising edge. FALLING_FCLA<Instance>_CTL<Instance>: Enables falling edge. BOTH_EDGES_FCLA<Instance>_CTL<Instance>: Enables falling and rising edge.
          enumeration PortDigitalFilterEnableInput4: {BYPASSED_FCLA5CTL4, FIXED_LOW_LEVEL}, set at post-build, origin=Renesas_v1.0.0, default-value=FIXED_LOW_LEVEL  # This parameter enables/disables for the signal SENT4RX. BYPASSED;_CTL<Instance>Filter signal is bypassed through Analog. FIXED_LOW_LEVEL: Filter is signal is bypassed through Digital.
          enumeration PortDigitalFilterEdgeControl4: {RISING_FCLA5CTL4, FALLING_FCLA5CTL4, BOTH_EDGES_FCLA5CTL4, DISABLED}, set at post-build, origin=Renesas_v1.0.0, default-value=DISABLED  # This parameter enables/disables for the signal SENT4RX. | DISABLED: Digital noise elimination disabled. RISING_FCLA<Instance>_CTL<Instance>: Enables rising edge. FALLING_FCLA<Instance>_CTL<Instance>: Enables falling edge. BOTH_EDGES_FCLA<Instance>_CTL<Instance>: Enables falling and rising edge.
          enumeration PortDigitalFilterEnableInput5: {BYPASSED_FCLA5CTL5, FIXED_LOW_LEVEL}, set at post-build, origin=Renesas_v1.0.0, default-value=FIXED_LOW_LEVEL  # This parameter enables/disables for the signal SENT5RX. BYPASSED;_CTL<Instance>Filter signal is bypassed through Analog. FIXED_LOW_LEVEL: Filter is signal is bypassed through Digital.
          enumeration PortDigitalFilterEdgeControl5: {RISING_FCLA5CTL5, FALLING_FCLA5CTL5, BOTH_EDGES_FCLA5CTL5, DISABLED}, set at post-build, origin=Renesas_v1.0.0, default-value=DISABLED  # This parameter enables/disables for the signal SENT5RX. | DISABLED: Digital noise elimination disabled. RISING_FCLA<Instance>_CTL<Instance>: Enables rising edge. FALLING_FCLA<Instance>_CTL<Instance>: Enables falling edge. BOTH_EDGES_FCLA<Instance>_CTL<Instance>: Enables falling and rising edge.
          enumeration PortDigitalFilterEnableInput6: {BYPASSED_FCLA5CTL6, FIXED_LOW_LEVEL}, set at post-build, origin=Renesas_v1.0.0, default-value=FIXED_LOW_LEVEL  # This parameter enables/disables for the signal SENT6RX. BYPASSED;_CTL<Instance>Filter signal is bypassed through Analog. FIXED_LOW_LEVEL: Filter is signal is bypassed through Digital.
          enumeration PortDigitalFilterEdgeControl6: {RISING_FCLA5CTL6, FALLING_FCLA5CTL6, BOTH_EDGES_FCLA5CTL6, DISABLED}, set at post-build, origin=Renesas_v1.0.0, default-value=DISABLED  # This parameter enables/disables for the signal SENT6RX. | DISABLED: Digital noise elimination disabled. RISING_FCLA<Instance>_CTL<Instance>: Enables rising edge. FALLING_FCLA<Instance>_CTL<Instance>: Enables falling edge. BOTH_EDGES_FCLA<Instance>_CTL<Instance>: Enables falling and rising edge.
          enumeration PortDigitalFilterEnableInput7: {BYPASSED_FCLA5CTL7, FIXED_LOW_LEVEL}, set at post-build, origin=Renesas_v1.0.0, default-value=FIXED_LOW_LEVEL  # This parameter enables/disables for the signal SENT7RX. BYPASSED;_CTL<Instance>Filter signal is bypassed through Analog. FIXED_LOW_LEVEL: Filter is signal is bypassed through Digital.
          enumeration PortDigitalFilterEdgeControl7: {RISING_FCLA5CTL7, FALLING_FCLA5CTL7, BOTH_EDGES_FCLA5CTL7, DISABLED}, set at post-build, origin=Renesas_v1.0.0, default-value=DISABLED  # This parameter enables/disables for the signal SENT7RX. | DISABLED: Digital noise elimination disabled. RISING_FCLA<Instance>_CTL<Instance>: Enables rising edge. FALLING_FCLA<Instance>_CTL<Instance>: Enables falling edge. BOTH_EDGES_FCLA<Instance>_CTL<Instance>: Enables falling and rising edge.
        container PortDigitalFilterGroup4 [0..1]  # This container contains the Port Digital Filter Functionality for the signal SENT8RX, SENT9RX.
          enumeration PortDigitalFilterModeSelection: {ALTERNATIVE_MODE, INTERRUPT_MODE}, set at post-build, origin=Renesas_v1.0.2, default-value=ALTERNATIVE_MODE  # This parameter sets the interval to elapse after the digital filter is enabled. ALTERNATIVE_MODE: When Output signal from the digital filter is set to an input for an alternative function. INTERRUPT_MODE : When digital filter is used with an interrupt acting as an event output signal.
          enumeration PortDigitalFilterBypass0: {BYPASS_ENABLED_FCLA6CTL0, DISABLED}, set at post-build, origin=Renesas_v1.0.0, default-value=DISABLED  # This parameter enables/disables bypass control. | BYPASS_ENABLED: Bypass functionality enabled. DISABLED: Bypass functionality disabled.
          enumeration PortDigitalFilterBypass1: {BYPASS_ENABLED_FCLA6CTL1, DISABLED}, set at post-build, origin=Renesas_v1.0.0, default-value=DISABLED  # This parameter enables/disables bypass control. | BYPASS_ENABLED: Bypass functionality enabled. DISABLED: Bypass functionality disabled.
          enumeration PortSameLevelSamples: {TWO_SAMPLES, THREE_SAMPLES, FOUR_SAMPLES, FIVE_SAMPLES}, set at post-build, origin=Renesas_v1.0.0, default-value=TWO_SAMPLES  # This parameter specifies the number of same level samples, i.e. the number of samples with the same level to judge an external signal pulse as valid. | TWO_SAMPLES: Two samples are enabled. THREE_SAMPLES: Three samples are enabled. FOUR_SAMPLES: Four Samples are enabled. FIVE_SAMPLES: Five Samples are enabled.
          enumeration PortSamplingClockFrequency: {DNFATCKI_DIV_BY_1, DNFATCKI_DIV_BY_2, DNFATCKI_DIV_BY_4, DNFATCKI_DIV_BY_8, DNFATCKI_DIV_BY_16, DNFATCKI_DIV_BY_32, DNFATCKI_DIV_BY_64, DNFATCKI_DIV_BY_128}, set at post-build, origin=Renesas_v1.0.0, default-value=DNFATCKI_DIV_BY_1  # This parameter specifies the Digital filter sampling clock frequency. | DNFATCKI_DIV_BY_1: DNFATCKI / 1 clock frequency is enabled. DNFATCKI_DIV_BY_2: NFATCKI / 2 clock frequency is enabled. DNFATCKI_DIV_BY_4: NFATCKI / 4 clock frequency is enabled. DNFATCKI_DIV_BY_8: NFATCKI / 8 clock frequency is enabled. DNFATCKI_DIV_BY_16: DNFATCKI / 16 clock frequency is enabled. DNFATCKI_DIV_BY_32: DNFATCKI / 32 clock frequency is enabled. DNFATCKI_DIV_BY_64: DNFATCKI / 64 clock frequency is enabled. DNFATCKI_DIV_BY_128 DNFATCKI / 128 clock frequency is enabled.
          enumeration PortDigitalFilterEnableInput0: {BYPASSED_FCLA6CTL0, FIXED_LOW_LEVEL}, set at post-build, origin=Renesas_v1.0.0, default-value=FIXED_LOW_LEVEL  # This parameter enables/disables for the signal SENT8RX. BYPASSED;_CTL<Instance>Filter signal is bypassed through Analog. FIXED_LOW_LEVEL: Filter is signal is bypassed through Digital.
          enumeration PortDigitalFilterEdgeControl0: {RISING_FCLA6CTL0, FALLING_FCLA6CTL0, BOTH_EDGES_FCLA6CTL0, DISABLED}, set at post-build, origin=Renesas_v1.0.0, default-value=DISABLED  # This parameter enables/disables for the signal SENT0RX. | DISABLED: Digital noise elimination disabled. RISING_FCLA<Instance>_CTL<Instance>: Enables rising edge. FALLING_FCLA<Instance>_CTL<Instance>: Enables falling edge. BOTH_EDGES_FCLA<Instance>_CTL<Instance>: Enables falling and rising edge.
          enumeration PortDigitalFilterEnableInput1: {BYPASSED_FCLA6CTL1, FIXED_LOW_LEVEL}, set at post-build, origin=Renesas_v1.0.0, default-value=FIXED_LOW_LEVEL  # This parameter enables/disables for the signal SENT9RX. BYPASSED;_CTL<Instance>Filter signal is bypassed through Analog. FIXED_LOW_LEVEL: Filter is signal is bypassed through Digital.
          enumeration PortDigitalFilterEdgeControl1: {RISING_FCLA6CTL1, FALLING_FCLA6CTL1, BOTH_EDGES_FCLA6CTL1, DISABLED}, set at post-build, origin=Renesas_v1.0.0, default-value=DISABLED  # This parameter enables/disables for the signal SENT0RX. | DISABLED: Digital noise elimination disabled. RISING_FCLA<Instance>_CTL<Instance>: Enables rising edge. FALLING_FCLA<Instance>_CTL<Instance>: Enables falling edge. BOTH_EDGES_FCLA<Instance>_CTL<Instance>: Enables falling and rising edge.
        container PortDigitalFilterGroup5 [0..1]  # This container contains the Port Digital Filter Functionality for the signal ADTRG0, ADTRG1.
          enumeration PortDigitalFilterModeSelection: {ALTERNATIVE_MODE, INTERRUPT_MODE}, set at post-build, origin=Renesas_v1.0.2, default-value=ALTERNATIVE_MODE  # This parameter sets the interval to elapse after the digital filter is enabled. ALTERNATIVE_MODE: When Output signal from the digital filter is set to an input for an alternative function. INTERRUPT_MODE : When digital filter is used with an interrupt acting as an event output signal.
          enumeration PortSameLevelSamples: {TWO_SAMPLES, THREE_SAMPLES, FOUR_SAMPLES, FIVE_SAMPLES}, set at post-build, origin=Renesas_v1.0.0, default-value=TWO_SAMPLES  # This parameter specifies the number of same level samples, i.e. the number of samples with the same level to judge an external signal pulse as valid. | TWO_SAMPLES: Two samples are enabled. THREE_SAMPLES: Three samples are enabled. FOUR_SAMPLES: Four Samples are enabled. FIVE_SAMPLES: Five Samples are enabled.
          enumeration PortSamplingClockFrequency: {DNFATCKI_DIV_BY_1, DNFATCKI_DIV_BY_2, DNFATCKI_DIV_BY_4, DNFATCKI_DIV_BY_8, DNFATCKI_DIV_BY_16, DNFATCKI_DIV_BY_32, DNFATCKI_DIV_BY_64, DNFATCKI_DIV_BY_128}, set at post-build, origin=Renesas_v1.0.0, default-value=DNFATCKI_DIV_BY_1  # This parameter specifies the Digital filter sampling clock frequency. | DNFATCKI_DIV_BY_1: DNFATCKI / 1 clock frequency is enabled. DNFATCKI_DIV_BY_2: NFATCKI / 2 clock frequency is enabled. DNFATCKI_DIV_BY_4: NFATCKI / 4 clock frequency is enabled. DNFATCKI_DIV_BY_8: NFATCKI / 8 clock frequency is enabled. DNFATCKI_DIV_BY_16: DNFATCKI / 16 clock frequency is enabled. DNFATCKI_DIV_BY_32: DNFATCKI / 32 clock frequency is enabled. DNFATCKI_DIV_BY_64: DNFATCKI / 64 clock frequency is enabled. DNFATCKI_DIV_BY_128 DNFATCKI / 128 clock frequency is enabled.
          enumeration PortDigitalFilterEnableInput0: {FIXED_LOW_LEVEL, BYPASSED_NOT_SUPPORTED}, set at post-build, origin=Renesas_v1.0.0, default-value=FIXED_LOW_LEVEL  # This parameter enables/disables for the signal ADCTRG0. FIXED_LOW_LEVEL: Fixed low level output signal is enabled. BYPASSED: Input signal passed through filter.
          enumeration PortDigitalFilterEnableInput1: {FIXED_LOW_LEVEL, BYPASSED_NOT_SUPPORTED}, set at post-build, origin=Renesas_v1.0.0, default-value=FIXED_LOW_LEVEL  # This parameter enables/disables for the signal ADCTRG1. FIXED_LOW_LEVEL: Fixed low level output signal is enabled. BYPASSED: Input signal passed through filter.
      container PortGroup0  # This container contains the configuration (parameters) for Port Group 0.
        container PortPin0  # This container contains the configuration (parameters) for Port Pin 0.
          boolean PortPinDirectionChangeable: set at post-build, origin=Renesas_v1.0.0, default-value=false  # Parameter to indicate if the direction is changeable on a port pin during runtime. true: Port Pin direction changeable enabled. false: Port Pin direction changeable disabled.
          boolean PortPinDioAltModeChangeable: set at post-build, origin=Renesas_v1.0.0, default-value=false  # Parameter to indicate if the mode of a port pin is changeable between DIO and Alternate during runtime by API functions Port_SetToDioMode and Port_SetToAlternateMode. Including these APIs is controlled by PortSetToDioAltModeApi. true: Dio Alternate mode is changeable. false: Dio Alternate mode is not changeable.
          boolean PortPinModeChangeable: set at post-build, origin=Renesas_v1.0.0, default-value=false  # Parameter to indicate if the mode of a port pin is changeable during runtime by API function Port_SetPinMode. Including this API is controlled by PortSetPinModeApi. true: Port Pin mode is changeable. false: Port Pin mode is not changeable.
          enumeration PortPinLevelValue: {PORT_PIN_LEVEL_LOW, PORT_PIN_LEVEL_HIGH}, set at post-build, origin=Renesas_v1.0.0, default-value=PORT_PIN_LEVEL_LOW  # Parameter to indicate port pin level value for a port pin. PORT_PIN_LEVEL_LOW: Port pin Level is low. PORT_PIN_LEVEL_HIGH: Port pin Level is high.
          enumeration PortPinInitialMode: {GTM0I6_ALT1_IN, GTMAT0O2_ALT1_OUT, SENT0RX_ALT3_IN, CSIH0CSS1_ALT3_OUT, CSIH0CSS5_ALT4_OUT, DIO}, set at post-build, origin=Renesas_v1.0.0, default-value=DIO  # Mode of the port pin for use with Port_Init() function. <Input name>_ALT<Alternative instance>_IN: Provides alternative instance for selected input. <Output name>_ALT<Alternative instance>_OUT: Provides alternative instance for selected output.
          enumeration PortPinDirection: {PORT_PIN_OUT, PORT_PIN_IN}, set at post-build, origin=Renesas_v1.0.0, default-value=PORT_PIN_IN  # The initial direction of the pin (IN or OUT). If the direction is not changeable, the value configured here is fixed. The direction must match the pin mode. PORT_PIN_IN: Port pin direction set as input. PORT_PIN_OUT: Port pin direction set as output.
          boolean PortInputBufferControl: set at post-build, origin=Renesas_v1.0.0, default-value=false  # This parameter is used as one of the factors to enable/disable port pins input buffer in DIO Mode (PMC=0). true: Port pin's input buffer is ready to be enabled in DIO Mode. false: Port pin's input buffer is disabled in DIO Mode.
          boolean PortBiDirectionControl: set at post-build, origin=Renesas_v1.0.0, default-value=false  # This parameter forces port pins input buffer and output buffer at the same time. If activated, the effect is valid independently from any other port settings. true: Activate forced Bi-directional IO buffer of the port pin. false: Deactivate forced Bi-directional IO buffer of the port pin.
          boolean PortIpControl: set at post-build, origin=Renesas_v1.0.0, default-value=false  # This parameter is used to enable/disable the direct IO control of port pins input buffer and output buffer. true: Enables the direct IO control of port pins input buffer and output buffer by the corresponding control signals of IP_ENI3(0) and IP_ENO3(0) from internal peripheral IPs. This register is valid only in Control Mode (PMC=1). false: Disables the direct IO control of port pins input buffer and output buffer.
          boolean PortPullUpOption: set at post-build, origin=Renesas_v1.0.0, default-value=false  # This register switches on or off the port pins pull-up resistor. true: Port pin's pull-up resistor is enabled. false: Port pin's pull-up resistor is disabled.
          boolean PortPullDownOption: set at post-build, origin=Renesas_v1.0.0, default-value=false  # This parameter switches on or off the port pins pull-down resistor. true: Port pin's pull-down resistor is enabled. false: Port pin's pull-down resistor is disabled.
          enumeration PortOpenDrainControl_Expansion: {PushPull, OpenDrain_N_Channel, OpenDrain_P_Channel}, set at post-build, origin=Renesas_v1.0.2, default-value=PushPull  # This parameter selects port pins output buffer function in combination of PODC and PODCE . | PushPull Specifies the PushPull type output circuit characteristics and updates both PODC and PODCE registers as 0 0 respectively. OpenDrain_N_Channel specifies the N-ch open drain type output circuit characteristics and updates the PODC and PODCE registers as 1 0 respectively. OpenDrain_P_Channel specifies the P-ch open drain type output circuit characteristics and updates the PODC and PODCE registers as 1 1 respectively.
          boolean PortOutputLevelInversion: set at post-build, origin=Renesas_v1.0.0, default-value=false  # This parameter specifies whether the output level from a pin is inverted or not. true: Pin output level is inverted. false: Pin output level is not inverted.
          enumeration PortDriveStrengthControl: {SLOW, FAST}, set at post-build, origin=Renesas_v1.0.0, default-value=SLOW  # This parameter selects the port pins output drive strength as high strength or low strength type. This functionality is also referred to fast (high strength) and slow (low strength) behavior of output buffer. SLOW: Lower drive strength (slow mode) is selected for port pin's output buffer. FAST: Higher drive strength (fast mode) is selected for port pin's output buffer.
          boolean PortUniversalCharacteristicCntrl: set at post-build, origin=Renesas_v1.0.0, default-value=false  # This parameter selects the port pins output drive strength as high or low type. The PortDriveStrengthControl must be enabled for this feature. false: PortDriveStrengthControl parameter specifies the output driver strength of the port pin. true : Number of output buffer characteristics selection capability is expanded, the maximum of 4 characteristics selection is possible PUCCn PDSCn 0 0 Output characteristic selection 1 (400 Ohm buffer) 0 1 Output characteristic selection 2 (200 Ohm buffer) 1 0 Output characteristic selection 3 (100 Ohm buffer) 1 1 Output characteristic selection 4 (50 Ohm buffer)
          enumeration PortInputSelection: {TYPE1_SHMT1, TYPE2_SHMT4}, set at post-build, origin=Renesas_v1.0.0, default-value=TYPE1_SHMT1  # This setting specifies the input buffer characteristics. TYPE1_SHMT1: TYPE 1 buffer is selected. TYPE2_SHMT4: TYPE 2 buffer is selected.
        container PortPin1  # This container contains the configuration (parameters) for Port Pin 0.
          boolean PortPinDirectionChangeable: set at post-build, origin=Renesas_v1.0.0, default-value=false  # Parameter to indicate if the direction is changeable on a port pin during runtime. true: Port Pin direction changeable enabled. false: Port Pin direction changeable disabled.
          boolean PortPinDioAltModeChangeable: set at post-build, origin=Renesas_v1.0.0, default-value=false  # Parameter to indicate if the mode of a port pin is changeable between DIO and Alternate during runtime by API functions Port_SetToDioMode and Port_SetToAlternateMode. Including these APIs is controlled by PortSetToDioAltModeApi. true: Dio Alternate mode is changeable. false: Dio Alternate mode is not changeable.
          boolean PortPinModeChangeable: set at post-build, origin=Renesas_v1.0.0, default-value=false  # Parameter to indicate if the mode of a port pin is changeable during runtime by API function Port_SetPinMode. Including this API is controlled by PortSetPinModeApi. true: Port Pin mode is changeable. false: Port Pin mode is not changeable.
          enumeration PortPinLevelValue: {PORT_PIN_LEVEL_LOW, PORT_PIN_LEVEL_HIGH}, set at post-build, origin=Renesas_v1.0.0, default-value=PORT_PIN_LEVEL_LOW  # Parameter to indicate port pin level value for a port pin. PORT_PIN_LEVEL_LOW: Port pin Level is low. PORT_PIN_LEVEL_HIGH: Port pin Level is high.
          enumeration PortPinInitialMode: {GTM0I3_ALT1_IN, GTMAT0O3N_ALT1_OUT, SENT1RX_ALT3_IN, CSIH1CSS6_ALT3_OUT, CSIH0CSS6_ALT4_OUT, DIO}, set at post-build, origin=Renesas_v1.0.0, default-value=DIO  # Mode of the port pin for use with Port_Init() function. <Input name>_ALT<Alternative instance>_IN: Provides alternative instance for selected input. <Output name>_ALT<Alternative instance>_OUT: Provides alternative instance for selected output.
          enumeration PortPinDirection: {PORT_PIN_OUT, PORT_PIN_IN}, set at post-build, origin=Renesas_v1.0.0, default-value=PORT_PIN_IN  # The initial direction of the pin (IN or OUT). If the direction is not changeable, the value configured here is fixed. The direction must match the pin mode. PORT_PIN_IN: Port pin direction set as input. PORT_PIN_OUT: Port pin direction set as output.
          boolean PortInputBufferControl: set at post-build, origin=Renesas_v1.0.0, default-value=false  # This parameter is used as one of the factors to enable/disable port pins input buffer in DIO Mode (PMC=0). true: Port pin's input buffer is ready to be enabled in DIO Mode. false: Port pin's input buffer is disabled in DIO Mode.
          boolean PortBiDirectionControl: set at post-build, origin=Renesas_v1.0.0, default-value=false  # This parameter forces port pins input buffer and output buffer at the same time. If activated, the effect is valid independently from any other port settings. true: Activate forced Bi-directional IO buffer of the port pin. false: Deactivate forced Bi-directional IO buffer of the port pin.
          boolean PortIpControl: set at post-build, origin=Renesas_v1.0.0, default-value=false  # This parameter is used to enable/disable the direct IO control of port pins input buffer and output buffer. true: Enables the direct IO control of port pins input buffer and output buffer by the corresponding control signals of IP_ENI3(0) and IP_ENO3(0) from internal peripheral IPs. This register is valid only in Control Mode (PMC=1). false: Disables the direct IO control of port pins input buffer and output buffer.
          boolean PortPullUpOption: set at post-build, origin=Renesas_v1.0.0, default-value=false  # This register switches on or off the port pins pull-up resistor. true: Port pin's pull-up resistor is enabled. false: Port pin's pull-up resistor is disabled.
          boolean PortPullDownOption: set at post-build, origin=Renesas_v1.0.0, default-value=false  # This parameter switches on or off the port pins pull-down resistor. true: Port pin's pull-down resistor is enabled. false: Port pin's pull-down resistor is disabled.
          enumeration PortOpenDrainControl_Expansion: {PushPull, OpenDrain_N_Channel, OpenDrain_P_Channel}, set at post-build, origin=Renesas_v1.0.2, default-value=PushPull  # This parameter selects port pins output buffer function in combination of PODC and PODCE . | PushPull Specifies the PushPull type output circuit characteristics and updates both PODC and PODCE registers as 0 0 respectively. OpenDrain_N_Channel specifies the N-ch open drain type output circuit characteristics and updates the PODC and PODCE registers as 1 0 respectively. OpenDrain_P_Channel specifies the P-ch open drain type output circuit characteristics and updates the PODC and PODCE registers as 1 1 respectively.
          boolean PortOutputLevelInversion: set at post-build, origin=Renesas_v1.0.0, default-value=false  # This parameter specifies whether the output level from a pin is inverted or not. true: Pin output level is inverted. false: Pin output level is not inverted.
          enumeration PortDriveStrengthControl: {SLOW, FAST}, set at post-build, origin=Renesas_v1.0.0, default-value=SLOW  # This parameter selects the port pins output drive strength as high strength or low strength type. This functionality is also referred to fast (high strength) and slow (low strength) behavior of output buffer. SLOW: Lower drive strength (slow mode) is selected for port pin's output buffer. FAST: Higher drive strength (fast mode) is selected for port pin's output buffer.
          boolean PortUniversalCharacteristicCntrl: set at post-build, origin=Renesas_v1.0.0, default-value=false  # This parameter selects the port pins output drive strength as high or low type. The PortDriveStrengthControl must be enabled for this feature. | false: PortDriveStrengthControl parameter specifies the output driver strength of the port pin. true : Number of output buffer characteristics selection capability is expanded, the maximum of 4 characteristics selection is possible PUCCn PDSCn 0 0 Output characteristic selection 1 (400 Ohm buffer) 0 1 Output characteristic selection 2 (200 Ohm buffer) 1 0 Output characteristic selection 3 (100 Ohm buffer) 1 1 Output characteristic selection 4 (50 Ohm buffer)
          enumeration PortInputSelection: {TYPE1_SHMT1, TYPE2_SHMT4}, set at post-build, origin=Renesas_v1.0.0, default-value=TYPE1_SHMT1  # This setting specifies the input buffer characteristics. TYPE1_SHMT1: TYPE 1 buffer is selected. TYPE2_SHMT4: TYPE 2 buffer is selected.
        container PortPin2  # This container contains the configuration (parameters) for Port Pin 0.
          boolean PortPinDirectionChangeable: set at post-build, origin=Renesas_v1.0.0, default-value=false  # Parameter to indicate if the direction is changeable on a port pin during runtime. true: Port Pin direction changeable enabled. false: Port Pin direction changeable disabled.
          boolean PortPinDioAltModeChangeable: set at post-build, origin=Renesas_v1.0.0, default-value=false  # Parameter to indicate if the mode of a port pin is changeable between DIO and Alternate during runtime by API functions Port_SetToDioMode and Port_SetToAlternateMode. Including these APIs is controlled by PortSetToDioAltModeApi. true: Dio Alternate mode is changeable. false: Dio Alternate mode is not changeable.
          boolean PortPinModeChangeable: set at post-build, origin=Renesas_v1.0.0, default-value=false  # Parameter to indicate if the mode of a port pin is changeable during runtime by API function Port_SetPinMode. Including this API is controlled by PortSetPinModeApi. true: Port Pin mode is changeable. false: Port Pin mode is not changeable.
          enumeration PortPinLevelValue: {PORT_PIN_LEVEL_LOW, PORT_PIN_LEVEL_HIGH}, set at post-build, origin=Renesas_v1.0.0, default-value=PORT_PIN_LEVEL_LOW  # Parameter to indicate port pin level value for a port pin. PORT_PIN_LEVEL_LOW: Port pin Level is low. PORT_PIN_LEVEL_HIGH: Port pin Level is high.
          enumeration PortPinInitialMode: {GTM0I2_ALT1_IN, GTMAT1O1_ALT1_OUT, CSIH0CSS4_ALT3_OUT, CSIH2CSS2_ALT2_OUT, DIO}, set at post-build, origin=Renesas_v1.0.0, default-value=DIO  # Mode of the port pin for use with Port_Init() function. <Input name>_ALT<Alternative instance>_IN: Provides alternative instance for selected input. <Output name>_ALT<Alternative instance>_OUT: Provides alternative instance for selected output.
          enumeration PortPinDirection: {PORT_PIN_OUT, PORT_PIN_IN}, set at post-build, origin=Renesas_v1.0.0, default-value=PORT_PIN_IN  # The initial direction of the pin (IN or OUT). If the direction is not changeable, the value configured here is fixed. The direction must match the pin mode. PORT_PIN_IN: Port pin direction set as input. PORT_PIN_OUT: Port pin direction set as output.
          boolean PortInputBufferControl: set at post-build, origin=Renesas_v1.0.0, default-value=false  # This parameter is used as one of the factors to enable/disable port pins input buffer in DIO Mode (PMC=0). true: Port pin's input buffer is ready to be enabled in DIO Mode. false: Port pin's input buffer is disabled in DIO Mode.
          boolean PortBiDirectionControl: set at post-build, origin=Renesas_v1.0.0, default-value=false  # This parameter forces port pins input buffer and output buffer at the same time. If activated, the effect is valid independently from any other port settings. true: Activate forced Bi-directional IO buffer of the port pin. false: Deactivate forced Bi-directional IO buffer of the port pin.
          boolean PortIpControl: set at post-build, origin=Renesas_v1.0.0, default-value=false  # This parameter is used to enable/disable the direct IO control of port pins input buffer and output buffer. true: Enables the direct IO control of port pins input buffer and output buffer by the corresponding control signals of IP_ENI3(0) and IP_ENO3(0) from internal peripheral IPs. This register is valid only in Control Mode (PMC=1). false: Disables the direct IO control of port pins input buffer and output buffer.
          boolean PortPullUpOption: set at post-build, origin=Renesas_v1.0.0, default-value=false  # This register switches on or off the port pins pull-up resistor. true: Port pin's pull-up resistor is enabled. false: Port pin's pull-up resistor is disabled.
          boolean PortPullDownOption: set at post-build, origin=Renesas_v1.0.0, default-value=false  # This parameter switches on or off the port pins pull-down resistor. true: Port pin's pull-down resistor is enabled. false: Port pin's pull-down resistor is disabled.
          enumeration PortOpenDrainControl_Expansion: {PushPull, OpenDrain_N_Channel, OpenDrain_P_Channel}, set at post-build, origin=Renesas_v1.0.2, default-value=PushPull  # This parameter selects port pins output buffer function in combination of PODC and PODCE . | PushPull Specifies the PushPull type output circuit characteristics and updates both PODC and PODCE registers as 0 0 respectively. OpenDrain_N_Channel specifies the N-ch open drain type output circuit characteristics and updates the PODC and PODCE registers as 1 0 respectively. OpenDrain_P_Channel specifies the P-ch open drain type output circuit characteristics and updates the PODC and PODCE registers as 1 1 respectively.
          boolean PortOutputLevelInversion: set at post-build, origin=Renesas_v1.0.0, default-value=false  # This parameter specifies whether the output level from a pin is inverted or not. true: Pin output level is inverted. false: Pin output level is not inverted.
          enumeration PortDriveStrengthControl: {SLOW, FAST}, set at post-build, origin=Renesas_v1.0.0, default-value=SLOW  # This parameter selects the port pins output drive strength as high strength or low strength type. This functionality is also referred to fast (high strength) and slow (low strength) behavior of output buffer. SLOW: Lower drive strength (slow mode) is selected for port pin's output buffer. FAST: Higher drive strength (fast mode) is selected for port pin's output buffer.
          boolean PortUniversalCharacteristicCntrl: set at post-build, origin=Renesas_v1.0.0, default-value=false  # This parameter selects the port pins output drive strength as high or low type. The PortDriveStrengthControl must be enabled for this feature. | false: PortDriveStrengthControl parameter specifies the output driver strength of the port pin. true : Number of output buffer characteristics selection capability is expanded, the maximum of 4 characteristics selection is possible PUCCn PDSCn 0 0 Output characteristic selection 1 (400 Ohm buffer) 0 1 Output characteristic selection 2 (200 Ohm buffer) 1 0 Output characteristic selection 3 (100 Ohm buffer) 1 1 Output characteristic selection 4 (50 Ohm buffer)
          enumeration PortInputSelection: {TYPE1_SHMT1, TYPE2_SHMT4}, set at post-build, origin=Renesas_v1.0.0, default-value=TYPE1_SHMT1  # This setting specifies the input buffer characteristics. TYPE1_SHMT1: TYPE 1 buffer is selected. TYPE2_SHMT4: TYPE 2 buffer is selected.
        container PortPin3  # This container contains the configuration (parameters) for Port Pin 0.
          boolean PortPinDirectionChangeable: set at post-build, origin=Renesas_v1.0.0, default-value=false  # Parameter to indicate if the direction is changeable on a port pin during runtime. true: Port Pin direction changeable enabled. false: Port Pin direction changeable disabled.
          boolean PortPinDioAltModeChangeable: set at post-build, origin=Renesas_v1.0.0, default-value=false  # Parameter to indicate if the mode of a port pin is changeable between DIO and Alternate during runtime by API functions Port_SetToDioMode and Port_SetToAlternateMode. Including these APIs is controlled by PortSetToDioAltModeApi. true: Dio Alternate mode is changeable. false: Dio Alternate mode is not changeable.
          boolean PortPinModeChangeable: set at post-build, origin=Renesas_v1.0.0, default-value=false  # Parameter to indicate if the mode of a port pin is changeable during runtime by API function Port_SetPinMode. Including this API is controlled by PortSetPinModeApi. true: Port Pin mode is changeable. false: Port Pin mode is not changeable.
          enumeration PortPinLevelValue: {PORT_PIN_LEVEL_LOW, PORT_PIN_LEVEL_HIGH}, set at post-build, origin=Renesas_v1.0.0, default-value=PORT_PIN_LEVEL_LOW  # Parameter to indicate port pin level value for a port pin. PORT_PIN_LEVEL_LOW: Port pin Level is low. PORT_PIN_LEVEL_HIGH: Port pin Level is high.
          enumeration PortPinInitialMode: {GTM1I0_ALT1_IN, GTMAT0O0_ALT1_OUT, CSIH0CSS3_ALT3_OUT, CSIH2CSS4_ALT2_OUT, DIO}, set at post-build, origin=Renesas_v1.0.0, default-value=DIO  # Mode of the port pin for use with Port_Init() function. <Input name>_ALT<Alternative instance>_IN: Provides alternative instance for selected input. <Output name>_ALT<Alternative instance>_OUT: Provides alternative instance for selected output.
          enumeration PortPinDirection: {PORT_PIN_OUT, PORT_PIN_IN}, set at post-build, origin=Renesas_v1.0.0, default-value=PORT_PIN_IN  # The initial direction of the pin (IN or OUT). If the direction is not changeable, the value configured here is fixed. The direction must match the pin mode. PORT_PIN_IN: Port pin direction set as input. PORT_PIN_OUT: Port pin direction set as output.
          boolean PortInputBufferControl: set at post-build, origin=Renesas_v1.0.0, default-value=false  # This parameter is used as one of the factors to enable/disable port pins input buffer in DIO Mode (PMC=0). true: Port pin's input buffer is ready to be enabled in DIO Mode. false: Port pin's input buffer is disabled in DIO Mode.
          boolean PortBiDirectionControl: set at post-build, origin=Renesas_v1.0.0, default-value=false  # This parameter forces port pins input buffer and output buffer at the same time. If activated, the effect is valid independently from any other port settings. true: Activate forced Bi-directional IO buffer of the port pin. false: Deactivate forced Bi-directional IO buffer of the port pin.
          boolean PortIpControl: set at post-build, origin=Renesas_v1.0.0, default-value=false  # This parameter is used to enable/disable the direct IO control of port pins input buffer and output buffer. true: Enables the direct IO control of port pins input buffer and output buffer by the corresponding control signals of IP_ENI3(0) and IP_ENO3(0) from internal peripheral IPs. This register is valid only in Control Mode (PMC=1). false: Disables the direct IO control of port pins input buffer and output buffer.
          boolean PortPullUpOption: set at post-build, origin=Renesas_v1.0.0, default-value=false  # This register switches on or off the port pins pull-up resistor. true: Port pin's pull-up resistor is enabled. false: Port pin's pull-up resistor is disabled.
          boolean PortPullDownOption: set at post-build, origin=Renesas_v1.0.0, default-value=false  # This parameter switches on or off the port pins pull-down resistor. true: Port pin's pull-down resistor is enabled. false: Port pin's pull-down resistor is disabled.
          enumeration PortOpenDrainControl_Expansion: {PushPull, OpenDrain_N_Channel, OpenDrain_P_Channel}, set at post-build, origin=Renesas_v1.0.2, default-value=PushPull  # This parameter selects port pins output buffer function in combination of PODC and PODCE . | PushPull Specifies the PushPull type output circuit characteristics and updates both PODC and PODCE registers as 0 0 respectively. OpenDrain_N_Channel specifies the N-ch open drain type output circuit characteristics and updates the PODC and PODCE registers as 1 0 respectively. OpenDrain_P_Channel specifies the P-ch open drain type output circuit characteristics and updates the PODC and PODCE registers as 1 1 respectively.
          boolean PortOutputLevelInversion: set at post-build, origin=Renesas_v1.0.0, default-value=false  # This parameter specifies whether the output level from a pin is inverted or not. true: Pin output level is inverted. false: Pin output level is not inverted.
          enumeration PortDriveStrengthControl: {SLOW, FAST}, set at post-build, origin=Renesas_v1.0.0, default-value=SLOW  # This parameter selects the port pins output drive strength as high strength or low strength type. This functionality is also referred to fast (high strength) and slow (low strength) behavior of output buffer. SLOW: Lower drive strength (slow mode) is selected for port pin's output buffer. FAST: Higher drive strength (fast mode) is selected for port pin's output buffer.
          boolean PortUniversalCharacteristicCntrl: set at post-build, origin=Renesas_v1.0.0, default-value=false  # This parameter selects the port pins output drive strength as high or low type. The PortDriveStrengthControl must be enabled for this feature. | false: PortDriveStrengthControl parameter specifies the output driver strength of the port pin. true : Number of output buffer characteristics selection capability is expanded, the maximum of 4 characteristics selection is possible PUCCn PDSCn 0 0 Output characteristic selection 1 (400 Ohm buffer) 0 1 Output characteristic selection 2 (200 Ohm buffer) 1 0 Output characteristic selection 3 (100 Ohm buffer) 1 1 Output characteristic selection 4 (50 Ohm buffer)
          enumeration PortInputSelection: {TYPE1_SHMT1, TYPE2_SHMT4}, set at post-build, origin=Renesas_v1.0.0, default-value=TYPE1_SHMT1  # This setting specifies the input buffer characteristics. TYPE1_SHMT1: TYPE 1 buffer is selected. TYPE2_SHMT4: TYPE 2 buffer is selected.
        container PortPin4  # This container contains the configuration (parameters) for Port Pin 0.
          boolean PortPinDirectionChangeable: set at post-build, origin=Renesas_v1.0.0, default-value=false  # Parameter to indicate if the direction is changeable on a port pin during runtime. true: Port Pin direction changeable enabled. false: Port Pin direction changeable disabled.
          boolean PortPinDioAltModeChangeable: set at post-build, origin=Renesas_v1.0.0, default-value=false  # Parameter to indicate if the mode of a port pin is changeable between DIO and Alternate during runtime by API functions Port_SetToDioMode and Port_SetToAlternateMode. Including these APIs is controlled by PortSetToDioAltModeApi. true: Dio Alternate mode is changeable. false: Dio Alternate mode is not changeable.
          boolean PortPinModeChangeable: set at post-build, origin=Renesas_v1.0.0, default-value=false  # Parameter to indicate if the mode of a port pin is changeable during runtime by API function Port_SetPinMode. Including this API is controlled by PortSetPinModeApi. true: Port Pin mode is changeable. false: Port Pin mode is not changeable.
          enumeration PortPinLevelValue: {PORT_PIN_LEVEL_LOW, PORT_PIN_LEVEL_HIGH}, set at post-build, origin=Renesas_v1.0.0, default-value=PORT_PIN_LEVEL_LOW  # Parameter to indicate port pin level value for a port pin. PORT_PIN_LEVEL_LOW: Port pin Level is low. PORT_PIN_LEVEL_HIGH: Port pin Level is high.
          enumeration PortPinInitialMode: {GTM0I1_ALT1_IN, GTMAT1O2_ALT1_OUT, CSIH1CSS2_ALT3_OUT, CSIH2CSS5_ALT2_OUT, DIO}, set at post-build, origin=Renesas_v1.0.0, default-value=DIO  # Mode of the port pin for use with Port_Init() function. <Input name>_ALT<Alternative instance>_IN: Provides alternative instance for selected input. <Output name>_ALT<Alternative instance>_OUT: Provides alternative instance for selected output.
          enumeration PortPinDirection: {PORT_PIN_OUT, PORT_PIN_IN}, set at post-build, origin=Renesas_v1.0.0, default-value=PORT_PIN_IN  # The initial direction of the pin (IN or OUT). If the direction is not changeable, the value configured here is fixed. The direction must match the pin mode. PORT_PIN_IN: Port pin direction set as input. PORT_PIN_OUT: Port pin direction set as output.
          boolean PortInputBufferControl: set at post-build, origin=Renesas_v1.0.0, default-value=false  # This parameter is used as one of the factors to enable/disable port pins input buffer in DIO Mode (PMC=0). true: Port pin's input buffer is ready to be enabled in DIO Mode. false: Port pin's input buffer is disabled in DIO Mode.
          boolean PortBiDirectionControl: set at post-build, origin=Renesas_v1.0.0, default-value=false  # This parameter forces port pins input buffer and output buffer at the same time. If activated, the effect is valid independently from any other port settings. true: Activate forced Bi-directional IO buffer of the port pin. false: Deactivate forced Bi-directional IO buffer of the port pin.
          boolean PortIpControl: set at post-build, origin=Renesas_v1.0.0, default-value=false  # This parameter is used to enable/disable the direct IO control of port pins input buffer and output buffer. true: Enables the direct IO control of port pins input buffer and output buffer by the corresponding control signals of IP_ENI3(0) and IP_ENO3(0) from internal peripheral IPs. This register is valid only in Control Mode (PMC=1). false: Disables the direct IO control of port pins input buffer and output buffer.
          boolean PortPullUpOption: set at post-build, origin=Renesas_v1.0.0, default-value=false  # This register switches on or off the port pins pull-up resistor. true: Port pin's pull-up resistor is enabled. false: Port pin's pull-up resistor is disabled.
          boolean PortPullDownOption: set at post-build, origin=Renesas_v1.0.0, default-value=false  # This parameter switches on or off the port pins pull-down resistor. true: Port pin's pull-down resistor is enabled. false: Port pin's pull-down resistor is disabled.
          enumeration PortOpenDrainControl_Expansion: {PushPull, OpenDrain_N_Channel, OpenDrain_P_Channel}, set at post-build, origin=Renesas_v1.0.2, default-value=PushPull  # This parameter selects port pins output buffer function in combination of PODC and PODCE . | PushPull Specifies the PushPull type output circuit characteristics and updates both PODC and PODCE registers as 0 0 respectively. OpenDrain_N_Channel specifies the N-ch open drain type output circuit characteristics and updates the PODC and PODCE registers as 1 0 respectively. OpenDrain_P_Channel specifies the P-ch open drain type output circuit characteristics and updates the PODC and PODCE registers as 1 1 respectively.
          boolean PortOutputLevelInversion: set at post-build, origin=Renesas_v1.0.0, default-value=false  # This parameter specifies whether the output level from a pin is inverted or not. true: Pin output level is inverted. false: Pin output level is not inverted.
          enumeration PortDriveStrengthControl: {SLOW, FAST}, set at post-build, origin=Renesas_v1.0.0, default-value=SLOW  # This parameter selects the port pins output drive strength as high strength or low strength type. This functionality is also referred to fast (high strength) and slow (low strength) behavior of output buffer. SLOW: Lower drive strength (slow mode) is selected for port pin's output buffer. FAST: Higher drive strength (fast mode) is selected for port pin's output buffer.
          boolean PortUniversalCharacteristicCntrl: set at post-build, origin=Renesas_v1.0.0, default-value=false  # This parameter selects the port pins output drive strength as high or low type. The PortDriveStrengthControl must be enabled for this feature. | false: PortDriveStrengthControl parameter specifies the output driver strength of the port pin. true : Number of output buffer characteristics selection capability is expanded, the maximum of 4 characteristics selection is possible PUCCn PDSCn 0 0 Output characteristic selection 1 (400 Ohm buffer) 0 1 Output characteristic selection 2 (200 Ohm buffer) 1 0 Output characteristic selection 3 (100 Ohm buffer) 1 1 Output characteristic selection 4 (50 Ohm buffer)
          enumeration PortInputSelection: {TYPE1_SHMT1, TYPE2_SHMT4}, set at post-build, origin=Renesas_v1.0.0, default-value=TYPE1_SHMT1  # This setting specifies the input buffer characteristics. TYPE1_SHMT1: TYPE 1 buffer is selected. TYPE2_SHMT4: TYPE 2 buffer is selected.
        container PortPin5  # This container contains the configuration (parameters) for Port Pin 0.
          boolean PortPinDirectionChangeable: set at post-build, origin=Renesas_v1.0.0, default-value=false  # Parameter to indicate if the direction is changeable on a port pin during runtime. true: Port Pin direction changeable enabled. false: Port Pin direction changeable disabled.
          boolean PortPinDioAltModeChangeable: set at post-build, origin=Renesas_v1.0.0, default-value=false  # Parameter to indicate if the mode of a port pin is changeable between DIO and Alternate during runtime by API functions Port_SetToDioMode and Port_SetToAlternateMode. Including these APIs is controlled by PortSetToDioAltModeApi. true: Dio Alternate mode is changeable. false: Dio Alternate mode is not changeable.
          boolean PortPinModeChangeable: set at post-build, origin=Renesas_v1.0.0, default-value=false  # Parameter to indicate if the mode of a port pin is changeable during runtime by API function Port_SetPinMode. Including this API is controlled by PortSetPinModeApi. true: Port Pin mode is changeable. false: Port Pin mode is not changeable.
          enumeration PortPinLevelValue: {PORT_PIN_LEVEL_LOW, PORT_PIN_LEVEL_HIGH}, set at post-build, origin=Renesas_v1.0.0, default-value=PORT_PIN_LEVEL_LOW  # Parameter to indicate port pin level value for a port pin. PORT_PIN_LEVEL_LOW: Port pin Level is low. PORT_PIN_LEVEL_HIGH: Port pin Level is high.
          enumeration PortPinInitialMode: {GTM1I3_ALT1_IN, GTMAT1O0_ALT1_OUT, INTP3_ALT2_IN, CSIH1CSS1_ALT4_OUT, CSIH2CSS6_ALT2_OUT, DIO}, set at post-build, origin=Renesas_v1.0.0, default-value=DIO  # Mode of the port pin for use with Port_Init() function. <Input name>_ALT<Alternative instance>_IN: Provides alternative instance for selected input. <Output name>_ALT<Alternative instance>_OUT: Provides alternative instance for selected output.
          enumeration PortPinDirection: {PORT_PIN_OUT, PORT_PIN_IN}, set at post-build, origin=Renesas_v1.0.0, default-value=PORT_PIN_IN  # The initial direction of the pin (IN or OUT). If the direction is not changeable, the value configured here is fixed. The direction must match the pin mode. PORT_PIN_IN: Port pin direction set as input. PORT_PIN_OUT: Port pin direction set as output.
          boolean PortInputBufferControl: set at post-build, origin=Renesas_v1.0.0, default-value=false  # This parameter is used as one of the factors to enable/disable port pins input buffer in DIO Mode (PMC=0). true: Port pin's input buffer is ready to be enabled in DIO Mode. false: Port pin's input buffer is disabled in DIO Mode.
          boolean PortBiDirectionControl: set at post-build, origin=Renesas_v1.0.0, default-value=false  # This parameter forces port pins input buffer and output buffer at the same time. If activated, the effect is valid independently from any other port settings. true: Activate forced Bi-directional IO buffer of the port pin. false: Deactivate forced Bi-directional IO buffer of the port pin.
          boolean PortIpControl: set at post-build, origin=Renesas_v1.0.0, default-value=false  # This parameter is used to enable/disable the direct IO control of port pins input buffer and output buffer. true: Enables the direct IO control of port pins input buffer and output buffer by the corresponding control signals of IP_ENI3(0) and IP_ENO3(0) from internal peripheral IPs. This register is valid only in Control Mode (PMC=1). false: Disables the direct IO control of port pins input buffer and output buffer.
          boolean PortPullUpOption: set at post-build, origin=Renesas_v1.0.0, default-value=false  # This register switches on or off the port pins pull-up resistor. true: Port pin's pull-up resistor is enabled. false: Port pin's pull-up resistor is disabled.
          boolean PortPullDownOption: set at post-build, origin=Renesas_v1.0.0, default-value=false  # This parameter switches on or off the port pins pull-down resistor. true: Port pin's pull-down resistor is enabled. false: Port pin's pull-down resistor is disabled.
          enumeration PortOpenDrainControl_Expansion: {PushPull, OpenDrain_N_Channel, OpenDrain_P_Channel}, set at post-build, origin=Renesas_v1.0.2, default-value=PushPull  # This parameter selects port pins output buffer function in combination of PODC and PODCE . | PushPull Specifies the PushPull type output circuit characteristics and updates both PODC and PODCE registers as 0 0 respectively. OpenDrain_N_Channel specifies the N-ch open drain type output circuit characteristics and updates the PODC and PODCE registers as 1 0 respectively. OpenDrain_P_Channel specifies the P-ch open drain type output circuit characteristics and updates the PODC and PODCE registers as 1 1 respectively.
          boolean PortOutputLevelInversion: set at post-build, origin=Renesas_v1.0.0, default-value=false  # This parameter specifies whether the output level from a pin is inverted or not. true: Pin output level is inverted. false: Pin output level is not inverted.
          enumeration PortDriveStrengthControl: {SLOW, FAST}, set at post-build, origin=Renesas_v1.0.0, default-value=SLOW  # This parameter selects the port pins output drive strength as high strength or low strength type. This functionality is also referred to fast (high strength) and slow (low strength) behavior of output buffer. SLOW: Lower drive strength (slow mode) is selected for port pin's output buffer. FAST: Higher drive strength (fast mode) is selected for port pin's output buffer.
          boolean PortUniversalCharacteristicCntrl: set at post-build, origin=Renesas_v1.0.0, default-value=false  # This parameter selects the port pins output drive strength as high or low type. The PortDriveStrengthControl must be enabled for this feature. | false: PortDriveStrengthControl parameter specifies the output driver strength of the port pin. true : Number of output buffer characteristics selection capability is expanded, the maximum of 4 characteristics selection is possible PUCCn PDSCn 0 0 Output characteristic selection 1 (400 Ohm buffer) 0 1 Output characteristic selection 2 (200 Ohm buffer) 1 0 Output characteristic selection 3 (100 Ohm buffer) 1 1 Output characteristic selection 4 (50 Ohm buffer)
          enumeration PortInputSelection: {TYPE1_SHMT1, TYPE2_SHMT4}, set at post-build, origin=Renesas_v1.0.0, default-value=TYPE1_SHMT1  # This setting specifies the input buffer characteristics. TYPE1_SHMT1: TYPE 1 buffer is selected. TYPE2_SHMT4: TYPE 2 buffer is selected.
        container PortPin6  # This container contains the configuration (parameters) for Port Pin 0.
          boolean PortPinDirectionChangeable: set at post-build, origin=Renesas_v1.0.0, default-value=false  # Parameter to indicate if the direction is changeable on a port pin during runtime. true: Port Pin direction changeable enabled. false: Port Pin direction changeable disabled.
          boolean PortPinDioAltModeChangeable: set at post-build, origin=Renesas_v1.0.0, default-value=false  # Parameter to indicate if the mode of a port pin is changeable between DIO and Alternate during runtime by API functions Port_SetToDioMode and Port_SetToAlternateMode. Including these APIs is controlled by PortSetToDioAltModeApi. true: Dio Alternate mode is changeable. false: Dio Alternate mode is not changeable.
          boolean PortPinModeChangeable: set at post-build, origin=Renesas_v1.0.0, default-value=false  # Parameter to indicate if the mode of a port pin is changeable during runtime by API function Port_SetPinMode. Including this API is controlled by PortSetPinModeApi. true: Port Pin mode is changeable. false: Port Pin mode is not changeable.
          enumeration PortPinLevelValue: {PORT_PIN_LEVEL_LOW, PORT_PIN_LEVEL_HIGH}, set at post-build, origin=Renesas_v1.0.0, default-value=PORT_PIN_LEVEL_LOW  # Parameter to indicate port pin level value for a port pin. PORT_PIN_LEVEL_LOW: Port pin Level is low. PORT_PIN_LEVEL_HIGH: Port pin Level is high.
          enumeration PortPinInitialMode: {GTM0I0_ALT1_IN, GTMAT0O6_ALT1_OUT, CSIH2CSS7_ALT2_OUT, CSIH1CSS0_ALT4_OUT, DIO}, set at post-build, origin=Renesas_v1.0.0, default-value=DIO  # Mode of the port pin for use with Port_Init() function. <Input name>_ALT<Alternative instance>_IN: Provides alternative instance for selected input. <Output name>_ALT<Alternative instance>_OUT: Provides alternative instance for selected output.
          enumeration PortPinDirection: {PORT_PIN_OUT, PORT_PIN_IN}, set at post-build, origin=Renesas_v1.0.0, default-value=PORT_PIN_IN  # The initial direction of the pin (IN or OUT). If the direction is not changeable, the value configured here is fixed. The direction must match the pin mode. PORT_PIN_IN: Port pin direction set as input. PORT_PIN_OUT: Port pin direction set as output.
          boolean PortInputBufferControl: set at post-build, origin=Renesas_v1.0.0, default-value=false  # This parameter is used as one of the factors to enable/disable port pins input buffer in DIO Mode (PMC=0). true: Port pin's input buffer is ready to be enabled in DIO Mode. false: Port pin's input buffer is disabled in DIO Mode.
          boolean PortBiDirectionControl: set at post-build, origin=Renesas_v1.0.0, default-value=false  # This parameter forces port pins input buffer and output buffer at the same time. If activated, the effect is valid independently from any other port settings. true: Activate forced Bi-directional IO buffer of the port pin. false: Deactivate forced Bi-directional IO buffer of the port pin.
          boolean PortPullUpOption: set at post-build, origin=Renesas_v1.0.0, default-value=false  # This register switches on or off the port pins pull-up resistor. true: Port pin's pull-up resistor is enabled. false: Port pin's pull-up resistor is disabled.
          boolean PortPullDownOption: set at post-build, origin=Renesas_v1.0.0, default-value=false  # This parameter switches on or off the port pins pull-down resistor. true: Port pin's pull-down resistor is enabled. false: Port pin's pull-down resistor is disabled.
          enumeration PortOpenDrainControl_Expansion: {PushPull, OpenDrain_N_Channel, OpenDrain_P_Channel}, set at post-build, origin=Renesas_v1.0.2, default-value=PushPull  # This parameter selects port pins output buffer function in combination of PODC and PODCE . | PushPull Specifies the PushPull type output circuit characteristics and updates both PODC and PODCE registers as 0 0 respectively. OpenDrain_N_Channel specifies the N-ch open drain type output circuit characteristics and updates the PODC and PODCE registers as 1 0 respectively. OpenDrain_P_Channel specifies the P-ch open drain type output circuit characteristics and updates the PODC and PODCE registers as 1 1 respectively.
          boolean PortOutputLevelInversion: set at post-build, origin=Renesas_v1.0.0, default-value=false  # This parameter specifies whether the output level from a pin is inverted or not. true: Pin output level is inverted. false: Pin output level is not inverted.
          enumeration PortDriveStrengthControl: {SLOW, FAST}, set at post-build, origin=Renesas_v1.0.0, default-value=SLOW  # This parameter selects the port pins output drive strength as high strength or low strength type. This functionality is also referred to fast (high strength) and slow (low strength) behavior of output buffer. SLOW: Lower drive strength (slow mode) is selected for port pin's output buffer. FAST: Higher drive strength (fast mode) is selected for port pin's output buffer.
          boolean PortUniversalCharacteristicCntrl: set at post-build, origin=Renesas_v1.0.0, default-value=false  # This parameter selects the port pins output drive strength as high or low type. The PortDriveStrengthControl must be enabled for this feature. | false: PortDriveStrengthControl parameter specifies the output driver strength of the port pin. true : Number of output buffer characteristics selection capability is expanded, the maximum of 4 characteristics selection is possible PUCCn PDSCn 0 0 Output characteristic selection 1 (400 Ohm buffer) 0 1 Output characteristic selection 2 (200 Ohm buffer) 1 0 Output characteristic selection 3 (100 Ohm buffer) 1 1 Output characteristic selection 4 (50 Ohm buffer)
          enumeration PortInputSelection: {TYPE1_SHMT1, TYPE2_SHMT4}, set at post-build, origin=Renesas_v1.0.0, default-value=TYPE1_SHMT1  # This setting specifies the input buffer characteristics. TYPE1_SHMT1: TYPE 1 buffer is selected. TYPE2_SHMT4: TYPE 2 buffer is selected.
        container PortPin7  # This container contains the configuration (parameters) for Port Pin 0.
          boolean PortPinDirectionChangeable: set at post-build, origin=Renesas_v1.0.0, default-value=false  # Parameter to indicate if the direction is changeable on a port pin during runtime. true: Port Pin direction changeable enabled. false: Port Pin direction changeable disabled.
          boolean PortPinDioAltModeChangeable: set at post-build, origin=Renesas_v1.0.0, default-value=false  # Parameter to indicate if the mode of a port pin is changeable between DIO and Alternate during runtime by API functions Port_SetToDioMode and Port_SetToAlternateMode. Including these APIs is controlled by PortSetToDioAltModeApi. true: Dio Alternate mode is changeable. false: Dio Alternate mode is not changeable.
          boolean PortPinModeChangeable: set at post-build, origin=Renesas_v1.0.0, default-value=false  # Parameter to indicate if the mode of a port pin is changeable during runtime by API function Port_SetPinMode. Including this API is controlled by PortSetPinModeApi. true: Port Pin mode is changeable. false: Port Pin mode is not changeable.
          enumeration PortPinLevelValue: {PORT_PIN_LEVEL_LOW, PORT_PIN_LEVEL_HIGH}, set at post-build, origin=Renesas_v1.0.0, default-value=PORT_PIN_LEVEL_LOW  # Parameter to indicate port pin level value for a port pin. PORT_PIN_LEVEL_LOW: Port pin Level is low. PORT_PIN_LEVEL_HIGH: Port pin Level is high.
          enumeration PortPinInitialMode: {GTM0I4_ALT1_IN, GTMAT1O2_ALT1_OUT, MCAN1RX_ALT2_IN, CSIH0SI2_ALT3_IN, CSIH1DCS_ALT4_IN, CSIH1SO2_ALT4_OUT, DIO}, set at post-build, origin=Renesas_v1.0.0, default-value=DIO  # Mode of the port pin for use with Port_Init() function. <Input name>_ALT<Alternative instance>_IN: Provides alternative instance for selected input. <Output name>_ALT<Alternative instance>_OUT: Provides alternative instance for selected output.
          enumeration PortPinDirection: {PORT_PIN_OUT, PORT_PIN_IN}, set at post-build, origin=Renesas_v1.0.0, default-value=PORT_PIN_IN  # The initial direction of the pin (IN or OUT). If the direction is not changeable, the value configured here is fixed. The direction must match the pin mode. PORT_PIN_IN: Port pin direction set as input. PORT_PIN_OUT: Port pin direction set as output.
          boolean PortInputBufferControl: set at post-build, origin=Renesas_v1.0.0, default-value=false  # This parameter is used as one of the factors to enable/disable port pins input buffer in DIO Mode (PMC=0). true: Port pin's input buffer is ready to be enabled in DIO Mode. false: Port pin's input buffer is disabled in DIO Mode.
          boolean PortBiDirectionControl: set at post-build, origin=Renesas_v1.0.0, default-value=false  # This parameter forces port pins input buffer and output buffer at the same time. If activated, the effect is valid independently from any other port settings. true: Activate forced Bi-directional IO buffer of the port pin. false: Deactivate forced Bi-directional IO buffer of the port pin.
          boolean PortIpControl: set at post-build, origin=Renesas_v1.0.0, default-value=false  # This parameter is used to enable/disable the direct IO control of port pins input buffer and output buffer. true: Enables the direct IO control of port pins input buffer and output buffer by the corresponding control signals of IP_ENI3(0) and IP_ENO3(0) from internal peripheral IPs. This register is valid only in Control Mode (PMC=1). false: Disables the direct IO control of port pins input buffer and output buffer.
          boolean PortPullUpOption: set at post-build, origin=Renesas_v1.0.0, default-value=false  # This register switches on or off the port pins pull-up resistor. true: Port pin's pull-up resistor is enabled. false: Port pin's pull-up resistor is disabled.
          boolean PortPullDownOption: set at post-build, origin=Renesas_v1.0.0, default-value=false  # This parameter switches on or off the port pins pull-down resistor. true: Port pin's pull-down resistor is enabled. false: Port pin's pull-down resistor is disabled.
          enumeration PortOpenDrainControl_Expansion: {PushPull, OpenDrain_N_Channel, OpenDrain_P_Channel}, set at post-build, origin=Renesas_v1.0.2, default-value=PushPull  # This parameter selects port pins output buffer function in combination of PODC and PODCE . | PushPull Specifies the PushPull type output circuit characteristics and updates both PODC and PODCE registers as 0 0 respectively. OpenDrain_N_Channel specifies the N-ch open drain type output circuit characteristics and updates the PODC and PODCE registers as 1 0 respectively. OpenDrain_P_Channel specifies the P-ch open drain type output circuit characteristics and updates the PODC and PODCE registers as 1 1 respectively.
          boolean PortOutputLevelInversion: set at post-build, origin=Renesas_v1.0.0, default-value=false  # This parameter specifies whether the output level from a pin is inverted or not. true: Pin output level is inverted. false: Pin output level is not inverted.
          enumeration PortDriveStrengthControl: {SLOW, FAST}, set at post-build, origin=Renesas_v1.0.0, default-value=SLOW  # This parameter selects the port pins output drive strength as high strength or low strength type. This functionality is also referred to fast (high strength) and slow (low strength) behavior of output buffer. SLOW: Lower drive strength (slow mode) is selected for port pin's output buffer. FAST: Higher drive strength (fast mode) is selected for port pin's output buffer.
          boolean PortUniversalCharacteristicCntrl: set at post-build, origin=Renesas_v1.0.0, default-value=false  # This parameter selects the port pins output drive strength as high or low type. The PortDriveStrengthControl must be enabled for this feature. | false: PortDriveStrengthControl parameter specifies the output driver strength of the port pin. true : Number of output buffer characteristics selection capability is expanded, the maximum of 4 characteristics selection is possible PUCCn PDSCn 0 0 Output characteristic selection 1 (400 Ohm buffer) 0 1 Output characteristic selection 2 (200 Ohm buffer) 1 0 Output characteristic selection 3 (100 Ohm buffer) 1 1 Output characteristic selection 4 (50 Ohm buffer)
          enumeration PortInputSelection: {TYPE1_SHMT1, TYPE2_SHMT4}, set at post-build, origin=Renesas_v1.0.0, default-value=TYPE1_SHMT1  # This setting specifies the input buffer characteristics. TYPE1_SHMT1: TYPE 1 buffer is selected. TYPE2_SHMT4: TYPE 2 buffer is selected.
        container PortPin8  # This container contains the configuration (parameters) for Port Pin 0.
          boolean PortPinDirectionChangeable: set at post-build, origin=Renesas_v1.0.0, default-value=false  # Parameter to indicate if the direction is changeable on a port pin during runtime. true: Port Pin direction changeable enabled. false: Port Pin direction changeable disabled.
          boolean PortPinDioAltModeChangeable: set at post-build, origin=Renesas_v1.0.0, default-value=false  # Parameter to indicate if the mode of a port pin is changeable between DIO and Alternate during runtime by API functions Port_SetToDioMode and Port_SetToAlternateMode. Including these APIs is controlled by PortSetToDioAltModeApi. true: Dio Alternate mode is changeable. false: Dio Alternate mode is not changeable.
          boolean PortPinModeChangeable: set at post-build, origin=Renesas_v1.0.0, default-value=false  # Parameter to indicate if the mode of a port pin is changeable during runtime by API function Port_SetPinMode. Including this API is controlled by PortSetPinModeApi. true: Port Pin mode is changeable. false: Port Pin mode is not changeable.
          enumeration PortPinLevelValue: {PORT_PIN_LEVEL_LOW, PORT_PIN_LEVEL_HIGH}, set at post-build, origin=Renesas_v1.0.0, default-value=PORT_PIN_LEVEL_LOW  # Parameter to indicate port pin level value for a port pin. PORT_PIN_LEVEL_LOW: Port pin Level is low. PORT_PIN_LEVEL_HIGH: Port pin Level is high.
          enumeration PortPinInitialMode: {GTM0I5_ALT1_IN, GTMAT1O3_ALT1_OUT, MCAN1TX_ALT2_OUT, CSIH0SCI2_ALT3_IN, CSIH0SCO2_ALT3_OUT, CSIH1SCI2_ALT4_IN, CSIH1SCO2_ALT4_OUT, DIO}, set at post-build, origin=Renesas_v1.0.0, default-value=DIO  # Mode of the port pin for use with Port_Init() function. <Input name>_ALT<Alternative instance>_IN: Provides alternative instance for selected input. <Output name>_ALT<Alternative instance>_OUT: Provides alternative instance for selected output.
          enumeration PortPinDirection: {PORT_PIN_OUT, PORT_PIN_IN}, set at post-build, origin=Renesas_v1.0.0, default-value=PORT_PIN_IN  # The initial direction of the pin (IN or OUT). If the direction is not changeable, the value configured here is fixed. The direction must match the pin mode. PORT_PIN_IN: Port pin direction set as input. PORT_PIN_OUT: Port pin direction set as output.
          boolean PortInputBufferControl: set at post-build, origin=Renesas_v1.0.0, default-value=false  # This parameter is used as one of the factors to enable/disable port pins input buffer in DIO Mode (PMC=0). true: Port pin's input buffer is ready to be enabled in DIO Mode. false: Port pin's input buffer is disabled in DIO Mode.
          boolean PortBiDirectionControl: set at post-build, origin=Renesas_v1.0.0, default-value=false  # This parameter forces port pins input buffer and output buffer at the same time. If activated, the effect is valid independently from any other port settings. true: Activate forced Bi-directional IO buffer of the port pin. false: Deactivate forced Bi-directional IO buffer of the port pin.
          boolean PortIpControl: set at post-build, origin=Renesas_v1.0.0, default-value=false  # This parameter is used to enable/disable the direct IO control of port pins input buffer and output buffer. true: Enables the direct IO control of port pins input buffer and output buffer by the corresponding control signals of IP_ENI3(0) and IP_ENO3(0) from internal peripheral IPs. This register is valid only in Control Mode (PMC=1). false: Disables the direct IO control of port pins input buffer and output buffer.
          boolean PortPullUpOption: set at post-build, origin=Renesas_v1.0.0, default-value=false  # This register switches on or off the port pins pull-up resistor. true: Port pin's pull-up resistor is enabled. false: Port pin's pull-up resistor is disabled.
          boolean PortPullDownOption: set at post-build, origin=Renesas_v1.0.0, default-value=false  # This parameter switches on or off the port pins pull-down resistor. true: Port pin's pull-down resistor is enabled. false: Port pin's pull-down resistor is disabled.
          enumeration PortOpenDrainControl_Expansion: {PushPull, OpenDrain_N_Channel, OpenDrain_P_Channel}, set at post-build, origin=Renesas_v1.0.2, default-value=PushPull  # This parameter selects port pins output buffer function in combination of PODC and PODCE . | PushPull Specifies the PushPull type output circuit characteristics and updates both PODC and PODCE registers as 0 0 respectively. OpenDrain_N_Channel specifies the N-ch open drain type output circuit characteristics and updates the PODC and PODCE registers as 1 0 respectively. OpenDrain_P_Channel specifies the P-ch open drain type output circuit characteristics and updates the PODC and PODCE registers as 1 1 respectively.
          boolean PortOutputLevelInversion: set at post-build, origin=Renesas_v1.0.0, default-value=false  # This parameter specifies whether the output level from a pin is inverted or not. true: Pin output level is inverted. false: Pin output level is not inverted.
          enumeration PortDriveStrengthControl: {SLOW, FAST}, set at post-build, origin=Renesas_v1.0.0, default-value=SLOW  # This parameter selects the port pins output drive strength as high strength or low strength type. This functionality is also referred to fast (high strength) and slow (low strength) behavior of output buffer. SLOW: Lower drive strength (slow mode) is selected for port pin's output buffer. FAST: Higher drive strength (fast mode) is selected for port pin's output buffer.
          boolean PortUniversalCharacteristicCntrl: set at post-build, origin=Renesas_v1.0.0, default-value=false  # This parameter selects the port pins output drive strength as high or low type. The PortDriveStrengthControl must be enabled for this feature. | false: PortDriveStrengthControl parameter specifies the output driver strength of the port pin. true : Number of output buffer characteristics selection capability is expanded, the maximum of 4 characteristics selection is possible PUCCn PDSCn 0 0 Output characteristic selection 1 (400 Ohm buffer) 0 1 Output characteristic selection 2 (200 Ohm buffer) 1 0 Output characteristic selection 3 (100 Ohm buffer) 1 1 Output characteristic selection 4 (50 Ohm buffer)
          enumeration PortInputSelection: {TYPE1_SHMT1, TYPE2_SHMT4}, set at post-build, origin=Renesas_v1.0.0, default-value=TYPE1_SHMT1  # This setting specifies the input buffer characteristics. TYPE1_SHMT1: TYPE 1 buffer is selected. TYPE2_SHMT4: TYPE 2 buffer is selected.
        container PortPin9  # This container contains the configuration (parameters) for Port Pin 0.
          boolean PortPinDirectionChangeable: set at post-build, origin=Renesas_v1.0.0, default-value=false  # Parameter to indicate if the direction is changeable on a port pin during runtime. true: Port Pin direction changeable enabled. false: Port Pin direction changeable disabled.
          boolean PortPinDioAltModeChangeable: set at post-build, origin=Renesas_v1.0.0, default-value=false  # Parameter to indicate if the mode of a port pin is changeable between DIO and Alternate during runtime by API functions Port_SetToDioMode and Port_SetToAlternateMode. Including these APIs is controlled by PortSetToDioAltModeApi. true: Dio Alternate mode is changeable. false: Dio Alternate mode is not changeable.
          boolean PortPinModeChangeable: set at post-build, origin=Renesas_v1.0.0, default-value=false  # Parameter to indicate if the mode of a port pin is changeable during runtime by API function Port_SetPinMode. Including this API is controlled by PortSetPinModeApi. true: Port Pin mode is changeable. false: Port Pin mode is not changeable.
          enumeration PortPinLevelValue: {PORT_PIN_LEVEL_LOW, PORT_PIN_LEVEL_HIGH}, set at post-build, origin=Renesas_v1.0.0, default-value=PORT_PIN_LEVEL_LOW  # Parameter to indicate port pin level value for a port pin. PORT_PIN_LEVEL_LOW: Port pin Level is low. PORT_PIN_LEVEL_HIGH: Port pin Level is high.
          enumeration PortPinInitialMode: {GTM1I4_ALT1_IN, GTMAT1O0N_ALT1_OUT, CSIH0DCS_ALT3_IN, CSIH0SO2_ALT3_OUT, EXTCLK1O_ALT2_OUT, CSIH1SI2_ALT4_IN, DIO}, set at post-build, origin=Renesas_v1.0.0, default-value=DIO  # Mode of the port pin for use with Port_Init() function. <Input name>_ALT<Alternative instance>_IN: Provides alternative instance for selected input. <Output name>_ALT<Alternative instance>_OUT: Provides alternative instance for selected output.
          enumeration PortPinDirection: {PORT_PIN_OUT, PORT_PIN_IN}, set at post-build, origin=Renesas_v1.0.0, default-value=PORT_PIN_IN  # The initial direction of the pin (IN or OUT). If the direction is not changeable, the value configured here is fixed. The direction must match the pin mode. PORT_PIN_IN: Port pin direction set as input. PORT_PIN_OUT: Port pin direction set as output.
          boolean PortInputBufferControl: set at post-build, origin=Renesas_v1.0.0, default-value=false  # This parameter is used as one of the factors to enable/disable port pins input buffer in DIO Mode (PMC=0). true: Port pin's input buffer is ready to be enabled in DIO Mode. false: Port pin's input buffer is disabled in DIO Mode.
          boolean PortBiDirectionControl: set at post-build, origin=Renesas_v1.0.0, default-value=false  # This parameter forces port pins input buffer and output buffer at the same time. If activated, the effect is valid independently from any other port settings. true: Activate forced Bi-directional IO buffer of the port pin. false: Deactivate forced Bi-directional IO buffer of the port pin.
          boolean PortIpControl: set at post-build, origin=Renesas_v1.0.0, default-value=false  # This parameter is used to enable/disable the direct IO control of port pins input buffer and output buffer. true: Enables the direct IO control of port pins input buffer and output buffer by the corresponding control signals of IP_ENI3(0) and IP_ENO3(0) from internal peripheral IPs. This register is valid only in Control Mode (PMC=1). false: Disables the direct IO control of port pins input buffer and output buffer.
          boolean PortPullUpOption: set at post-build, origin=Renesas_v1.0.0, default-value=false  # This register switches on or off the port pins pull-up resistor. true: Port pin's pull-up resistor is enabled. false: Port pin's pull-up resistor is disabled.
          boolean PortPullDownOption: set at post-build, origin=Renesas_v1.0.0, default-value=false  # This parameter switches on or off the port pins pull-down resistor. true: Port pin's pull-down resistor is enabled. false: Port pin's pull-down resistor is disabled.
          enumeration PortOpenDrainControl_Expansion: {PushPull, OpenDrain_N_Channel, OpenDrain_P_Channel}, set at post-build, origin=Renesas_v1.0.2, default-value=PushPull  # This parameter selects port pins output buffer function in combination of PODC and PODCE . | PushPull Specifies the PushPull type output circuit characteristics and updates both PODC and PODCE registers as 0 0 respectively. OpenDrain_N_Channel specifies the N-ch open drain type output circuit characteristics and updates the PODC and PODCE registers as 1 0 respectively. OpenDrain_P_Channel specifies the P-ch open drain type output circuit characteristics and updates the PODC and PODCE registers as 1 1 respectively.
          boolean PortOutputLevelInversion: set at post-build, origin=Renesas_v1.0.0, default-value=false  # This parameter specifies whether the output level from a pin is inverted or not. true: Pin output level is inverted. false: Pin output level is not inverted.
          enumeration PortDriveStrengthControl: {SLOW, FAST}, set at post-build, origin=Renesas_v1.0.0, default-value=SLOW  # This parameter selects the port pins output drive strength as high strength or low strength type. This functionality is also referred to fast (high strength) and slow (low strength) behavior of output buffer. SLOW: Lower drive strength (slow mode) is selected for port pin's output buffer. FAST: Higher drive strength (fast mode) is selected for port pin's output buffer.
          boolean PortUniversalCharacteristicCntrl: set at post-build, origin=Renesas_v1.0.0, default-value=false  # This parameter selects the port pins output drive strength as high or low type. The PortDriveStrengthControl must be enabled for this feature. | false: PortDriveStrengthControl parameter specifies the output driver strength of the port pin. true : Number of output buffer characteristics selection capability is expanded, the maximum of 4 characteristics selection is possible PUCCn PDSCn 0 0 Output characteristic selection 1 (400 Ohm buffer) 0 1 Output characteristic selection 2 (200 Ohm buffer) 1 0 Output characteristic selection 3 (100 Ohm buffer) 1 1 Output characteristic selection 4 (50 Ohm buffer)
          enumeration PortInputSelection: {TYPE1_SHMT1, TYPE2_SHMT4}, set at post-build, origin=Renesas_v1.0.0, default-value=TYPE1_SHMT1  # This setting specifies the input buffer characteristics. TYPE1_SHMT1: TYPE 1 buffer is selected. TYPE2_SHMT4: TYPE 2 buffer is selected.
        container PortPin10  # This container contains the configuration (parameters) for Port Pin 0.
          boolean PortPinDirectionChangeable: set at post-build, origin=Renesas_v1.0.0, default-value=false  # Parameter to indicate if the direction is changeable on a port pin during runtime. true: Port Pin direction changeable enabled. false: Port Pin direction changeable disabled.
          boolean PortPinDioAltModeChangeable: set at post-build, origin=Renesas_v1.0.0, default-value=false  # Parameter to indicate if the mode of a port pin is changeable between DIO and Alternate during runtime by API functions Port_SetToDioMode and Port_SetToAlternateMode. Including these APIs is controlled by PortSetToDioAltModeApi. true: Dio Alternate mode is changeable. false: Dio Alternate mode is not changeable.
          boolean PortPinModeChangeable: set at post-build, origin=Renesas_v1.0.0, default-value=false  # Parameter to indicate if the mode of a port pin is changeable during runtime by API function Port_SetPinMode. Including this API is controlled by PortSetPinModeApi. true: Port Pin mode is changeable. false: Port Pin mode is not changeable.
          enumeration PortPinLevelValue: {PORT_PIN_LEVEL_LOW, PORT_PIN_LEVEL_HIGH}, set at post-build, origin=Renesas_v1.0.0, default-value=PORT_PIN_LEVEL_LOW  # Parameter to indicate port pin level value for a port pin. PORT_PIN_LEVEL_LOW: Port pin Level is low. PORT_PIN_LEVEL_HIGH: Port pin Level is high.
          enumeration PortPinInitialMode: {ALT_NOT_SUPPORTED}, set at post-build, origin=Renesas_v1.0.0, default-value=ALT_NOT_SUPPORTED  # Mode of the port pin for use with Port_Init() function. <Input name>_ALT<Alternative instance>_IN: Provides alternative instance for selected input. <Output name>_ALT<Alternative instance>_OUT: Provides alternative instance for selected output.
          enumeration PortPinDirection: {PORT_PIN_OUT, PORT_PIN_IN}, set at post-build, origin=Renesas_v1.0.0, default-value=PORT_PIN_IN  # The initial direction of the pin (IN or OUT). If the direction is not changeable, the value configured here is fixed. The direction must match the pin mode. PORT_PIN_IN: Port pin direction set as input. PORT_PIN_OUT: Port pin direction set as output.
          boolean PortInputBufferControl: set at post-build, origin=Renesas_v1.0.0, default-value=false  # This parameter is used as one of the factors to enable/disable port pins input buffer in DIO Mode (PMC=0). true: Port pin's input buffer is ready to be enabled in DIO Mode. false: Port pin's input buffer is disabled in DIO Mode.
          boolean PortBiDirectionControl: set at post-build, origin=Renesas_v1.0.0, default-value=false  # This parameter forces port pins input buffer and output buffer at the same time. If activated, the effect is valid independently from any other port settings. true: Activate forced Bi-directional IO buffer of the port pin. false: Deactivate forced Bi-directional IO buffer of the port pin.
          boolean PortPullUpOption: set at post-build, origin=Renesas_v1.0.0, default-value=false  # This register switches on or off the port pins pull-up resistor. true: Port pin's pull-up resistor is enabled. false: Port pin's pull-up resistor is disabled.
          boolean PortPullDownOption: set at post-build, origin=Renesas_v1.0.0, default-value=false  # This parameter switches on or off the port pins pull-down resistor. true: Port pin's pull-down resistor is enabled. false: Port pin's pull-down resistor is disabled.
          enumeration PortOpenDrainControl_Expansion: {PushPull, OpenDrain_N_Channel, OpenDrain_P_Channel}, set at post-build, origin=Renesas_v1.0.2, default-value=PushPull  # This parameter selects port pins output buffer function in combination of PODC and PODCE . | PushPull Specifies the PushPull type output circuit characteristics and updates both PODC and PODCE registers as 0 0 respectively. OpenDrain_N_Channel specifies the N-ch open drain type output circuit characteristics and updates the PODC and PODCE registers as 1 0 respectively. OpenDrain_P_Channel specifies the P-ch open drain type output circuit characteristics and updates the PODC and PODCE registers as 1 1 respectively.
          boolean PortOutputLevelInversion: set at post-build, origin=Renesas_v1.0.0, default-value=false  # This parameter specifies whether the output level from a pin is inverted or not. true: Pin output level is inverted. false: Pin output level is not inverted.
          enumeration PortDriveStrengthControl: {SLOW, FAST}, set at post-build, origin=Renesas_v1.0.0, default-value=SLOW  # This parameter selects the port pins output drive strength as high strength or low strength type. This functionality is also referred to fast (high strength) and slow (low strength) behavior of output buffer. SLOW: Lower drive strength (slow mode) is selected for port pin's output buffer. FAST: Higher drive strength (fast mode) is selected for port pin's output buffer.
          boolean PortUniversalCharacteristicCntrl: set at post-build, origin=Renesas_v1.0.0, default-value=false  # This parameter selects the port pins output drive strength as high or low type. The PortDriveStrengthControl must be enabled for this feature. | false: PortDriveStrengthControl parameter specifies the output driver strength of the port pin. true : Number of output buffer characteristics selection capability is expanded, the maximum of 4 characteristics selection is possible PUCCn PDSCn 0 0 Output characteristic selection 1 (400 Ohm buffer) 0 1 Output characteristic selection 2 (200 Ohm buffer) 1 0 Output characteristic selection 3 (100 Ohm buffer) 1 1 Output characteristic selection 4 (50 Ohm buffer)
          enumeration PortInputSelection: {TYPE1_SHMT1, TYPE2_SHMT4}, set at post-build, origin=Renesas_v1.0.0, default-value=TYPE1_SHMT1  # This setting specifies the input buffer characteristics. TYPE1_SHMT1: TYPE 1 buffer is selected. TYPE2_SHMT4: TYPE 2 buffer is selected.
        container PortPin13  # This container contains the configuration (parameters) for Port Pin 0.
          boolean PortPinDirectionChangeable: set at post-build, origin=Renesas_v1.0.0, default-value=false  # Parameter to indicate if the direction is changeable on a port pin during runtime. true: Port Pin direction changeable enabled. false: Port Pin direction changeable disabled.
          boolean PortPinDioAltModeChangeable: set at post-build, origin=Renesas_v1.0.0, default-value=false  # Parameter to indicate if the mode of a port pin is changeable between DIO and Alternate during runtime by API functions Port_SetToDioMode and Port_SetToAlternateMode. Including these APIs is controlled by PortSetToDioAltModeApi. true: Dio Alternate mode is changeable. false: Dio Alternate mode is not changeable.
          boolean PortPinModeChangeable: set at post-build, origin=Renesas_v1.0.0, default-value=false  # Parameter to indicate if the mode of a port pin is changeable during runtime by API function Port_SetPinMode. Including this API is controlled by PortSetPinModeApi. true: Port Pin mode is changeable. false: Port Pin mode is not changeable.
          enumeration PortPinLevelValue: {PORT_PIN_LEVEL_LOW, PORT_PIN_LEVEL_HIGH}, set at post-build, origin=Renesas_v1.0.0, default-value=PORT_PIN_LEVEL_LOW  # Parameter to indicate port pin level value for a port pin. PORT_PIN_LEVEL_LOW: Port pin Level is low. PORT_PIN_LEVEL_HIGH: Port pin Level is high.
          enumeration PortPinInitialMode: {GTM1I3_ALT1_IN, GTMAT1O1N_ALT1_OUT, CSIH1RYI_ALT2_IN, CSIH1RYO_ALT2_OUT, SENT4RX_ALT3_IN, MCAN0RX_ALT4_IN, DIO}, set at post-build, origin=Renesas_v1.0.0, default-value=DIO  # Mode of the port pin for use with Port_Init() function. <Input name>_ALT<Alternative instance>_IN: Provides alternative instance for selected input. <Output name>_ALT<Alternative instance>_OUT: Provides alternative instance for selected output.
          enumeration PortPinDirection: {PORT_PIN_OUT, PORT_PIN_IN}, set at post-build, origin=Renesas_v1.0.0, default-value=PORT_PIN_IN  # The initial direction of the pin (IN or OUT). If the direction is not changeable, the value configured here is fixed. The direction must match the pin mode. PORT_PIN_IN: Port pin direction set as input. PORT_PIN_OUT: Port pin direction set as output.
          boolean PortInputBufferControl: set at post-build, origin=Renesas_v1.0.0, default-value=false  # This parameter is used as one of the factors to enable/disable port pins input buffer in DIO Mode (PMC=0). true: Port pin's input buffer is ready to be enabled in DIO Mode. false: Port pin's input buffer is disabled in DIO Mode.
          boolean PortBiDirectionControl: set at post-build, origin=Renesas_v1.0.0, default-value=false  # This parameter forces port pins input buffer and output buffer at the same time. If activated, the effect is valid independently from any other port settings. true: Activate forced Bi-directional IO buffer of the port pin. false: Deactivate forced Bi-directional IO buffer of the port pin.
          boolean PortIpControl: set at post-build, origin=Renesas_v1.0.0, default-value=false  # This parameter is used to enable/disable the direct IO control of port pins input buffer and output buffer. true: Enables the direct IO control of port pins input buffer and output buffer by the corresponding control signals of IP_ENI3(0) and IP_ENO3(0) from internal peripheral IPs. This register is valid only in Control Mode (PMC=1). false: Disables the direct IO control of port pins input buffer and output buffer.
          boolean PortPullUpOption: set at post-build, origin=Renesas_v1.0.0, default-value=false  # This register switches on or off the port pins pull-up resistor. true: Port pin's pull-up resistor is enabled. false: Port pin's pull-up resistor is disabled.
          boolean PortPullDownOption: set at post-build, origin=Renesas_v1.0.0, default-value=false  # This parameter switches on or off the port pins pull-down resistor. true: Port pin's pull-down resistor is enabled. false: Port pin's pull-down resistor is disabled.
          enumeration PortOpenDrainControl_Expansion: {PushPull, OpenDrain_N_Channel, OpenDrain_P_Channel}, set at post-build, origin=Renesas_v1.0.2, default-value=PushPull  # This parameter selects port pins output buffer function in combination of PODC and PODCE . | PushPull Specifies the PushPull type output circuit characteristics and updates both PODC and PODCE registers as 0 0 respectively. OpenDrain_N_Channel specifies the N-ch open drain type output circuit characteristics and updates the PODC and PODCE registers as 1 0 respectively. OpenDrain_P_Channel specifies the P-ch open drain type output circuit characteristics and updates the PODC and PODCE registers as 1 1 respectively.
          boolean PortOutputLevelInversion: set at post-build, origin=Renesas_v1.0.0, default-value=false  # This parameter specifies whether the output level from a pin is inverted or not. true: Pin output level is inverted. false: Pin output level is not inverted.
          enumeration PortDriveStrengthControl: {SLOW, FAST}, set at post-build, origin=Renesas_v1.0.0, default-value=SLOW  # This parameter selects the port pins output drive strength as high strength or low strength type. This functionality is also referred to fast (high strength) and slow (low strength) behavior of output buffer. SLOW: Lower drive strength (slow mode) is selected for port pin's output buffer. FAST: Higher drive strength (fast mode) is selected for port pin's output buffer.
          boolean PortUniversalCharacteristicCntrl: set at post-build, origin=Renesas_v1.0.0, default-value=false  # This parameter selects the port pins output drive strength as high or low type. The PortDriveStrengthControl must be enabled for this feature. | false: PortDriveStrengthControl parameter specifies the output driver strength of the port pin. true : Number of output buffer characteristics selection capability is expanded, the maximum of 4 characteristics selection is possible PUCCn PDSCn 0 0 Output characteristic selection 1 (400 Ohm buffer) 0 1 Output characteristic selection 2 (200 Ohm buffer) 1 0 Output characteristic selection 3 (100 Ohm buffer) 1 1 Output characteristic selection 4 (50 Ohm buffer)
          enumeration PortInputSelection: {TYPE1_SHMT1, TYPE2_SHMT4}, set at post-build, origin=Renesas_v1.0.0, default-value=TYPE1_SHMT1  # This setting specifies the input buffer characteristics. TYPE1_SHMT1: TYPE 1 buffer is selected. TYPE2_SHMT4: TYPE 2 buffer is selected.
        container PortPin14  # This container contains the configuration (parameters) for Port Pin 0.
          boolean PortPinDirectionChangeable: set at post-build, origin=Renesas_v1.0.0, default-value=false  # Parameter to indicate if the direction is changeable on a port pin during runtime. true: Port Pin direction changeable enabled. false: Port Pin direction changeable disabled.
          boolean PortPinDioAltModeChangeable: set at post-build, origin=Renesas_v1.0.0, default-value=false  # Parameter to indicate if the mode of a port pin is changeable between DIO and Alternate during runtime by API functions Port_SetToDioMode and Port_SetToAlternateMode. Including these APIs is controlled by PortSetToDioAltModeApi. true: Dio Alternate mode is changeable. false: Dio Alternate mode is not changeable.
          boolean PortPinModeChangeable: set at post-build, origin=Renesas_v1.0.0, default-value=false  # Parameter to indicate if the mode of a port pin is changeable during runtime by API function Port_SetPinMode. Including this API is controlled by PortSetPinModeApi. true: Port Pin mode is changeable. false: Port Pin mode is not changeable.
          enumeration PortPinLevelValue: {PORT_PIN_LEVEL_LOW, PORT_PIN_LEVEL_HIGH}, set at post-build, origin=Renesas_v1.0.0, default-value=PORT_PIN_LEVEL_LOW  # Parameter to indicate port pin level value for a port pin. PORT_PIN_LEVEL_LOW: Port pin Level is low. PORT_PIN_LEVEL_HIGH: Port pin Level is high.
          enumeration PortPinInitialMode: {GTM0I2_ALT1_IN, GTMAT0O4_ALT1_OUT, EXTCLK1O_ALT2_OUT, SENT0RX_ALT3_IN, MCAN0TX_ALT4_OUT, DIO}, set at post-build, origin=Renesas_v1.0.0, default-value=DIO  # Mode of the port pin for use with Port_Init() function. <Input name>_ALT<Alternative instance>_IN: Provides alternative instance for selected input. <Output name>_ALT<Alternative instance>_OUT: Provides alternative instance for selected output.
          enumeration PortPinDirection: {PORT_PIN_OUT, PORT_PIN_IN}, set at post-build, origin=Renesas_v1.0.0, default-value=PORT_PIN_IN  # The initial direction of the pin (IN or OUT). If the direction is not changeable, the value configured here is fixed. The direction must match the pin mode. PORT_PIN_IN: Port pin direction set as input. PORT_PIN_OUT: Port pin direction set as output.
          boolean PortInputBufferControl: set at post-build, origin=Renesas_v1.0.0, default-value=false  # This parameter is used as one of the factors to enable/disable port pins input buffer in DIO Mode (PMC=0). true: Port pin's input buffer is ready to be enabled in DIO Mode. false: Port pin's input buffer is disabled in DIO Mode.
          boolean PortBiDirectionControl: set at post-build, origin=Renesas_v1.0.0, default-value=false  # This parameter forces port pins input buffer and output buffer at the same time. If activated, the effect is valid independently from any other port settings. true: Activate forced Bi-directional IO buffer of the port pin. false: Deactivate forced Bi-directional IO buffer of the port pin.
          boolean PortIpControl: set at post-build, origin=Renesas_v1.0.0, default-value=false  # This parameter is used to enable/disable the direct IO control of port pins input buffer and output buffer. true: Enables the direct IO control of port pins input buffer and output buffer by the corresponding control signals of IP_ENI3(0) and IP_ENO3(0) from internal peripheral IPs. This register is valid only in Control Mode (PMC=1). false: Disables the direct IO control of port pins input buffer and output buffer.
          boolean PortPullUpOption: set at post-build, origin=Renesas_v1.0.0, default-value=false  # This register switches on or off the port pins pull-up resistor. true: Port pin's pull-up resistor is enabled. false: Port pin's pull-up resistor is disabled.
          boolean PortPullDownOption: set at post-build, origin=Renesas_v1.0.0, default-value=false  # This parameter switches on or off the port pins pull-down resistor. true: Port pin's pull-down resistor is enabled. false: Port pin's pull-down resistor is disabled.
          enumeration PortOpenDrainControl_Expansion: {PushPull, OpenDrain_N_Channel, OpenDrain_P_Channel}, set at post-build, origin=Renesas_v1.0.2, default-value=PushPull  # This parameter selects port pins output buffer function in combination of PODC and PODCE . | PushPull Specifies the PushPull type output circuit characteristics and updates both PODC and PODCE registers as 0 0 respectively. OpenDrain_N_Channel specifies the N-ch open drain type output circuit characteristics and updates the PODC and PODCE registers as 1 0 respectively. OpenDrain_P_Channel specifies the P-ch open drain type output circuit characteristics and updates the PODC and PODCE registers as 1 1 respectively.
          boolean PortOutputLevelInversion: set at post-build, origin=Renesas_v1.0.0, default-value=false  # This parameter specifies whether the output level from a pin is inverted or not. true: Pin output level is inverted. false: Pin output level is not inverted.
          enumeration PortDriveStrengthControl: {SLOW, FAST}, set at post-build, origin=Renesas_v1.0.0, default-value=SLOW  # This parameter selects the port pins output drive strength as high strength or low strength type. This functionality is also referred to fast (high strength) and slow (low strength) behavior of output buffer. SLOW: Lower drive strength (slow mode) is selected for port pin's output buffer. FAST: Higher drive strength (fast mode) is selected for port pin's output buffer.
          boolean PortUniversalCharacteristicCntrl: set at post-build, origin=Renesas_v1.0.0, default-value=false  # This parameter selects the port pins output drive strength as high or low type. The PortDriveStrengthControl must be enabled for this feature. | false: PortDriveStrengthControl parameter specifies the output driver strength of the port pin. true : Number of output buffer characteristics selection capability is expanded, the maximum of 4 characteristics selection is possible PUCCn PDSCn 0 0 Output characteristic selection 1 (400 Ohm buffer) 0 1 Output characteristic selection 2 (200 Ohm buffer) 1 0 Output characteristic selection 3 (100 Ohm buffer) 1 1 Output characteristic selection 4 (50 Ohm buffer)
          enumeration PortInputSelection: {TYPE1_SHMT1, TYPE2_SHMT4}, set at post-build, origin=Renesas_v1.0.0, default-value=TYPE1_SHMT1  # This setting specifies the input buffer characteristics. TYPE1_SHMT1: TYPE 1 buffer is selected. TYPE2_SHMT4: TYPE 2 buffer is selected.
      container PortGroup1  # This container contains the configuration (parameters) for Port Group 0.
        container PortPin1  # This container contains the configuration (parameters) for Port Pin 0.
          boolean PortPinDirectionChangeable: set at post-build, origin=Renesas_v1.0.0, default-value=false  # Parameter to indicate if the direction is changeable on a port pin during runtime. true: Port Pin direction changeable enabled. false: Port Pin direction changeable disabled.
          boolean PortPinDioAltModeChangeable: set at post-build, origin=Renesas_v1.0.0, default-value=false  # Parameter to indicate if the mode of a port pin is changeable between DIO and Alternate during runtime by API functions Port_SetToDioMode and Port_SetToAlternateMode. Including these APIs is controlled by PortSetToDioAltModeApi. true: Dio Alternate mode is changeable. false: Dio Alternate mode is not changeable.
          boolean PortPinModeChangeable: set at post-build, origin=Renesas_v1.0.0, default-value=false  # Parameter to indicate if the mode of a port pin is changeable during runtime by API function Port_SetPinMode. Including this API is controlled by PortSetPinModeApi. true: Port Pin mode is changeable. false: Port Pin mode is not changeable.
          enumeration PortPinLevelValue: {PORT_PIN_LEVEL_LOW, PORT_PIN_LEVEL_HIGH}, set at post-build, origin=Renesas_v1.0.0, default-value=PORT_PIN_LEVEL_LOW  # Parameter to indicate port pin level value for a port pin. PORT_PIN_LEVEL_LOW: Port pin Level is low. PORT_PIN_LEVEL_HIGH: Port pin Level is high.
          enumeration PortPinInitialMode: {GTM0I1_ALT1_IN, GTMAT0O5_ALT1_OUT, INTP4_ALT2_IN, CSIH3CSS0_ALT2_OUT, CSIH1SI1_ALT3_IN, HSURT0SDIO0I_ALT4_IN, HSURT0SDIO0O_ALT4_OUT, DIO}, set at post-build, origin=Renesas_v1.0.0, default-value=DIO  # Mode of the port pin for use with Port_Init() function. <Input name>_ALT<Alternative instance>_IN: Provides alternative instance for selected input. <Output name>_ALT<Alternative instance>_OUT: Provides alternative instance for selected output.
          enumeration PortPinDirection: {PORT_PIN_OUT, PORT_PIN_IN}, set at post-build, origin=Renesas_v1.0.0, default-value=PORT_PIN_IN  # The initial direction of the pin (IN or OUT). If the direction is not changeable, the value configured here is fixed. The direction must match the pin mode. PORT_PIN_IN: Port pin direction set as input. PORT_PIN_OUT: Port pin direction set as output.
          boolean PortInputBufferControl: set at post-build, origin=Renesas_v1.0.0, default-value=false  # This parameter is used as one of the factors to enable/disable port pins input buffer in DIO Mode (PMC=0). true: Port pin's input buffer is ready to be enabled in DIO Mode. false: Port pin's input buffer is disabled in DIO Mode.
          boolean PortBiDirectionControl: set at post-build, origin=Renesas_v1.0.0, default-value=false  # This parameter forces port pins input buffer and output buffer at the same time. If activated, the effect is valid independently from any other port settings. true: Activate forced Bi-directional IO buffer of the port pin. false: Deactivate forced Bi-directional IO buffer of the port pin.
          boolean PortIpControl: set at post-build, origin=Renesas_v1.0.0, default-value=false  # This parameter is used to enable/disable the direct IO control of port pins input buffer and output buffer. true: Enables the direct IO control of port pins input buffer and output buffer by the corresponding control signals of IP_ENI3(0) and IP_ENO3(0) from internal peripheral IPs. This register is valid only in Control Mode (PMC=1). false: Disables the direct IO control of port pins input buffer and output buffer.
          boolean PortPullUpOption: set at post-build, origin=Renesas_v1.0.0, default-value=false  # This register switches on or off the port pins pull-up resistor. true: Port pin's pull-up resistor is enabled. false: Port pin's pull-up resistor is disabled.
          boolean PortPullDownOption: set at post-build, origin=Renesas_v1.0.0, default-value=false  # This parameter switches on or off the port pins pull-down resistor. true: Port pin's pull-down resistor is enabled. false: Port pin's pull-down resistor is disabled.
          enumeration PortOpenDrainControl_Expansion: {PushPull, OpenDrain_N_Channel, OpenDrain_P_Channel}, set at post-build, origin=Renesas_v1.0.2, default-value=PushPull  # This parameter selects port pins output buffer function in combination of PODC and PODCE . | PushPull Specifies the PushPull type output circuit characteristics and updates both PODC and PODCE registers as 0 0 respectively. OpenDrain_N_Channel specifies the N-ch open drain type output circuit characteristics and updates the PODC and PODCE registers as 1 0 respectively. OpenDrain_P_Channel specifies the P-ch open drain type output circuit characteristics and updates the PODC and PODCE registers as 1 1 respectively.
          boolean PortOutputLevelInversion: set at post-build, origin=Renesas_v1.0.0, default-value=false  # This parameter specifies whether the output level from a pin is inverted or not. true: Pin output level is inverted. false: Pin output level is not inverted.
          enumeration PortDriveStrengthControl: {SLOW, FAST}, set at post-build, origin=Renesas_v1.0.0, default-value=SLOW  # This parameter selects the port pins output drive strength as high strength or low strength type. This functionality is also referred to fast (high strength) and slow (low strength) behavior of output buffer. SLOW: Lower drive strength (slow mode) is selected for port pin's output buffer. FAST: Higher drive strength (fast mode) is selected for port pin's output buffer.
          boolean PortUniversalCharacteristicCntrl: set at post-build, origin=Renesas_v1.0.0, default-value=false  # This parameter selects the port pins output drive strength as high or low type. The PortDriveStrengthControl must be enabled for this feature. | false: PortDriveStrengthControl parameter specifies the output driver strength of the port pin. true : Number of output buffer characteristics selection capability is expanded, the maximum of 4 characteristics selection is possible PUCCn PDSCn 0 0 Output characteristic selection 1 (400 Ohm buffer) 0 1 Output characteristic selection 2 (200 Ohm buffer) 1 0 Output characteristic selection 3 (100 Ohm buffer) 1 1 Output characteristic selection 4 (50 Ohm buffer)
          enumeration PortInputSelection: {TYPE1_SHMT1, TYPE2_SHMT4}, set at post-build, origin=Renesas_v1.0.0, default-value=TYPE1_SHMT1  # This setting specifies the input buffer characteristics. TYPE1_SHMT1: TYPE 1 buffer is selected. TYPE2_SHMT4: TYPE 2 buffer is selected.
        container PortPin2  # This container contains the configuration (parameters) for Port Pin 0.
          boolean PortPinDirectionChangeable: set at post-build, origin=Renesas_v1.0.0, default-value=false  # Parameter to indicate if the direction is changeable on a port pin during runtime. true: Port Pin direction changeable enabled. false: Port Pin direction changeable disabled.
          boolean PortPinDioAltModeChangeable: set at post-build, origin=Renesas_v1.0.0, default-value=false  # Parameter to indicate if the mode of a port pin is changeable between DIO and Alternate during runtime by API functions Port_SetToDioMode and Port_SetToAlternateMode. Including these APIs is controlled by PortSetToDioAltModeApi. true: Dio Alternate mode is changeable. false: Dio Alternate mode is not changeable.
          boolean PortPinModeChangeable: set at post-build, origin=Renesas_v1.0.0, default-value=false  # Parameter to indicate if the mode of a port pin is changeable during runtime by API function Port_SetPinMode. Including this API is controlled by PortSetPinModeApi. true: Port Pin mode is changeable. false: Port Pin mode is not changeable.
          enumeration PortPinLevelValue: {PORT_PIN_LEVEL_LOW, PORT_PIN_LEVEL_HIGH}, set at post-build, origin=Renesas_v1.0.0, default-value=PORT_PIN_LEVEL_LOW  # Parameter to indicate port pin level value for a port pin. PORT_PIN_LEVEL_LOW: Port pin Level is low. PORT_PIN_LEVEL_HIGH: Port pin Level is high.
          enumeration PortPinInitialMode: {GTM0I5_ALT1_IN, GTMAT0O2_ALT1_OUT, CSIH3SCI0_ALT2_IN, CSIH3SCO0_ALT2_OUT, CSIH1DCS_ALT3_IN, CSIH1SO1_ALT3_OUT, HSURT0SDIO1I_ALT4_IN, HSURT0SDIO1O_ALT4_OUT, DIO}, set at post-build, origin=Renesas_v1.0.0, default-value=DIO  # Mode of the port pin for use with Port_Init() function. <Input name>_ALT<Alternative instance>_IN: Provides alternative instance for selected input. <Output name>_ALT<Alternative instance>_OUT: Provides alternative instance for selected output.
          enumeration PortPinDirection: {PORT_PIN_OUT, PORT_PIN_IN}, set at post-build, origin=Renesas_v1.0.0, default-value=PORT_PIN_IN  # The initial direction of the pin (IN or OUT). If the direction is not changeable, the value configured here is fixed. The direction must match the pin mode. PORT_PIN_IN: Port pin direction set as input. PORT_PIN_OUT: Port pin direction set as output.
          boolean PortInputBufferControl: set at post-build, origin=Renesas_v1.0.0, default-value=false  # This parameter is used as one of the factors to enable/disable port pins input buffer in DIO Mode (PMC=0). true: Port pin's input buffer is ready to be enabled in DIO Mode. false: Port pin's input buffer is disabled in DIO Mode.
          boolean PortBiDirectionControl: set at post-build, origin=Renesas_v1.0.0, default-value=false  # This parameter forces port pins input buffer and output buffer at the same time. If activated, the effect is valid independently from any other port settings. true: Activate forced Bi-directional IO buffer of the port pin. false: Deactivate forced Bi-directional IO buffer of the port pin.
          boolean PortIpControl: set at post-build, origin=Renesas_v1.0.0, default-value=false  # This parameter is used to enable/disable the direct IO control of port pins input buffer and output buffer. true: Enables the direct IO control of port pins input buffer and output buffer by the corresponding control signals of IP_ENI3(0) and IP_ENO3(0) from internal peripheral IPs. This register is valid only in Control Mode (PMC=1). false: Disables the direct IO control of port pins input buffer and output buffer.
          boolean PortPullUpOption: set at post-build, origin=Renesas_v1.0.0, default-value=false  # This register switches on or off the port pins pull-up resistor. true: Port pin's pull-up resistor is enabled. false: Port pin's pull-up resistor is disabled.
          boolean PortPullDownOption: set at post-build, origin=Renesas_v1.0.0, default-value=false  # This parameter switches on or off the port pins pull-down resistor. true: Port pin's pull-down resistor is enabled. false: Port pin's pull-down resistor is disabled.
          enumeration PortOpenDrainControl_Expansion: {PushPull, OpenDrain_N_Channel, OpenDrain_P_Channel}, set at post-build, origin=Renesas_v1.0.2, default-value=PushPull  # This parameter selects port pins output buffer function in combination of PODC and PODCE . | PushPull Specifies the PushPull type output circuit characteristics and updates both PODC and PODCE registers as 0 0 respectively. OpenDrain_N_Channel specifies the N-ch open drain type output circuit characteristics and updates the PODC and PODCE registers as 1 0 respectively. OpenDrain_P_Channel specifies the P-ch open drain type output circuit characteristics and updates the PODC and PODCE registers as 1 1 respectively.
          boolean PortOutputLevelInversion: set at post-build, origin=Renesas_v1.0.0, default-value=false  # This parameter specifies whether the output level from a pin is inverted or not. true: Pin output level is inverted. false: Pin output level is not inverted.
          enumeration PortDriveStrengthControl: {SLOW, FAST}, set at post-build, origin=Renesas_v1.0.0, default-value=SLOW  # This parameter selects the port pins output drive strength as high strength or low strength type. This functionality is also referred to fast (high strength) and slow (low strength) behavior of output buffer. SLOW: Lower drive strength (slow mode) is selected for port pin's output buffer. FAST: Higher drive strength (fast mode) is selected for port pin's output buffer.
          boolean PortUniversalCharacteristicCntrl: set at post-build, origin=Renesas_v1.0.0, default-value=false  # This parameter selects the port pins output drive strength as high or low type. The PortDriveStrengthControl must be enabled for this feature. | false: PortDriveStrengthControl parameter specifies the output driver strength of the port pin. true : Number of output buffer characteristics selection capability is expanded, the maximum of 4 characteristics selection is possible PUCCn PDSCn 0 0 Output characteristic selection 1 (400 Ohm buffer) 0 1 Output characteristic selection 2 (200 Ohm buffer) 1 0 Output characteristic selection 3 (100 Ohm buffer) 1 1 Output characteristic selection 4 (50 Ohm buffer)
          enumeration PortInputSelection: {TYPE1_SHMT1, TYPE2_SHMT4}, set at post-build, origin=Renesas_v1.0.0, default-value=TYPE1_SHMT1  # This setting specifies the input buffer characteristics. TYPE1_SHMT1: TYPE 1 buffer is selected. TYPE2_SHMT4: TYPE 2 buffer is selected.
        container PortPin3  # This container contains the configuration (parameters) for Port Pin 0.
          boolean PortPinDirectionChangeable: set at post-build, origin=Renesas_v1.0.0, default-value=false  # Parameter to indicate if the direction is changeable on a port pin during runtime. true: Port Pin direction changeable enabled. false: Port Pin direction changeable disabled.
          boolean PortPinDioAltModeChangeable: set at post-build, origin=Renesas_v1.0.0, default-value=false  # Parameter to indicate if the mode of a port pin is changeable between DIO and Alternate during runtime by API functions Port_SetToDioMode and Port_SetToAlternateMode. Including these APIs is controlled by PortSetToDioAltModeApi. true: Dio Alternate mode is changeable. false: Dio Alternate mode is not changeable.
          boolean PortPinModeChangeable: set at post-build, origin=Renesas_v1.0.0, default-value=false  # Parameter to indicate if the mode of a port pin is changeable during runtime by API function Port_SetPinMode. Including this API is controlled by PortSetPinModeApi. true: Port Pin mode is changeable. false: Port Pin mode is not changeable.
          enumeration PortPinLevelValue: {PORT_PIN_LEVEL_LOW, PORT_PIN_LEVEL_HIGH}, set at post-build, origin=Renesas_v1.0.0, default-value=PORT_PIN_LEVEL_LOW  # Parameter to indicate port pin level value for a port pin. PORT_PIN_LEVEL_LOW: Port pin Level is low. PORT_PIN_LEVEL_HIGH: Port pin Level is high.
          enumeration PortPinInitialMode: {GTM0I4_ALT1_IN, GTMAT0O3_ALT1_OUT, CSIH3SI0_ALT2_IN, HSURT0SDIO2I_ALT4_IN, HSURT0SDIO2O_ALT4_OUT, DIO}, set at post-build, origin=Renesas_v1.0.0, default-value=DIO  # Mode of the port pin for use with Port_Init() function. <Input name>_ALT<Alternative instance>_IN: Provides alternative instance for selected input. <Output name>_ALT<Alternative instance>_OUT: Provides alternative instance for selected output.
          enumeration PortPinDirection: {PORT_PIN_OUT, PORT_PIN_IN}, set at post-build, origin=Renesas_v1.0.0, default-value=PORT_PIN_IN  # The initial direction of the pin (IN or OUT). If the direction is not changeable, the value configured here is fixed. The direction must match the pin mode. PORT_PIN_IN: Port pin direction set as input. PORT_PIN_OUT: Port pin direction set as output.
          boolean PortInputBufferControl: set at post-build, origin=Renesas_v1.0.0, default-value=false  # This parameter is used as one of the factors to enable/disable port pins input buffer in DIO Mode (PMC=0). true: Port pin's input buffer is ready to be enabled in DIO Mode. false: Port pin's input buffer is disabled in DIO Mode.
          boolean PortBiDirectionControl: set at post-build, origin=Renesas_v1.0.0, default-value=false  # This parameter forces port pins input buffer and output buffer at the same time. If activated, the effect is valid independently from any other port settings. true: Activate forced Bi-directional IO buffer of the port pin. false: Deactivate forced Bi-directional IO buffer of the port pin.
          boolean PortIpControl: set at post-build, origin=Renesas_v1.0.0, default-value=false  # This parameter is used to enable/disable the direct IO control of port pins input buffer and output buffer. true: Enables the direct IO control of port pins input buffer and output buffer by the corresponding control signals of IP_ENI3(0) and IP_ENO3(0) from internal peripheral IPs. This register is valid only in Control Mode (PMC=1). false: Disables the direct IO control of port pins input buffer and output buffer.
          boolean PortPullUpOption: set at post-build, origin=Renesas_v1.0.0, default-value=false  # This register switches on or off the port pins pull-up resistor. true: Port pin's pull-up resistor is enabled. false: Port pin's pull-up resistor is disabled.
          boolean PortPullDownOption: set at post-build, origin=Renesas_v1.0.0, default-value=false  # This parameter switches on or off the port pins pull-down resistor. true: Port pin's pull-down resistor is enabled. false: Port pin's pull-down resistor is disabled.
          enumeration PortOpenDrainControl_Expansion: {PushPull, OpenDrain_N_Channel, OpenDrain_P_Channel}, set at post-build, origin=Renesas_v1.0.2, default-value=PushPull  # This parameter selects port pins output buffer function in combination of PODC and PODCE . | PushPull Specifies the PushPull type output circuit characteristics and updates both PODC and PODCE registers as 0 0 respectively. OpenDrain_N_Channel specifies the N-ch open drain type output circuit characteristics and updates the PODC and PODCE registers as 1 0 respectively. OpenDrain_P_Channel specifies the P-ch open drain type output circuit characteristics and updates the PODC and PODCE registers as 1 1 respectively.
          boolean PortOutputLevelInversion: set at post-build, origin=Renesas_v1.0.0, default-value=false  # This parameter specifies whether the output level from a pin is inverted or not. true: Pin output level is inverted. false: Pin output level is not inverted.
          enumeration PortDriveStrengthControl: {SLOW, FAST}, set at post-build, origin=Renesas_v1.0.0, default-value=SLOW  # This parameter selects the port pins output drive strength as high strength or low strength type. This functionality is also referred to fast (high strength) and slow (low strength) behavior of output buffer. SLOW: Lower drive strength (slow mode) is selected for port pin's output buffer. FAST: Higher drive strength (fast mode) is selected for port pin's output buffer.
          boolean PortUniversalCharacteristicCntrl: set at post-build, origin=Renesas_v1.0.0, default-value=false  # This parameter selects the port pins output drive strength as high or low type. The PortDriveStrengthControl must be enabled for this feature. | false: PortDriveStrengthControl parameter specifies the output driver strength of the port pin. true : Number of output buffer characteristics selection capability is expanded, the maximum of 4 characteristics selection is possible PUCCn PDSCn 0 0 Output characteristic selection 1 (400 Ohm buffer) 0 1 Output characteristic selection 2 (200 Ohm buffer) 1 0 Output characteristic selection 3 (100 Ohm buffer) 1 1 Output characteristic selection 4 (50 Ohm buffer)
          enumeration PortInputSelection: {TYPE1_SHMT1, TYPE2_SHMT4}, set at post-build, origin=Renesas_v1.0.0, default-value=TYPE1_SHMT1  # This setting specifies the input buffer characteristics. TYPE1_SHMT1: TYPE 1 buffer is selected. TYPE2_SHMT4: TYPE 2 buffer is selected.
        container PortPin4  # This container contains the configuration (parameters) for Port Pin 0.
          boolean PortPinDirectionChangeable: set at post-build, origin=Renesas_v1.0.0, default-value=false  # Parameter to indicate if the direction is changeable on a port pin during runtime. true: Port Pin direction changeable enabled. false: Port Pin direction changeable disabled.
          boolean PortPinDioAltModeChangeable: set at post-build, origin=Renesas_v1.0.0, default-value=false  # Parameter to indicate if the mode of a port pin is changeable between DIO and Alternate during runtime by API functions Port_SetToDioMode and Port_SetToAlternateMode. Including these APIs is controlled by PortSetToDioAltModeApi. true: Dio Alternate mode is changeable. false: Dio Alternate mode is not changeable.
          boolean PortPinModeChangeable: set at post-build, origin=Renesas_v1.0.0, default-value=false  # Parameter to indicate if the mode of a port pin is changeable during runtime by API function Port_SetPinMode. Including this API is controlled by PortSetPinModeApi. true: Port Pin mode is changeable. false: Port Pin mode is not changeable.
          enumeration PortPinLevelValue: {PORT_PIN_LEVEL_LOW, PORT_PIN_LEVEL_HIGH}, set at post-build, origin=Renesas_v1.0.0, default-value=PORT_PIN_LEVEL_LOW  # Parameter to indicate port pin level value for a port pin. PORT_PIN_LEVEL_LOW: Port pin Level is low. PORT_PIN_LEVEL_HIGH: Port pin Level is high.
          enumeration PortPinInitialMode: {GTM0I0_ALT1_IN, GTMAT1O3_ALT1_OUT, CSIH3DCS_ALT2_IN, CSIH3SO0_ALT2_OUT, HSURT0SDIO3I_ALT4_IN, HSURT0SDIO3O_ALT4_OUT, DIO}, set at post-build, origin=Renesas_v1.0.0, default-value=DIO  # Mode of the port pin for use with Port_Init() function. <Input name>_ALT<Alternative instance>_IN: Provides alternative instance for selected input. <Output name>_ALT<Alternative instance>_OUT: Provides alternative instance for selected output.
          enumeration PortPinDirection: {PORT_PIN_OUT, PORT_PIN_IN}, set at post-build, origin=Renesas_v1.0.0, default-value=PORT_PIN_IN  # The initial direction of the pin (IN or OUT). If the direction is not changeable, the value configured here is fixed. The direction must match the pin mode. PORT_PIN_IN: Port pin direction set as input. PORT_PIN_OUT: Port pin direction set as output.
          boolean PortInputBufferControl: set at post-build, origin=Renesas_v1.0.0, default-value=false  # This parameter is used as one of the factors to enable/disable port pins input buffer in DIO Mode (PMC=0). true: Port pin's input buffer is ready to be enabled in DIO Mode. false: Port pin's input buffer is disabled in DIO Mode.
          boolean PortBiDirectionControl: set at post-build, origin=Renesas_v1.0.0, default-value=false  # This parameter forces port pins input buffer and output buffer at the same time. If activated, the effect is valid independently from any other port settings. true: Activate forced Bi-directional IO buffer of the port pin. false: Deactivate forced Bi-directional IO buffer of the port pin.
          boolean PortIpControl: set at post-build, origin=Renesas_v1.0.0, default-value=false  # This parameter is used to enable/disable the direct IO control of port pins input buffer and output buffer. true: Enables the direct IO control of port pins input buffer and output buffer by the corresponding control signals of IP_ENI3(0) and IP_ENO3(0) from internal peripheral IPs. This register is valid only in Control Mode (PMC=1). false: Disables the direct IO control of port pins input buffer and output buffer.
          boolean PortPullUpOption: set at post-build, origin=Renesas_v1.0.0, default-value=false  # This register switches on or off the port pins pull-up resistor. true: Port pin's pull-up resistor is enabled. false: Port pin's pull-up resistor is disabled.
          boolean PortPullDownOption: set at post-build, origin=Renesas_v1.0.0, default-value=false  # This parameter switches on or off the port pins pull-down resistor. true: Port pin's pull-down resistor is enabled. false: Port pin's pull-down resistor is disabled.
          enumeration PortOpenDrainControl_Expansion: {PushPull, OpenDrain_N_Channel, OpenDrain_P_Channel}, set at post-build, origin=Renesas_v1.0.2, default-value=PushPull  # This parameter selects port pins output buffer function in combination of PODC and PODCE . | PushPull Specifies the PushPull type output circuit characteristics and updates both PODC and PODCE registers as 0 0 respectively. OpenDrain_N_Channel specifies the N-ch open drain type output circuit characteristics and updates the PODC and PODCE registers as 1 0 respectively. OpenDrain_P_Channel specifies the P-ch open drain type output circuit characteristics and updates the PODC and PODCE registers as 1 1 respectively.
          boolean PortOutputLevelInversion: set at post-build, origin=Renesas_v1.0.0, default-value=false  # This parameter specifies whether the output level from a pin is inverted or not. true: Pin output level is inverted. false: Pin output level is not inverted.
          enumeration PortDriveStrengthControl: {SLOW, FAST}, set at post-build, origin=Renesas_v1.0.0, default-value=SLOW  # This parameter selects the port pins output drive strength as high strength or low strength type. This functionality is also referred to fast (high strength) and slow (low strength) behavior of output buffer. SLOW: Lower drive strength (slow mode) is selected for port pin's output buffer. FAST: Higher drive strength (fast mode) is selected for port pin's output buffer.
          boolean PortUniversalCharacteristicCntrl: set at post-build, origin=Renesas_v1.0.0, default-value=false  # This parameter selects the port pins output drive strength as high or low type. The PortDriveStrengthControl must be enabled for this feature. | false: PortDriveStrengthControl parameter specifies the output driver strength of the port pin. true : Number of output buffer characteristics selection capability is expanded, the maximum of 4 characteristics selection is possible PUCCn PDSCn 0 0 Output characteristic selection 1 (400 Ohm buffer) 0 1 Output characteristic selection 2 (200 Ohm buffer) 1 0 Output characteristic selection 3 (100 Ohm buffer) 1 1 Output characteristic selection 4 (50 Ohm buffer)
          enumeration PortInputSelection: {TYPE1_SHMT1, TYPE2_SHMT4}, set at post-build, origin=Renesas_v1.0.0, default-value=TYPE1_SHMT1  # This setting specifies the input buffer characteristics. TYPE1_SHMT1: TYPE 1 buffer is selected. TYPE2_SHMT4: TYPE 2 buffer is selected.
        container PortPin5  # This container contains the configuration (parameters) for Port Pin 0.
          boolean PortPinDirectionChangeable: set at post-build, origin=Renesas_v1.0.0, default-value=false  # Parameter to indicate if the direction is changeable on a port pin during runtime. true: Port Pin direction changeable enabled. false: Port Pin direction changeable disabled.
          boolean PortPinDioAltModeChangeable: set at post-build, origin=Renesas_v1.0.0, default-value=false  # Parameter to indicate if the mode of a port pin is changeable between DIO and Alternate during runtime by API functions Port_SetToDioMode and Port_SetToAlternateMode. Including these APIs is controlled by PortSetToDioAltModeApi. true: Dio Alternate mode is changeable. false: Dio Alternate mode is not changeable.
          boolean PortPinModeChangeable: set at post-build, origin=Renesas_v1.0.0, default-value=false  # Parameter to indicate if the mode of a port pin is changeable during runtime by API function Port_SetPinMode. Including this API is controlled by PortSetPinModeApi. true: Port Pin mode is changeable. false: Port Pin mode is not changeable.
          enumeration PortPinLevelValue: {PORT_PIN_LEVEL_LOW, PORT_PIN_LEVEL_HIGH}, set at post-build, origin=Renesas_v1.0.0, default-value=PORT_PIN_LEVEL_LOW  # Parameter to indicate port pin level value for a port pin. PORT_PIN_LEVEL_LOW: Port pin Level is low. PORT_PIN_LEVEL_HIGH: Port pin Level is high.
          enumeration PortPinInitialMode: {GTM1I6_ALT1_IN_SUPP_PFC_PMCSR, CSIH3CSS1_ALT2_OUT_SUPP_PFC_PMCSR, DIO_SUPP_PFC_PMCSR}, set at post-build, origin=Renesas_v1.0.0, default-value=DIO_SUPP_PFC_PMCSR  # Mode of the port pin for use with Port_Init() function. <Input name>_ALT<Alternative instance>_IN: Provides alternative instance for selected input. <Output name>_ALT<Alternative instance>_OUT: Provides alternative instance for selected output.
          enumeration PortPinDirection: {PORT_PIN_OUT, PORT_PIN_IN}, set at post-build, origin=Renesas_v1.0.0, default-value=PORT_PIN_IN  # The initial direction of the pin (IN or OUT). If the direction is not changeable, the value configured here is fixed. The direction must match the pin mode. PORT_PIN_IN: Port pin direction set as input. PORT_PIN_OUT: Port pin direction set as output.
          boolean PortInputBufferControl: set at post-build, origin=Renesas_v1.0.0, default-value=false  # This parameter is used as one of the factors to enable/disable port pins input buffer in DIO Mode (PMC=0). true: Port pin's input buffer is ready to be enabled in DIO Mode. false: Port pin's input buffer is disabled in DIO Mode.
          boolean PortBiDirectionControl: set at post-build, origin=Renesas_v1.0.0, default-value=false  # This parameter forces port pins input buffer and output buffer at the same time. If activated, the effect is valid independently from any other port settings. true: Activate forced Bi-directional IO buffer of the port pin. false: Deactivate forced Bi-directional IO buffer of the port pin.
          boolean PortPullUpOption: set at post-build, origin=Renesas_v1.0.0, default-value=false  # This register switches on or off the port pins pull-up resistor. true: Port pin's pull-up resistor is enabled. false: Port pin's pull-up resistor is disabled.
          boolean PortPullDownOption: set at post-build, origin=Renesas_v1.0.0, default-value=false  # This parameter switches on or off the port pins pull-down resistor. true: Port pin's pull-down resistor is enabled. false: Port pin's pull-down resistor is disabled.
          enumeration PortOpenDrainControl_Expansion: {PushPull, OpenDrain_N_Channel, OpenDrain_P_Channel}, set at post-build, origin=Renesas_v1.0.2, default-value=PushPull  # This parameter selects port pins output buffer function in combination of PODC and PODCE . | PushPull Specifies the PushPull type output circuit characteristics and updates both PODC and PODCE registers as 0 0 respectively. OpenDrain_N_Channel specifies the N-ch open drain type output circuit characteristics and updates the PODC and PODCE registers as 1 0 respectively. OpenDrain_P_Channel specifies the P-ch open drain type output circuit characteristics and updates the PODC and PODCE registers as 1 1 respectively.
          boolean PortOutputLevelInversion: set at post-build, origin=Renesas_v1.0.0, default-value=false  # This parameter specifies whether the output level from a pin is inverted or not. true: Pin output level is inverted. false: Pin output level is not inverted.
          enumeration PortDriveStrengthControl: {SLOW, FAST}, set at post-build, origin=Renesas_v1.0.0, default-value=SLOW  # This parameter selects the port pins output drive strength as high strength or low strength type. This functionality is also referred to fast (high strength) and slow (low strength) behavior of output buffer. SLOW: Lower drive strength (slow mode) is selected for port pin's output buffer. FAST: Higher drive strength (fast mode) is selected for port pin's output buffer.
          boolean PortUniversalCharacteristicCntrl: set at post-build, origin=Renesas_v1.0.0, default-value=false  # This parameter selects the port pins output drive strength as high or low type. The PortDriveStrengthControl must be enabled for this feature. | false: PortDriveStrengthControl parameter specifies the output driver strength of the port pin. true : Number of output buffer characteristics selection capability is expanded, the maximum of 4 characteristics selection is possible PUCCn PDSCn 0 0 Output characteristic selection 1 (400 Ohm buffer) 0 1 Output characteristic selection 2 (200 Ohm buffer) 1 0 Output characteristic selection 3 (100 Ohm buffer) 1 1 Output characteristic selection 4 (50 Ohm buffer)
          enumeration PortInputSelection: {TYPE1_SHMT1, TYPE2_SHMT4}, set at post-build, origin=Renesas_v1.0.0, default-value=TYPE1_SHMT1  # This setting specifies the input buffer characteristics. TYPE1_SHMT1: TYPE 1 buffer is selected. TYPE2_SHMT4: TYPE 2 buffer is selected.
        container PortPin6  # This container contains the configuration (parameters) for Port Pin 0.
          boolean PortPinDirectionChangeable: set at post-build, origin=Renesas_v1.0.0, default-value=false  # Parameter to indicate if the direction is changeable on a port pin during runtime. true: Port Pin direction changeable enabled. false: Port Pin direction changeable disabled.
          boolean PortPinDioAltModeChangeable: set at post-build, origin=Renesas_v1.0.0, default-value=false  # Parameter to indicate if the mode of a port pin is changeable between DIO and Alternate during runtime by API functions Port_SetToDioMode and Port_SetToAlternateMode. Including these APIs is controlled by PortSetToDioAltModeApi. true: Dio Alternate mode is changeable. false: Dio Alternate mode is not changeable.
          boolean PortPinModeChangeable: set at post-build, origin=Renesas_v1.0.0, default-value=false  # Parameter to indicate if the mode of a port pin is changeable during runtime by API function Port_SetPinMode. Including this API is controlled by PortSetPinModeApi. true: Port Pin mode is changeable. false: Port Pin mode is not changeable.
          enumeration PortPinLevelValue: {PORT_PIN_LEVEL_LOW, PORT_PIN_LEVEL_HIGH}, set at post-build, origin=Renesas_v1.0.0, default-value=PORT_PIN_LEVEL_LOW  # Parameter to indicate port pin level value for a port pin. PORT_PIN_LEVEL_LOW: Port pin Level is low. PORT_PIN_LEVEL_HIGH: Port pin Level is high.
          enumeration PortPinInitialMode: {GTM1I3_ALT1_IN, CSIH3CSS2_ALT2_OUT, CSIH1CSS7_ALT3_OUT, DIO}, set at post-build, origin=Renesas_v1.0.0, default-value=DIO  # Mode of the port pin for use with Port_Init() function. <Input name>_ALT<Alternative instance>_IN: Provides alternative instance for selected input. <Output name>_ALT<Alternative instance>_OUT: Provides alternative instance for selected output.
          enumeration PortPinDirection: {PORT_PIN_OUT, PORT_PIN_IN}, set at post-build, origin=Renesas_v1.0.0, default-value=PORT_PIN_IN  # The initial direction of the pin (IN or OUT). If the direction is not changeable, the value configured here is fixed. The direction must match the pin mode. PORT_PIN_IN: Port pin direction set as input. PORT_PIN_OUT: Port pin direction set as output.
          boolean PortInputBufferControl: set at post-build, origin=Renesas_v1.0.0, default-value=false  # This parameter is used as one of the factors to enable/disable port pins input buffer in DIO Mode (PMC=0). true: Port pin's input buffer is ready to be enabled in DIO Mode. false: Port pin's input buffer is disabled in DIO Mode.
          boolean PortBiDirectionControl: set at post-build, origin=Renesas_v1.0.0, default-value=false  # This parameter forces port pins input buffer and output buffer at the same time. If activated, the effect is valid independently from any other port settings. true: Activate forced Bi-directional IO buffer of the port pin. false: Deactivate forced Bi-directional IO buffer of the port pin.
          boolean PortPullUpOption: set at post-build, origin=Renesas_v1.0.0, default-value=false  # This register switches on or off the port pins pull-up resistor. true: Port pin's pull-up resistor is enabled. false: Port pin's pull-up resistor is disabled.
          boolean PortPullDownOption: set at post-build, origin=Renesas_v1.0.0, default-value=false  # This parameter switches on or off the port pins pull-down resistor. true: Port pin's pull-down resistor is enabled. false: Port pin's pull-down resistor is disabled.
          enumeration PortOpenDrainControl_Expansion: {PushPull, OpenDrain_N_Channel, OpenDrain_P_Channel}, set at post-build, origin=Renesas_v1.0.2, default-value=PushPull  # This parameter selects port pins output buffer function in combination of PODC and PODCE . | PushPull Specifies the PushPull type output circuit characteristics and updates both PODC and PODCE registers as 0 0 respectively. OpenDrain_N_Channel specifies the N-ch open drain type output circuit characteristics and updates the PODC and PODCE registers as 1 0 respectively. OpenDrain_P_Channel specifies the P-ch open drain type output circuit characteristics and updates the PODC and PODCE registers as 1 1 respectively.
          boolean PortOutputLevelInversion: set at post-build, origin=Renesas_v1.0.0, default-value=false  # This parameter specifies whether the output level from a pin is inverted or not. true: Pin output level is inverted. false: Pin output level is not inverted.
          enumeration PortDriveStrengthControl: {SLOW, FAST}, set at post-build, origin=Renesas_v1.0.0, default-value=SLOW  # This parameter selects the port pins output drive strength as high strength or low strength type. This functionality is also referred to fast (high strength) and slow (low strength) behavior of output buffer. SLOW: Lower drive strength (slow mode) is selected for port pin's output buffer. FAST: Higher drive strength (fast mode) is selected for port pin's output buffer.
          boolean PortUniversalCharacteristicCntrl: set at post-build, origin=Renesas_v1.0.0, default-value=false  # This parameter selects the port pins output drive strength as high or low type. The PortDriveStrengthControl must be enabled for this feature. | false: PortDriveStrengthControl parameter specifies the output driver strength of the port pin. true : Number of output buffer characteristics selection capability is expanded, the maximum of 4 characteristics selection is possible PUCCn PDSCn 0 0 Output characteristic selection 1 (400 Ohm buffer) 0 1 Output characteristic selection 2 (200 Ohm buffer) 1 0 Output characteristic selection 3 (100 Ohm buffer) 1 1 Output characteristic selection 4 (50 Ohm buffer)
          enumeration PortInputSelection: {TYPE1_SHMT1, TYPE2_SHMT4}, set at post-build, origin=Renesas_v1.0.0, default-value=TYPE1_SHMT1  # This setting specifies the input buffer characteristics. TYPE1_SHMT1: TYPE 1 buffer is selected. TYPE2_SHMT4: TYPE 2 buffer is selected.
        container PortPin7  # This container contains the configuration (parameters) for Port Pin 0.
          boolean PortPinDirectionChangeable: set at post-build, origin=Renesas_v1.0.0, default-value=false  # Parameter to indicate if the direction is changeable on a port pin during runtime. true: Port Pin direction changeable enabled. false: Port Pin direction changeable disabled.
          boolean PortPinDioAltModeChangeable: set at post-build, origin=Renesas_v1.0.0, default-value=false  # Parameter to indicate if the mode of a port pin is changeable between DIO and Alternate during runtime by API functions Port_SetToDioMode and Port_SetToAlternateMode. Including these APIs is controlled by PortSetToDioAltModeApi. true: Dio Alternate mode is changeable. false: Dio Alternate mode is not changeable.
          boolean PortPinModeChangeable: set at post-build, origin=Renesas_v1.0.0, default-value=false  # Parameter to indicate if the mode of a port pin is changeable during runtime by API function Port_SetPinMode. Including this API is controlled by PortSetPinModeApi. true: Port Pin mode is changeable. false: Port Pin mode is not changeable.
          enumeration PortPinLevelValue: {PORT_PIN_LEVEL_LOW, PORT_PIN_LEVEL_HIGH}, set at post-build, origin=Renesas_v1.0.0, default-value=PORT_PIN_LEVEL_LOW  # Parameter to indicate port pin level value for a port pin. PORT_PIN_LEVEL_LOW: Port pin Level is low. PORT_PIN_LEVEL_HIGH: Port pin Level is high.
          enumeration PortPinInitialMode: {GTM1I4_ALT1_IN, CSIH3CSS3_ALT2_OUT, CSIH1CSS6_ALT3_OUT, DIO}, set at post-build, origin=Renesas_v1.0.0, default-value=DIO  # Mode of the port pin for use with Port_Init() function. <Input name>_ALT<Alternative instance>_IN: Provides alternative instance for selected input. <Output name>_ALT<Alternative instance>_OUT: Provides alternative instance for selected output.
          enumeration PortPinDirection: {PORT_PIN_OUT, PORT_PIN_IN}, set at post-build, origin=Renesas_v1.0.0, default-value=PORT_PIN_IN  # The initial direction of the pin (IN or OUT). If the direction is not changeable, the value configured here is fixed. The direction must match the pin mode. PORT_PIN_IN: Port pin direction set as input. PORT_PIN_OUT: Port pin direction set as output.
          boolean PortInputBufferControl: set at post-build, origin=Renesas_v1.0.0, default-value=false  # This parameter is used as one of the factors to enable/disable port pins input buffer in DIO Mode (PMC=0). true: Port pin's input buffer is ready to be enabled in DIO Mode. false: Port pin's input buffer is disabled in DIO Mode.
          boolean PortBiDirectionControl: set at post-build, origin=Renesas_v1.0.0, default-value=false  # This parameter forces port pins input buffer and output buffer at the same time. If activated, the effect is valid independently from any other port settings. true: Activate forced Bi-directional IO buffer of the port pin. false: Deactivate forced Bi-directional IO buffer of the port pin.
          boolean PortPullUpOption: set at post-build, origin=Renesas_v1.0.0, default-value=false  # This register switches on or off the port pins pull-up resistor. true: Port pin's pull-up resistor is enabled. false: Port pin's pull-up resistor is disabled.
          boolean PortPullDownOption: set at post-build, origin=Renesas_v1.0.0, default-value=false  # This parameter switches on or off the port pins pull-down resistor. true: Port pin's pull-down resistor is enabled. false: Port pin's pull-down resistor is disabled.
          enumeration PortOpenDrainControl_Expansion: {PushPull, OpenDrain_N_Channel, OpenDrain_P_Channel}, set at post-build, origin=Renesas_v1.0.2, default-value=PushPull  # This parameter selects port pins output buffer function in combination of PODC and PODCE . | PushPull Specifies the PushPull type output circuit characteristics and updates both PODC and PODCE registers as 0 0 respectively. OpenDrain_N_Channel specifies the N-ch open drain type output circuit characteristics and updates the PODC and PODCE registers as 1 0 respectively. OpenDrain_P_Channel specifies the P-ch open drain type output circuit characteristics and updates the PODC and PODCE registers as 1 1 respectively.
          boolean PortOutputLevelInversion: set at post-build, origin=Renesas_v1.0.0, default-value=false  # This parameter specifies whether the output level from a pin is inverted or not. true: Pin output level is inverted. false: Pin output level is not inverted.
          enumeration PortDriveStrengthControl: {SLOW, FAST}, set at post-build, origin=Renesas_v1.0.0, default-value=SLOW  # This parameter selects the port pins output drive strength as high strength or low strength type. This functionality is also referred to fast (high strength) and slow (low strength) behavior of output buffer. SLOW: Lower drive strength (slow mode) is selected for port pin's output buffer. FAST: Higher drive strength (fast mode) is selected for port pin's output buffer.
          boolean PortUniversalCharacteristicCntrl: set at post-build, origin=Renesas_v1.0.0, default-value=false  # This parameter selects the port pins output drive strength as high or low type. The PortDriveStrengthControl must be enabled for this feature. | false: PortDriveStrengthControl parameter specifies the output driver strength of the port pin. true : Number of output buffer characteristics selection capability is expanded, the maximum of 4 characteristics selection is possible PUCCn PDSCn 0 0 Output characteristic selection 1 (400 Ohm buffer) 0 1 Output characteristic selection 2 (200 Ohm buffer) 1 0 Output characteristic selection 3 (100 Ohm buffer) 1 1 Output characteristic selection 4 (50 Ohm buffer)
          enumeration PortInputSelection: {TYPE1_SHMT1, TYPE2_SHMT4}, set at post-build, origin=Renesas_v1.0.0, default-value=TYPE1_SHMT1  # This setting specifies the input buffer characteristics. TYPE1_SHMT1: TYPE 1 buffer is selected. TYPE2_SHMT4: TYPE 2 buffer is selected.
