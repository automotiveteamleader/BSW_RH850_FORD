AUTOSAR XML (schema 4-0-3)
package /Renesas/EcucDefs_Mcu
  module config Mcu_Rec: definition=Mcu, implementation-config-variant=VARIANT-POST-BUILD
    McuGeneralConfiguration: McuVersionCheckExternalModules=0
  bsw implementation Mcu_Impl: programming-language=C, used-code-generator=EXTERNAL, behavior=McuBehavior, recommended-configuration=Mcu_Rec, vendor-specific-module-def=Mcu
