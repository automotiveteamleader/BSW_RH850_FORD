[part 1 of 2: package /Renesas/EcucDefs_Mcu]
AUTOSAR XML (schema 4-0-3)
# COPYRIGHT
# Copyright(c) 2015-2017 Renesas Electronics Corporation
# 13.Copyright Information is updated.
package /Renesas/EcucDefs_Mcu
  ecuc definition collection RenesasParameterDefinition_Mcu: module=Mcu
  module definition Mcu: refined-module-def=Mcu, variants post-build  # Configuration of the MCU (Microcontroller Unit) module.
    container McuPublishedInformation  # Container holding all MCU specific published information parameters.
      container McuResetReasonConf [1..*]  # This container contains the configuration for the different type of reset reason that can be retrieved from Mcu_GetResetReason API.
        integer McuResetReason: 0..255, set at published-information, symbolic-name-value=true, default-value=0  # The parameter represents the different type of reset that a Micro supports. This parameter is referenced by the parameter EcuMResetReason in the ECU State manager module. This parameter is not used for implementation.
      container McuRstRsnConfPowOnRst  # This container contains the configuration for the different type of reset reason that can be retrieved from Mcu_GetResetReason API.
        integer McuResetReason: 0..0, set at published-information, origin=Renesas_v1.0.0, symbolic-name-value=true, default-value=0  # The parameter represents the different type of reset that a Micro supports. This parameter is referenced by the parameter EcuMResetReason in the ECU State manager module, MCU_POWER_ON_RESET.
      container McuRstRsnConfTerminalRst  # This container contains the configuration for the different type of reset reason that can be retrieved from Mcu_GetResetReason API.
        integer McuResetReason: 1..1, set at published-information, origin=Renesas_v1.0.0, symbolic-name-value=true, default-value=1  # The parameter represents the different type of reset that a Micro supports. This parameter is referenced by the parameter EcuMResetReason in the ECU State manager module, MCU_TERMINAL_RESET.
      container McuRstRsnConfCvmRst  # This container contains the configuration for the different type of reset reason that can be retrieved from Mcu_GetResetReason API.
        integer McuResetReason: 2..2, set at published-information, origin=Renesas_v1.0.0, symbolic-name-value=true, default-value=2  # The parameter represents the different type of reset that a Micro supports. This parameter is referenced by the parameter EcuMResetReason in the ECU State manager module, MCU_CVM_RESET.
      container McuRstRsnConfSwSysRst  # This container contains the configuration for the different type of reset reason that can be retrieved from Mcu_GetResetReason API.
        integer McuResetReason: 3..3, set at published-information, origin=Renesas_v1.0.0, symbolic-name-value=true, default-value=3  # The parameter represents the different type of reset that a Micro supports. This parameter is referenced by the parameter EcuMResetReason in the ECU State manager module, MCU_SW_SYS_RESET.
      container McuRstRsnConfWdtRst  # This container contains the configuration for the different type of reset reason that can be retrieved from Mcu_GetResetReason API.
        integer McuResetReason: 4..4, set at published-information, origin=Renesas_v1.0.0, symbolic-name-value=true, default-value=4  # The parameter represents the different type of reset that a Micro supports. This parameter is referenced by the parameter EcuMResetReason in the ECU State manager module, MCU_WATCHDOG_RESET.
      container McuRstRsnConfLockStepCoreRst  # This container contains the configuration for the different type of reset reason that can be retrieved from Mcu_GetResetReason API.
        integer McuResetReason: 5..5, set at published-information, origin=Renesas_v1.0.0, symbolic-name-value=true, default-value=5  # The parameter represents the different type of reset that a Micro supports. This parameter is referenced by the parameter EcuMResetReason in the ECU State manager module, MCU_LOCK_STEP_CORE_RST.
      container McuRstRsnConfPbusFssRst  # This container contains the configuration for the different type of reset reason that can be retrieved from Mcu_GetResetReason API.
        integer McuResetReason: 6..6, set at published-information, origin=Renesas_v1.0.0, symbolic-name-value=true, default-value=6  # The parameter represents the different type of reset that a Micro supports. This parameter is referenced by the parameter EcuMResetReason in the ECU State manager module, MCU_PBUS_FSS_RST.
      container McuRstRsnConfBusBridgeErrorRst  # This container contains the configuration for the different type of reset reason that can be retrieved from Mcu_GetResetReason API.
        integer McuResetReason: 7..7, set at published-information, origin=Renesas_v1.0.0, symbolic-name-value=true, default-value=7  # The parameter represents the different type of reset that a Micro supports. This parameter is referenced by the parameter EcuMResetReason in the ECU State manager module, MCU_BUS_BRIDGE_ERROR_RST.
      container McuRstRsnConfSafetyMechCompRst  # This container contains the configuration for the different type of reset reason that can be retrieved from Mcu_GetResetReason API.
        integer McuResetReason: 8..8, set at published-information, origin=Renesas_v1.0.0, symbolic-name-value=true, default-value=8  # The parameter represents the different type of reset that a Micro supports. This parameter is referenced by the parameter EcuMResetReason in the ECU State manager module, MCU_SAFETY_MECH_COMP_RST.
      container McuRstRsnConfTempSensorRst  # This container contains the configuration for the different type of reset reason that can be retrieved from Mcu_GetResetReason API.
        integer McuResetReason: 9..9, set at published-information, origin=Renesas_v1.0.0, symbolic-name-value=true, default-value=9  # The parameter represents the different type of reset that a Micro supports. This parameter is referenced by the parameter EcuMResetReason in the ECU State manager module, MCU_TEMPERATURE_SENSOR_RST.
      container McuRstRsnConfClma0Rst  # This container contains the configuration for the different type of reset reason that can be retrieved from Mcu_GetResetReason API.
        integer McuResetReason: 10..10, set at published-information, origin=Renesas_v1.0.0, symbolic-name-value=true, default-value=10  # The parameter represents the different type of reset that a Micro supports. This parameter is referenced by the parameter EcuMResetReason in the ECU State manager module, MCU_CLMA0_RST.
      container McuRstRsnConfClma2Rst  # This container contains the configuration for the different type of reset reason that can be retrieved from Mcu_GetResetReason API.
        integer McuResetReason: 11..11, set at published-information, origin=Renesas_v1.0.0, symbolic-name-value=true, default-value=11  # The parameter represents the different type of reset that a Micro supports. This parameter is referenced by the parameter EcuMResetReason in the ECU State manager module, MCU_CLMA2_RST.
      container McuRstRsnConfClma3Rst  # This container contains the configuration for the different type of reset reason that can be retrieved from Mcu_GetResetReason API.
        integer McuResetReason: 12..12, set at published-information, origin=Renesas_v1.0.0, symbolic-name-value=true, default-value=12  # The parameter represents the different type of reset that a Micro supports. This parameter is referenced by the parameter EcuMResetReason in the ECU State manager module, MCU_CLMA3_RST.
      container McuRstRsnConfClma4Rst  # This container contains the configuration for the different type of reset reason that can be retrieved from Mcu_GetResetReason API.
        integer McuResetReason: 13..13, set at published-information, origin=Renesas_v1.0.0, symbolic-name-value=true, default-value=13  # The parameter represents the different type of reset that a Micro supports. This parameter is referenced by the parameter EcuMResetReason in the ECU State manager module, MCU_CLMA4_RST.
      container McuRstRsnConfClma1Rst  # This container contains the configuration for the different type of reset reason that can be retrieved from Mcu_GetResetReason API.
        integer McuResetReason: 14..14, set at published-information, origin=Renesas_v1.0.0, symbolic-name-value=true, default-value=14  # The parameter represents the different type of reset that a Micro supports. This parameter is referenced by the parameter EcuMResetReason in the ECU State manager module, MCU_CLMA1_RST.
      container McuRstRsnConfLRamEccDedRst  # This container contains the configuration for the different type of reset reason that can be retrieved from Mcu_GetResetReason API.
        integer McuResetReason: 15..15, set at published-information, origin=Renesas_v1.0.0, symbolic-name-value=true, default-value=15  # The parameter represents the different type of reset that a Micro supports. This parameter is referenced by the parameter EcuMResetReason in the ECU State manager module, MCU_LRAM_ECC_DED_RST.
      container McuRstRsnConfGRamEccDedRst  # This container contains the configuration for the different type of reset reason that can be retrieved from Mcu_GetResetReason API.
        integer McuResetReason: 16..16, set at published-information, origin=Renesas_v1.0.0, symbolic-name-value=true, default-value=16  # The parameter represents the different type of reset that a Micro supports. This parameter is referenced by the parameter EcuMResetReason in the ECU State manager module, MCU_GRAM_ECC_DED_RST.
      container McuRstRsnConfCacheRamEdcRst  # This container contains the configuration for the different type of reset reason that can be retrieved from Mcu_GetResetReason API.
        integer McuResetReason: 17..17, set at published-information, origin=Renesas_v1.0.0, symbolic-name-value=true, default-value=17  # The parameter represents the different type of reset that a Micro supports. This parameter is referenced by the parameter EcuMResetReason in the ECU State manager module, MCU_CACHE_RAM_EDC_RST.
      container McuRstRsnConfCodeFlsEccDedRst  # This container contains the configuration for the different type of reset reason that can be retrieved from Mcu_GetResetReason API.
        integer McuResetReason: 18..18, set at published-information, origin=Renesas_v1.0.0, symbolic-name-value=true, default-value=18  # The parameter represents the different type of reset that a Micro supports. This parameter is referenced by the parameter EcuMResetReason in the ECU State manager module, MCU_CODE_FLS_ECC_DED_RST.
      container McuRstRsnConfDataFlsEccDedRst  # This container contains the configuration for the different type of reset reason that can be retrieved from Mcu_GetResetReason API.
        integer McuResetReason: 19..19, set at published-information, origin=Renesas_v1.0.0, symbolic-name-value=true, default-value=19  # The parameter represents the different type of reset that a Micro supports. This parameter is referenced by the parameter EcuMResetReason in the ECU State manager module, MCU_DATA_FLS_ECC_DED_RST.
      container McuRstRsnConfCsihRamEccDedRst  # This container contains the configuration for the different type of reset reason that can be retrieved from Mcu_GetResetReason API.
        integer McuResetReason: 20..20, set at published-information, origin=Renesas_v1.0.0, symbolic-name-value=true, default-value=20  # The parameter represents the different type of reset that a Micro supports. This parameter is referenced by the parameter EcuMResetReason in the ECU State manager module, MCU_CSIH_RAM_ECC_DED_RST.
      container McuRstRsnConfCanRamEccDedRst  # This container contains the configuration for the different type of reset reason that can be retrieved from Mcu_GetResetReason API.
        integer McuResetReason: 21..21, set at published-information, origin=Renesas_v1.0.0, symbolic-name-value=true, default-value=21  # The parameter represents the different type of reset that a Micro supports. This parameter is referenced by the parameter EcuMResetReason in the ECU State manager module, MCU_CAN_RAM_ECC_DED_RST.
      container McuRstRsnConfEthRamDedRst  # This container contains the configuration for the different type of reset reason that can be retrieved from Mcu_GetResetReason API.
        integer McuResetReason: 22..22, set at published-information, origin=Renesas_v1.0.0, symbolic-name-value=true, default-value=22  # The parameter represents the different type of reset that a Micro supports. This parameter is referenced by the parameter EcuMResetReason in the ECU State manager module, MCU_ETH_RAM_ECC_DED_RST.
      container McuRstRsnConfFrRamEccDedRst  # This container contains the configuration for the different type of reset reason that can be retrieved from Mcu_GetResetReason API.
        integer McuResetReason: 23..23, set at published-information, origin=Renesas_v1.0.0, symbolic-name-value=true, default-value=23  # The parameter represents the different type of reset that a Micro supports. This parameter is referenced by the parameter EcuMResetReason in the ECU State manager module, MCU_FR_RAM_ECC_DED_RST.
      container McuRstRsnConfGtmRamEccDedRst  # This container contains the configuration for the different type of reset reason that can be retrieved from Mcu_GetResetReason API.
        integer McuResetReason: 24..24, set at published-information, origin=Renesas_v1.0.0, symbolic-name-value=true, default-value=24  # The parameter represents the different type of reset that a Micro supports. This parameter is referenced by the parameter EcuMResetReason in the ECU State manager module, MCU_GTM_RAM_ECC_DED_RST.
      container McuRstRsnConfBusEccDedRst  # This container contains the configuration for the different type of reset reason that can be retrieved from Mcu_GetResetReason API.
        integer McuResetReason: 25..25, set at published-information, origin=Renesas_v1.0.0, symbolic-name-value=true, default-value=25  # The parameter represents the different type of reset that a Micro supports. This parameter is referenced by the parameter EcuMResetReason in the ECU State manager module, MCU_BUS_ECC_DED_RST.
      container McuRstRsnConfBusEccSedRst  # This container contains the configuration for the different type of reset reason that can be retrieved from Mcu_GetResetReason API.
        integer McuResetReason: 26..26, set at published-information, origin=Renesas_v1.0.0, symbolic-name-value=true, default-value=26  # The parameter represents the different type of reset that a Micro supports. This parameter is referenced by the parameter EcuMResetReason in the ECU State manager module, MCU_BUS_ECC_SED_RST.
      container McuRstRsnConfLRamAddrOvfRst  # This container contains the configuration for the different type of reset reason that can be retrieved from Mcu_GetResetReason API.
        integer McuResetReason: 27..27, set at published-information, origin=Renesas_v1.0.0, symbolic-name-value=true, default-value=27  # The parameter represents the different type of reset that a Micro supports. This parameter is referenced by the parameter EcuMResetReason in the ECU State manager module, MCU_LRAM_ADDR_OVF_RST.
      container McuRstRsnConfGRamAddrOvfRst  # This container contains the configuration for the different type of reset reason that can be retrieved from Mcu_GetResetReason API.
        integer McuResetReason: 28..28, set at published-information, origin=Renesas_v1.0.0, symbolic-name-value=true, default-value=28  # The parameter represents the different type of reset that a Micro supports. This parameter is referenced by the parameter EcuMResetReason in the ECU State manager module, MCU_GRAM_ADDR_OVF_RST.
      container McuRstRsnConfCodeFlsAddrOvfRst  # This container contains the configuration for the different type of reset reason that can be retrieved from Mcu_GetResetReason API.
        integer McuResetReason: 29..29, set at published-information, origin=Renesas_v1.0.0, symbolic-name-value=true, default-value=29  # The parameter represents the different type of reset that a Micro supports. This parameter is referenced by the parameter EcuMResetReason in the ECU State manager module, MCU_CODE_FLS_ADDR_OVF_RST.
      container McuRstRsnConfDataFlsAddrOvfRst  # This container contains the configuration for the different type of reset reason that can be retrieved from Mcu_GetResetReason API.
        integer McuResetReason: 30..30, set at published-information, origin=Renesas_v1.0.0, symbolic-name-value=true, default-value=30  # The parameter represents the different type of reset that a Micro supports. This parameter is referenced by the parameter EcuMResetReason in the ECU State manager module, MCU_DATA_FLS_ADDR_OVF_RST.
      container McuRstRsnConfPeriRamEccAddrOvfRst  # This container contains the configuration for the different type of reset reason that can be retrieved from Mcu_GetResetReason API.
        integer McuResetReason: 31..31, set at published-information, origin=Renesas_v1.0.0, symbolic-name-value=true, default-value=31  # The parameter represents the different type of reset that a Micro supports. This parameter is referenced by the parameter EcuMResetReason in the ECU State manager module, MCU_PERI_RAM_ECC_ADDR_OVF_RST.
      container McuRstRsnConfDtsRamEccDedRst  # This container contains the configuration for the different type of reset reason that can be retrieved from Mcu_GetResetReason API.
        integer McuResetReason: 32..32, set at published-information, origin=Renesas_v1.0.0, symbolic-name-value=true, default-value=32  # The parameter represents the different type of reset that a Micro supports. This parameter is referenced by the parameter EcuMResetReason in the ECU State manager module, MCU_DTS_RAM_ECC_DED_RST.
      container McuRstRsnConfDtsRamEccSedRst  # This container contains the configuration for the different type of reset reason that can be retrieved from Mcu_GetResetReason API.
        integer McuResetReason: 33..33, set at published-information, origin=Renesas_v1.0.0, symbolic-name-value=true, default-value=33  # The parameter represents the different type of reset that a Micro supports. This parameter is referenced by the parameter EcuMResetReason in the ECU State manager module, MCU_DTS_RAM_ECC_SED_RST.
      container McuRstRsnConfLRamEccSedRst  # This container contains the configuration for the different type of reset reason that can be retrieved from Mcu_GetResetReason API.
        integer McuResetReason: 34..34, set at published-information, origin=Renesas_v1.0.0, symbolic-name-value=true, default-value=34  # The parameter represents the different type of reset that a Micro supports. This parameter is referenced by the parameter EcuMResetReason in the ECU State manager module, MCU_LRAM_ECC_SED_RST.
      container McuRstRsnConfGRamEccSedRst  # This container contains the configuration for the different type of reset reason that can be retrieved from Mcu_GetResetReason API.
        integer McuResetReason: 35..35, set at published-information, origin=Renesas_v1.0.0, symbolic-name-value=true, default-value=35  # The parameter represents the different type of reset that a Micro supports. This parameter is referenced by the parameter EcuMResetReason in the ECU State manager module, MCU_GRAM_ECC_SED_RST.
      container McuRstRsnConfCodeFlsEccSedRst  # This container contains the configuration for the different type of reset reason that can be retrieved from Mcu_GetResetReason API.
        integer McuResetReason: 36..36, set at published-information, origin=Renesas_v1.0.0, symbolic-name-value=true, default-value=36  # The parameter represents the different type of reset that a Micro supports. This parameter is referenced by the parameter EcuMResetReason in the ECU State manager module, MCU_CODE_FLS_ECC_SED_RST.
      container McuRstRsnConfDataFlsEccSedRst  # This container contains the configuration for the different type of reset reason that can be retrieved from Mcu_GetResetReason API.
        integer McuResetReason: 37..37, set at published-information, origin=Renesas_v1.0.0, symbolic-name-value=true, default-value=37  # The parameter represents the different type of reset that a Micro supports. This parameter is referenced by the parameter EcuMResetReason in the ECU State manager module, MCU_DATA_FLS_ECC_SED_RST.
      container McuRstRsnConfCsihRamEccSedRst  # This container contains the configuration for the different type of reset reason that can be retrieved from Mcu_GetResetReason API.
        integer McuResetReason: 38..38, set at published-information, origin=Renesas_v1.0.0, symbolic-name-value=true, default-value=38  # The parameter represents the different type of reset that a Micro supports. This parameter is referenced by the parameter EcuMResetReason in the ECU State manager module, MCU_CSIH_RAM_ECC_SED_RST.
      container McuRstRsnConfCanRamEccSedRst  # This container contains the configuration for the different type of reset reason that can be retrieved from Mcu_GetResetReason API.
        integer McuResetReason: 39..39, set at published-information, origin=Renesas_v1.0.0, symbolic-name-value=true, default-value=39  # The parameter represents the different type of reset that a Micro supports. This parameter is referenced by the parameter EcuMResetReason in the ECU State manager module, MCU_CAN_RAM_ECC_SED_RST.
      container McuRstRsnConfEthRamEccSedRst  # This container contains the configuration for the different type of reset reason that can be retrieved from Mcu_GetResetReason API.
        integer McuResetReason: 40..40, set at published-information, origin=Renesas_v1.0.0, symbolic-name-value=true, default-value=40  # The parameter represents the different type of reset that a Micro supports. This parameter is referenced by the parameter EcuMResetReason in the ECU State manager module, MCU_ETH_RAM_ECC_SED_RST.
      container McuRstRsnConfFrRamEccSedRst  # This container contains the configuration for the different type of reset reason that can be retrieved from Mcu_GetResetReason API.
        integer McuResetReason: 41..41, set at published-information, origin=Renesas_v1.0.0, symbolic-name-value=true, default-value=41  # The parameter represents the different type of reset that a Micro supports. This parameter is referenced by the parameter EcuMResetReason in the ECU State manager module, MCU_FR_RAM_ECC_SED_RST.
      container McuRstRsnConfGtmRamEccSedRst  # This container contains the configuration for the different type of reset reason that can be retrieved from Mcu_GetResetReason API.
        integer McuResetReason: 42..42, set at published-information, origin=Renesas_v1.0.0, symbolic-name-value=true, default-value=42  # The parameter represents the different type of reset that a Micro supports. This parameter is referenced by the parameter EcuMResetReason in the ECU State manager module, MCU_GTM_RAM_ECC_SED_RST.
      container McuRstRsnConfPEGuardRst  # This container contains the configuration for the different type of reset reason that can be retrieved from Mcu_GetResetReason API.
        integer McuResetReason: 43..43, set at published-information, origin=Renesas_v1.0.0, symbolic-name-value=true, default-value=43  # The parameter represents the different type of reset that a Micro supports. This parameter is referenced by the parameter EcuMResetReason in the ECU State manager module, MCU_PE_GUARD_RST.
      container McuRstRsnConfGramGuardRst  # This container contains the configuration for the different type of reset reason that can be retrieved from Mcu_GetResetReason API.
        integer McuResetReason: 44..44, set at published-information, origin=Renesas_v1.0.0, symbolic-name-value=true, default-value=44  # The parameter represents the different type of reset that a Micro supports. This parameter is referenced by the parameter EcuMResetReason in the ECU State manager module, MCU_GRAM_GUARD_RST.
      container McuRstRsnConfMemcGuardRst  # This container contains the configuration for the different type of reset reason that can be retrieved from Mcu_GetResetReason API.
        integer McuResetReason: 45..45, set at published-information, origin=Renesas_v1.0.0, symbolic-name-value=true, default-value=45  # The parameter represents the different type of reset that a Micro supports. This parameter is referenced by the parameter EcuMResetReason in the ECU State manager module, MCU_MEMC_GUARD_RST.
      container McuRstRsnConfSlaveGuardRst  # This container contains the configuration for the different type of reset reason that can be retrieved from Mcu_GetResetReason API.
        integer McuResetReason: 46..46, set at published-information, origin=Renesas_v1.0.0, symbolic-name-value=true, default-value=46  # The parameter represents the different type of reset that a Micro supports. This parameter is referenced by the parameter EcuMResetReason in the ECU State manager module, MCU_SLAVE_GUARD_RST.
      container McuRstRsnConfCodeFlsPEUnmapAccessRst  # This container contains the configuration for the different type of reset reason that can be retrieved from Mcu_GetResetReason API.
        integer McuResetReason: 47..47, set at published-information, origin=Renesas_v1.0.0, symbolic-name-value=true, default-value=47  # The parameter represents the different type of reset that a Micro supports. This parameter is referenced by the parameter EcuMResetReason in the ECU State manager module, MCU_CODE_FLS_PE_UNMAP_ACCESS_RST.
      container McuRstRsnConfGramPEUnmapAccessRst  # This container contains the configuration for the different type of reset reason that can be retrieved from Mcu_GetResetReason API.
        integer McuResetReason: 48..48, set at published-information, origin=Renesas_v1.0.0, symbolic-name-value=true, default-value=48  # The parameter represents the different type of reset that a Micro supports. This parameter is referenced by the parameter EcuMResetReason in the ECU State manager module, MCU_GRAM_PE_UNMAP_ACCESS_RST.
      container McuRstRsnConfLpbPEUnmapAccessRst  # This container contains the configuration for the different type of reset reason that can be retrieved from Mcu_GetResetReason API.
        integer McuResetReason: 49..49, set at published-information, origin=Renesas_v1.0.0, symbolic-name-value=true, default-value=49  # The parameter represents the different type of reset that a Micro supports. This parameter is referenced by the parameter EcuMResetReason in the ECU State manager module, MCU_LPB_PE_UNMAP_ACCESS_RST.
      container McuRstRsnConfPBusUnmapAccessRst  # This container contains the configuration for the different type of reset reason that can be retrieved from Mcu_GetResetReason API.
        integer McuResetReason: 50..50, set at published-information, origin=Renesas_v1.0.0, symbolic-name-value=true, default-value=50  # The parameter represents the different type of reset that a Micro supports. This parameter is referenced by the parameter EcuMResetReason in the ECU State manager module, MCU_PBUS_UNMAP_ACCESS_RST.
      container McuRstRsnConfHBusUnmapAccessRst  # This container contains the configuration for the different type of reset reason that can be retrieved from Mcu_GetResetReason API.
        integer McuResetReason: 51..51, set at published-information, origin=Renesas_v1.0.0, symbolic-name-value=true, default-value=51  # The parameter represents the different type of reset that a Micro supports. This parameter is referenced by the parameter EcuMResetReason in the ECU State manager module, MCU_HBUS_UNMAP_ACCESS_RST.
      container McuRstRsnConfCodeFlsGvciUnmapAccessRst  # This container contains the configuration for the different type of reset reason that can be retrieved from Mcu_GetResetReason API.
        integer McuResetReason: 52..52, set at published-information, origin=Renesas_v1.0.0, symbolic-name-value=true, default-value=52  # The parameter represents the different type of reset that a Micro supports. This parameter is referenced by the parameter EcuMResetReason in the ECU State manager module, MCU_CODE_FLS_GVCI_UNMAP_ACCESS_RST.
      container McuRstRsnConfGramFlsGvciUnmapAccessRst  # This container contains the configuration for the different type of reset reason that can be retrieved from Mcu_GetResetReason API.
        integer McuResetReason: 53..53, set at published-information, origin=Renesas_v1.0.0, symbolic-name-value=true, default-value=53  # The parameter represents the different type of reset that a Micro supports. This parameter is referenced by the parameter EcuMResetReason in the ECU State manager module, MCU_GRAM_FLS_GVCI_UNMAP_ACCESS_RST.
      container McuRstRsnConfResHbusUnmapAccessRst  # This container contains the configuration for the different type of reset reason that can be retrieved from Mcu_GetResetReason API.
        integer McuResetReason: 54..54, set at published-information, origin=Renesas_v1.0.0, symbolic-name-value=true, default-value=54  # The parameter represents the different type of reset that a Micro supports. This parameter is referenced by the parameter EcuMResetReason in the ECU State manager module, MCU_RES_HBUS_UNMAP_ACCESS_RST.
      container McuRstRsnConfDmaTransferRst  # This container contains the configuration for the different type of reset reason that can be retrieved from Mcu_GetResetReason API.
        integer McuResetReason: 55..55, set at published-information, origin=Renesas_v1.0.0, symbolic-name-value=true, default-value=55  # The parameter represents the different type of reset that a Micro supports. This parameter is referenced by the parameter EcuMResetReason in the ECU State manager module, MCU_DMA_TRANSFER_RST.
      container McuRstRsnConfDmaUnmappedRst  # This container contains the configuration for the different type of reset reason that can be retrieved from Mcu_GetResetReason API.
        integer McuResetReason: 56..56, set at published-information, origin=Renesas_v1.0.0, symbolic-name-value=true, default-value=56  # The parameter represents the different type of reset that a Micro supports. This parameter is referenced by the parameter EcuMResetReason in the ECU State manager module, MCU_DMA_UNMAPPED_RST.
      container McuRstRsnConfFlsSequenceRst  # This container contains the configuration for the different type of reset reason that can be retrieved from Mcu_GetResetReason API.
        integer McuResetReason: 57..57, set at published-information, origin=Renesas_v1.0.0, symbolic-name-value=true, default-value=57  # The parameter represents the different type of reset that a Micro supports. This parameter is referenced by the parameter EcuMResetReason in the ECU State manager module, MCU_FLS_SEQUENCE_RST.
      container McuRstRsnConfFlsFaciRst  # This container contains the configuration for the different type of reset reason that can be retrieved from Mcu_GetResetReason API.
        integer McuResetReason: 58..58, set at published-information, origin=Renesas_v1.0.0, symbolic-name-value=true, default-value=58  # The parameter represents the different type of reset that a Micro supports. This parameter is referenced by the parameter EcuMResetReason in the ECU State manager module, MCU_FLS_FACI_RST.
      container McuRstRsnConfAdcParityRst  # This container contains the configuration for the different type of reset reason that can be retrieved from Mcu_GetResetReason API.
        integer McuResetReason: 59..59, set at published-information, origin=Renesas_v1.0.0, symbolic-name-value=true, default-value=59  # The parameter represents the different type of reset that a Micro supports. This parameter is referenced by the parameter EcuMResetReason in the ECU State manager module, MCU_ADC_PARITY_RST.
      container McuRstRsnConfPEUnintenEnableDisableRst  # This container contains the configuration for the different type of reset reason that can be retrieved from Mcu_GetResetReason API.
        integer McuResetReason: 60..60, set at published-information, origin=Renesas_v1.0.0, symbolic-name-value=true, default-value=60  # The parameter represents the different type of reset that a Micro supports. This parameter is referenced by the parameter EcuMResetReason in the ECU State manager module, MCU_PE_UNINTEN_EN_DIS_RST.
      container McuRstRsnConfUnintenDeactUserRst  # This container contains the configuration for the different type of reset reason that can be retrieved from Mcu_GetResetReason API.
        integer McuResetReason: 61..61, set at published-information, origin=Renesas_v1.0.0, symbolic-name-value=true, default-value=61  # The parameter represents the different type of reset that a Micro supports. This parameter is referenced by the parameter EcuMResetReason in the ECU State manager module, MCU_UNINTEN_DEACT_USR_RST.
      container McuRstRsnConfUnintenActCfpModeRst  # This container contains the configuration for the different type of reset reason that can be retrieved from Mcu_GetResetReason API.
        integer McuResetReason: 62..62, set at published-information, origin=Renesas_v1.0.0, symbolic-name-value=true, default-value=62  # The parameter represents the different type of reset that a Micro supports. This parameter is referenced by the parameter EcuMResetReason in the ECU State manager module, MCU_UNINTEN_ACT_CFP_MODE_RST.
      container McuRstRsnConfUnintenDebugEnableDetectRst  # This container contains the configuration for the different type of reset reason that can be retrieved from Mcu_GetResetReason API.
        integer McuResetReason: 63..63, set at published-information, origin=Renesas_v1.0.0, symbolic-name-value=true, default-value=63  # The parameter represents the different type of reset that a Micro supports. This parameter is referenced by the parameter EcuMResetReason in the ECU State manager module, MCU_UNINTEN_DEBUG_EN_DET_RST.
      container McuRstRsnConfUnintenActTestModeRst  # This container contains the configuration for the different type of reset reason that can be retrieved from Mcu_GetResetReason API.
        integer McuResetReason: 64..64, set at published-information, origin=Renesas_v1.0.0, symbolic-name-value=true, default-value=64  # The parameter represents the different type of reset that a Micro supports. This parameter is referenced by the parameter EcuMResetReason in the ECU State manager module, MCU_UNINTEN_ACT_TESTMODE_RST.
      container McuRstRsnConfEcmCompRst  # This container contains the configuration for the different type of reset reason that can be retrieved from Mcu_GetResetReason API.
        integer McuResetReason: 65..65, set at published-information, origin=Renesas_v1.0.0, symbolic-name-value=true, default-value=65  # The parameter represents the different type of reset that a Micro supports. This parameter is referenced by the parameter EcuMResetReason in the ECU State manager module, MCU_ECM_COMP_RST.
      container McuRstRsnConfDebuggerRst  # This container contains the configuration for the different type of reset reason that can be retrieved from Mcu_GetResetReason API.
        integer McuResetReason: 66..66, set at published-information, origin=Renesas_v1.0.0, symbolic-name-value=true, default-value=66  # The parameter represents the different type of reset that a Micro supports. This parameter is referenced by the parameter EcuMResetReason in the ECU State manager module, MCU_DEBUGGER_RESET.
      container McuRstRsnConfSwApplRst  # This container contains the configuration for the different type of reset reason that can be retrieved from Mcu_GetResetReason API.
        integer McuResetReason: 67..67, set at published-information, origin=Renesas_v1.0.0, symbolic-name-value=true, default-value=67  # The parameter represents the different type of reset that a Micro supports. This parameter is referenced by the parameter EcuMResetReason in the ECU State manager module, MCU_SW_APPL_RESET.
      container McuRstRsnConfBistRst  # This container contains the configuration for the different type of reset reason that can be retrieved from Mcu_GetResetReason API.
        integer McuResetReason: 68..68, set at published-information, origin=Renesas_v1.0.0, symbolic-name-value=true, default-value=68  # The parameter represents the different type of reset that a Micro supports. This parameter is referenced by the parameter EcuMResetReason in the ECU State manager module, MCU_BIST_RESET.
      container McuRstRsnConfRstUndefined  # This container contains the configuration for the different type of reset reason that can be retrieved from Mcu_GetResetReason API.
        integer McuResetReason: 69..69, set at published-information, origin=Renesas_v1.0.0, symbolic-name-value=true, default-value=69  # The parameter represents the different type of reset that a Micro supports. This parameter is referenced by the parameter EcuMResetReason in the ECU State manager module, MCU_RESET_UNDEFINED.
      container McuRstRsnConfRstUnknown  # This container contains the configuration for the different type of reset reason that can be retrieved from Mcu_GetResetReason API.
        integer McuResetReason: 70..70, set at published-information, origin=Renesas_v1.0.0, symbolic-name-value=true, default-value=70  # The parameter represents the different type of reset that a Micro supports. This parameter is referenced by the parameter EcuMResetReason in the ECU State manager module, MCU_RESET_UNKNOWN.
    container McuGeneralConfiguration  # This container contains the configuration (parameters) of the MCU driver.
      boolean McuVersionCheckExternalModules: set at pre-compile, origin=Renesas_v1.0.0, default-value=true  # Enable / disable AUTOSAR Version check for inter-module dependencies. | true: AUTOSAR Version check for inter-module dependencies is enabled. false: AUTOSAR Version check for inter-module dependencies is disabled.
      boolean McuDevErrorDetect: set at pre-compile, default-value=false  # Pre-processor switch for enabling the development error detection and reporting. | true: Enables development error detection and reporting. false: Disables development error detection and reporting.
      boolean McuGetRamStateApi: set at pre-compile, default-value=false  # Pre-processor switch to enable/disable the API Mcu_GetRamState. | (e.g. If the H/W does not support the functionality, this parameter can be used to disable the API). true: API Mcu_GetRamState is enabled. false: API Mcu_GetRamState is disabled.
      boolean McuInitClock: set at pre-compile, default-value=true  # If this parameter is set to FALSE, the clock initialization has to be disabled from the MCU driver. This concept applies when there are some write once clock registers and a bootloader is present. If this parameter is set to TRUE, the MCU driver is responsible for the clock initialization. | true: The MCU driver is responsible for the clock initialization. false: The clock initialization is disabled from the MCU driver.
      boolean McuNoPll: set at pre-compile, default-value=true  # This parameter shall be set true, if the H/W does not have a PLL or the PLL circuitry is enabled after the power on without S/W intervention. In this case MCU_DistributePllClock has to be disabled and MCU_GetPllStatus has to return MCU_PLL_STATUS_UNDEFINED. Otherwise this parameters has to be set False. | true: The H/W does not have a PLL and the PLL circuitry is enabled after the power on without S/W intervention. false: The H/W have a PLL and the PLL circuitry is disabled after the power on without S/W intervention.
      boolean McuPerformResetApi: set at pre-compile, default-value=false  # Pre-processor switch to enable or disable the use of the function Mcu_PerformReset(). | true: Enables the use of the function Mcu_PerformReset(). false: Disables the use of the function Mcu_PerformReset().
      boolean McuVersionInfoApi: set at pre-compile, default-value=false  # Pre-processor switch to enable or disable the API to read out the modules version information. | true: Enables the API to read out the modules version information. false: Disables the API to read out the modules version information.
      boolean McuCriticalSectionProtection: set at pre-compile, origin=Renesas_v1.0.0, default-value=true  # This parameter specifies if the MCU driver CPU load can be reduced by disabling the enter/exit critical section functionality by adding a precompiled configuration parameter to the MCU driver configuration. | true: Enables the critical section functionality for the restricted area. false: Disables the critical section functionality for the restricted area.
      boolean McuSwResetCallApi: set at pre-compile, origin=Renesas_v1.0.0, default-value=false  # This parameter shall decide if MCU_RESET_CALLOUT API will be used for to reset software. | true: MCU_RESET_CALLOUT API will be used for reset software. false: MCU_RESET_CALLOUT API will not be used for reset software.
      integer McuEcmDelayTimerOverflowValue: 0..65535, set at pre-compile, origin=Renesas_v1.0.0, default-value=65535  # This parameter specifies to configure the overflow value for the ECM delay timer.
      enumeration McuEcmErrorOutputMode: {NON_DYNAMIC_MODE, DYNAMIC_MODE}, set at pre-compile, origin=Renesas_v1.0.0, default-value=NON_DYNAMIC_MODE  # This parameter used to configure the error output either in Dynamic or Non-Dynamic mode. | NON_DYNAMIC_MODE: error output in Non-Dynamic mode. DYNAMIC_MODE: error output in Dynamic mode.
      boolean McuClm0Operation: set at post-build, origin=Renesas_v1.0.0, default-value=false  # This parameter enables or disables operation of clock monitor function for CLMA0. | true: Enables operation of clock monitor function for CLMA0. false: Disables operation of clock monitor function for CLMA0.
      float McuClm0MonitoringClockAccuracy: 0..20, set at pre-compile, origin=Renesas_v1.0.0, default-value=0  # This parameter specifies the monitoring clock accuracy of CLMA0 in percentage.
      float McuClm0SamplingClockAccuracy: 6..26, set at pre-compile, origin=Renesas_v1.0.0, default-value=6  # This parameter specifies the sampling clock accuracy of CLMA0 in percentage.
      boolean McuClm1Operation: set at post-build, origin=Renesas_v1.0.0, default-value=false  # This parameter enables or disables operation of clock monitor function for CLMA1. | true: Enables operation of clock monitor function for CLMA1. false: Disables operation of clock monitor function for CLMA1.
      float McuClm1MonitoringClockAccuracy: 1..20, set at pre-compile, origin=Renesas_v1.0.0, default-value=9  # This parameter specifies the monitoring clock accuracy of CLMA1 in percentage.
      float McuClm1SamplingClockAccuracy: 3..20, set at pre-compile, origin=Renesas_v1.0.0, default-value=9  # This parameter specifies the sampling clock accuracy of CLMA1 in percentage.
      boolean McuClm2Operation: set at post-build, origin=Renesas_v1.0.0, default-value=false  # This parameter enables or disables operation of clock monitor function for CLMA2. | true: Enables operation of clock monitor function for CLMA2. false: Disables operation of clock monitor function for CLMA2.
      float McuClm2MonitoringClockAccuracy: 2..20, set at pre-compile, origin=Renesas_v1.0.0, default-value=9  # This parameter specifies the monitoring clock accuracy of CLMA2 in percentage.
      float McuClm2SamplingClockAccuracy: 5..20, set at pre-compile, origin=Renesas_v1.0.0, default-value=9  # This parameter specifies the sampling clock accuracy of CLMA2 in percentage.
      boolean McuClm3Operation: set at post-build, origin=Renesas_v1.0.0, default-value=false  # This parameter enables or disables operation of clock monitor function for CLMA3. | true: Enables operation of clock monitor function for CLMA3. false: Disables operation of clock monitor function for CLMA3.
      float McuClm3MonitoringClockAccuracy: 0..20, set at pre-compile, origin=Renesas_v1.0.0, default-value=9  # This parameter specifies the monitoring clock accuracy of CLMA3 in percentage.
      float McuClm3SamplingClockAccuracy: 2..20, set at pre-compile, origin=Renesas_v1.0.0, default-value=9  # This parameter specifies the sampling clock accuracy of CLMA3 in percentage.
      boolean McuClm4Operation: set at post-build, origin=Renesas_v1.0.2, default-value=false  # This parameter enables or disables operation of clock monitor function for CLMA4. CLMA4 is not supported in P1M-C devices | true: Enables operation of clock monitor function for CLMA4. false: Disables operation of clock monitor function for CLMA4.
      float McuClm4MonitoringClockAccuracy: 0..20, set at pre-compile, origin=Renesas_v1.0.2, default-value=9  # This parameter specifies the monitoring clock accuracy of CLMA4 in percentage.
      float McuClm4SamplingClockAccuracy: 2..20, set at pre-compile, origin=Renesas_v1.0.2, default-value=9  # This parameter specifies the sampling clock accuracy of CLMA4 in percentage.
      boolean McuClma0SelfDiagnosticTest: set at pre-compile, origin=Renesas_v1.0.2, default-value=false  # This parameter enables or disables operation of self diagnostic test supported for CLMA0. CLMA0 Self-diagnostic tests shall be performed during initialization phase in the module specific initialization function. If self diagnostic test fails then DEM error will be reported. | true: Enables operation of self diagnostic test supported for CLMA0. false: Disables operation of self diagnostic test supported for CLMA0.
      boolean McuClma1SelfDiagnosticTest: set at pre-compile, origin=Renesas_v1.0.2, default-value=false  # This parameter enables or disables operation of self diagnostic test supported for CLMA1. CLMA1 Self-diagnostic tests shall be performed during initialization phase in the module specific initialization function. If self diagnostic test fails then DEM error will be reported. | true: Enables operation of self diagnostic test supported for CLMA1. false: Disables operation of self diagnostic test supported for CLMA1.
      boolean McuClma2SelfDiagnosticTest: set at pre-compile, origin=Renesas_v1.0.2, default-value=false  # This parameter enables or disables operation of self diagnostic test supported for CLMA2. CLMA2 Self-diagnostic tests shall be performed during initialization phase in the module specific initialization function. If self diagnostic test fails then DEM error will be reported. | true: Enables operation of self diagnostic test supported for CLMA2. false: Disables operation of self diagnostic test supported for CLMA2.
      boolean McuClma3SelfDiagnosticTest: set at pre-compile, origin=Renesas_v1.0.2, default-value=false  # This parameter enables or disables operation of self diagnostic test supported for CLMA3. CLMA3 Self-diagnostic tests shall be performed during initialization phase in the module specific initialization function. If self diagnostic test fails then DEM error will be reported. | true: Enables operation of self diagnostic test supported for CLMA3. false: Disables operation of self diagnostic test supported for CLMA3.
      boolean McuClma4SelfDiagnosticTest: set at pre-compile, origin=Renesas_v1.0.2, default-value=false  # This parameter enables or disables operation of self diagnostic test supported for CLMA4. CLMA4 Self-diagnostic tests shall be performed during initialization phase in the module specific initialization function. If self diagnostic test fails then DEM error will be reported. | true: Enables operation of self diagnostic test supported for CLMA4. false: Disables operation of self diagnostic test supported for CLMA4.
      integer McuLoopCount: 1..255, set at pre-compile, origin=Renesas_v1.0.0, default-value=28  # This parameter represents the Time-out loop in MCU module. | This parameter is used to avoid endless loops while the MCU module driver software expects a change in Hardware parameters. Default value of 28 has been set for this parameter to provide enough timeout for the MCU module driver software to capture the Hardware changes.
      enumeration McuEcmRstConfigure: {SYSTEM_RESET, APPLICATION_RESET}, set at pre-compile, origin=Renesas_v1.0.0, default-value=APPLICATION_RESET  # This parameter is used to configure the type of Ecm Reset. | SYSTEM_RESET: ECM Module will generate System Reset. APPLICATION_RESET: ECM Module will generate Application Reset.
      boolean McuRamSectorSetting: set at pre-compile, origin=Renesas_v1.0.2, default-value=false  # This parameter enable or disable Mcu_InitRamSection API. If McuRamSectorSetting = FALSE, All ECM errors sources must be configured as part of Mcu_Init API. If McuRamSectorSetting = TRUE, the Local and Global RAM error sources must be configured as part of Mcu_InitRamSection API. And all other ECM errors sources must be configured as part of Mcu_Init API | true: enables Mcu_InitRamSection API. false: disables Mcu_InitRamSection API.
      enumeration McuDeviceName: {R7F701370A, R7F701372, R7F701373, R7F701371, R7F701374}, set at pre-compile, origin=Renesas_v1.0.0, default-value=R7F701372  # This parameter contains the supported device name.
      boolean McuGTMConfigurationSupport: set at pre-compile, origin=Renesas_v1.0.1, default-value=false  # Pre-processor switch to enable or disable the complete support of all GTM related functionality. | true: Common GTM configuration settings shall be generated. false: Common GTM configuration settings shall NOT be generated.
      boolean McuInterruptConsistencyCheck: set at pre-compile, origin=Renesas_v1.0.2, default-value=false  # This parameter enables / disables the Interrupt Consistency Check functionality. | true: Interrupt Consistency Checks are enabled. false: Interrupt Consistency Checks are disabled.
      enumeration McuWriteVerify: {WV_DISABLE, WV_INIT_ONLY, WV_INIT_RUNTIME}, set at pre-compile, origin=Renesas_v1.0.2, default-value=WV_DISABLE  # This parameter enables selection and support of the register write-verify functionality of all MCU registers. | WV_INIT_ONLY: Enables write-verify functionality on static registers. WV_INIT_RUNTIME: Enables write-verify functionality on static and dynamic registers. WV_DISABLE: Disables the register write-verify functionality for MCU registers.
      boolean McuUseWriteVerifyErrorInterface: set at pre-compile, origin=Renesas_v1.0.2, default-value=false  # This parameter specifies whether user can configure error notification interface instead of DEM error for Write-Verify functionality. | true: user can configure error notification interface via McuWriteVerifyErrorInterface parameter. false: Error notification for Write-Verify functionality shall be handled via DEM error.
      function name McuWriteVerifyErrorInterface [0..1]: set at post-build, origin=Renesas_v1.0.2, default-value=NULL, regular-expression=[a-zA-Z][a-zA-Z0-9_]*  # This parameter is used to configure the name of the error notification which shall be called with the ApiID and ErrorId when there is a Write Verify error.
      boolean McuCvmSelfDiagnosticTest: set at pre-compile, origin=Renesas_v1.0.2, default-value=false  # This parameter enables or disables operation of Self Diagnostic Test supported for CVM. This test shall be performed during initialization phase in the module specific initialization function. If Self Diagnostic Test fails then DEM error will be reported. | true: Enables operation of self diagnostic test supported for CVM. false: Disables operation of self diagnostic test supported for CVM.
      boolean McuEcmSelfDiagnosticTest: set at pre-compile, origin=Renesas_v1.0.2, default-value=false  # This parameter enables or disables operation of self diagnostic test supported for ECM(Error Control Module) in order to test the ERROROUTZ signal. ECM Self-diagnostic tests shall be performed during initialization phase in the module specific initialization function. | true: Enables operation of self diagnostic test supported for ECM. false: Disables operation of self diagnostic test supported for ECM.
      boolean McuLockStepSelfDiagnosticTest: set at pre-compile, origin=Renesas_v1.0.2, default-value=false  # This parameter enables or disables the operation of self diagnostic test for PE lockstep mode. | true: Enables the Compare Unit Self-diagnostic test during initialisation phase. false: Disables the Compare Unit Self-diagnostic test during initialisation phase.
    container McuModuleConfiguration: multiple-configuration-container=true  # This container contains the configuration (parameters) of the MCU driver.
      enumeration McuClockSrcFailureNotification: {DISABLED, ENABLED}, set at post-build, default-value=DISABLED  # This parameter enables or disables clock failure notification. In case this feature is not supported by HW the setting should be disabled. This parameter is not used for implementation.
      integer McuNumberOfMcuModes: 1..255, set at pre-compile, default-value=1  # This parameter shall represent the number of Modes available for the MCU. This parameter is not used for implementation. | calculation Formula = Number of configured McuModeSettingConf
      integer McuRamSectors: 1..4294967295, set at post-build, default-value=1  # This parameter shall represent the number of RAM sectors available for the MCU. This parameter is not used for implementation. | calculation Formula = Number of configured McuRamSectorSettingConf
      integer McuResetSetting [0..1]: 1..255, set at pre-compile, default-value=1  # This parameter relates to the MCU specific reset configuration. This applies to the function Mcu_PerformReset, which performs a microcontroller reset using the hardware feature of the microcontroller. This parameter is not used for implementation.
      boolean McuCvmOutMaskFbist: set at post-build, origin=Renesas_v1.0.0, default-value=false  # This parameter enables or disables the CVMOUT Output Mask for FBIST Operation. | true: disables the CVMOUT Output Mask for FBIST Operation. false: enables the CVMOUT Output Mask for FBIST Operation.
      boolean McuCvmOutMaskDiag: set at post-build, origin=Renesas_v1.0.0, default-value=false  # This parameter enables or disables the CVMOUT Output Mask for DIAG Operation. | true: disables the CVMOUT Output Mask for DIAG Operation. false: enables the CVMOUT Output Mask for DIAG Operation.
      boolean McuCvmOutputFilter: set at post-build, origin=Renesas_v1.0.0, default-value=false  # This parameter enables or disables the CVMOUT Output Filter Control. | true: disables the 1 micro output filter of CVMOUT. false: enables the 1 micro output filter of CVMOUT.
      boolean McuCvmDiagLockBit: set at post-build, origin=Renesas_v1.0.2, default-value=true  # This parameter lock or unlock the CVM Diagnosis during normal operation. | true: lock the CVM Diagnosis during normal operation. false: unlock the CVM Diagnosis during normal operation. This needs to be set true when using ASIL applications.
      boolean McuCvmResetEnable: set at post-build, origin=Renesas_v1.0.2, default-value=false  # This parameter enables or disables a reset of core voltage operation area upon detection of abnormal voltage in the core power supply. The Core Voltage Monitor registers can be set only once after a power-on reset. Therefore, care should be taken while configuring this parameter for multiple configurations. | true: enables a reset of core voltage operation. false: disables a reset of core voltage operation.
      enumeration McuSwResetTrigger: {SW_SYSTEM_RESET, SW_APPLICATION_RESET, NO_RESET}, set at post-build, origin=VENDOR_ECUC, default-value=NO_RESET  # This parameter will decide the type of software reset. | SW_SYSTEM_RESET: Mcu_PerformReset Api will Perform System Reset. SW_APPLICATION_RESET: Mcu_PerformReset Api will Perform Application Reset. NO_RESET: Mcu_PerformReset Api will not Perform any Reset.
      container McuClockSettingConfig [1..255]: multiple-configuration-container=true  # This container contains the configuration (parameters) for the Clock settings of the MCU. Please see MCU031 for more information on the MCU clock settings.
        integer McuClockSettingId: 0..255, set at pre-compile, symbolic-name-value=true, default-value=0  # The Id of this McuClockSettingConfig to be used as argument for the API call "Mcu_InitClock".It should be unique and consecutive over multiple clocksetting configurations..
        enumeration McuMainOsciFrequency: {FREQ_16000000, FREQ_20000000, FREQ_24000000}, set at pre-compile, origin=Renesas_v1.0.0, default-value=FREQ_16000000  # This parameter is to select the main oscillator frequency in Hz.
        integer McuCpuMainSysClk: 120000000..240000000, set at post-build, origin=Renesas_v1.0.0, default-value=240000000  # This parameter contains the CPU main system clock frequency. This parameter does not affect the behavior of the MCU driver. It is a frequency that will be available to other modules for reference. It either needs to be calculated manually or by the configuration editor.
        enumeration McuUnitName: {CLK_CPUM}, set at post-build, origin=Renesas_v1.0.0, default-value=CLK_CPUM  # This parameter contains the functional unit name for the CPU. | CLK_CPUM: CLK_CPUM is unit name.
        container McuInternalOscillatorClk  # This container contains the parameters related to Internal Oscillator Clock.
          integer McuPeripheralClock: 16000000..16000000, set at post-build, origin=Renesas_v1.0.0, default-value=16000000  # This parameter contains the Internal Oscillator Clock value.
        container McuExternalClkOutSetting  # This container contains the parameters related to External clock output Setting.
          enumeration McuExternalClk0SourceSel: {MCU_MAIN_OSCILLATOR, MCU_CLK_LSB, MCU_CLK_CPU, MCU_BACKUP_CLOCK}, set at post-build, origin=Renesas_v1.0.0, default-value=MCU_BACKUP_CLOCK  # This parameter is to select the external clock 0 source. | MCU_MAIN_OSCILLATOR: 16 to 24 MHz MainOSC. MCU_CLK_LSB (Low Speed System Clock): 30 to 40 MHz MCU_CLK_CPU: 120 to 240 MHz clock. MCU_BACKUP_CLOCK: 8 MHz.
          integer McuExternalClk0DividerSel: 1..1023, set at post-build, origin=Renesas_v1.0.0, default-value=1  # This parameter is to select the divider for external clock 0 source.
          integer McuExternalClock0: 250000..20000000, set at post-build, origin=Renesas_v1.0.0, default-value=4000000  # This parameter contains the output of External Clock 0 value.
          enumeration McuExternalClk1SourceSel: {MCU_MAIN_OSCILLATOR, MCU_CLK_LSB, MCU_CLK_CPU, MCU_BACKUP_CLOCK}, set at post-build, origin=Renesas_v1.0.0, default-value=MCU_BACKUP_CLOCK  # This parameter is to select the external clock 1 source. | MCU_MAIN_OSCILLATOR: 16 to 24 MHz MainOSC. MCU_CLK_LSB: Low Speed System Clock. If MCU_CLK_CPU is 240 MHz or 160 MHz, MCU_CLK_LSB is 40 MHz. If MCU_CLK_CPU is 120 MHz, MCU_CLK_LSB is 30 MHz MCU_CLK_CPU: 120 to 240 MHz clock. MCU_BACKUP_CLOCK: Internal oscillator clock * 1/2.
          integer McuExternalClk1DividerSel: 1..1023, set at post-build, origin=Renesas_v1.0.0, default-value=1  # This parameter is to select the divider for external clock 1 source.
          integer McuExternalClock1: 250000..20000000, set at post-build, origin=Renesas_v1.0.0, default-value=4000000  # This parameter contains the output of External Clock 1 value.
        container McuPLLClkSetting  # This container contains the parameters related to PLL clock Setting.
          enumeration McuSystemSourceSel: {MCU_PLL, MCU_INTERNAL_OSCILLATOR}, set at post-build, origin=Renesas_v1.0.0, default-value=MCU_PLL  # This parameter is to select the System Clock source 0. | MCU_PLL: 320 to 480 MHz Clock. MCU_INTERNAL_OSCILLATOR: 16 MHz IntOSC.
          integer McuPLLClk0DividerSel: 1..7, set at post-build, origin=Renesas_v1.0.0, default-value=1  # This parameter is to select the divider for PLL source.
          integer McuPLLClock0: 320000000..480000000, set at post-build, origin=Renesas_v1.0.0, default-value=480000000  # This parameter contains the PLL Clock value.
          integer McuPLLClk1DividerSel: 1..7, set at post-build, origin=Renesas_v1.0.0, default-value=1  # This parameter is to select the divider for PLL source.
          integer McuOPBT1Sel: 0..4294967295, set at post-build, origin=Renesas_v1.0.1, default-value=3221211608  # This parameter contains the value that is to be written in OPBT1.
        container McuSAWdtCounterClk  # This container contains the parameters related to Secure Application Wdta counter Clock.
          enumeration McuSAWdtCounterDivider: {DIVBY_ID_8, DIVBY_ID_9}, set at post-build, origin=Renesas_v1.0.0, default-value=DIVBY_ID_8  # This parameter contains the divider for the Secure Application WDTA counter clock. | DIVBY_ID_8: Secure Application WdtacounterClk/80000 (or) WdtacounterClk/250 is selected as clock divider.Provided SAWDTMD=0/1. DIVBY_ID_9: Secure Application WdtacounterClk/80000 (or) WdtacounterClk/250 is selected as clock divider.Provided SAWDTMD=1/0.
          enumeration McuUnitName: {WDTCLKI}, set at post-build, origin=Renesas_v1.0.0, default-value=WDTCLKI  # This parameter contains the functional unit name for the Secure Application Wdta counter Clock. | WDTCLKI: CLK_SAWDT is unit name.
          integer McuPeripheralClock: 2000..640000, set at post-build, origin=Renesas_v1.0.0, default-value=2000  # This parameter contains the Wdta counter Clock.
        container McuWdtaCounterClk [0..1]  # This container contains the parameters related to Wdta counter Clock.
          enumeration McuWdtCounterDivider: {DIVBY_1_ID_1, DIVBY_32_ID_1}, set at post-build, origin=Renesas_v1.0.0, default-value=DIVBY_1_ID_1  # This parameter contains the divider for the WDTA counter clock. | DIVBY_1_ID_1: WdtacounterClk/1 is selected as clock divider. DIVBY_32_ID_1: WdtacounterClk/32 is selected as clock divider.
          enumeration McuUnitName: {CLK_WDTA}, set at post-build, origin=Renesas_v1.0.0, default-value=CLK_WDTA  # This parameter contains the functional unit name for the Wdta counter Clock. | WDTCLKI: WDTCLKI is unit name.
          integer McuPeripheralClock: 250000..8000000, set at post-build, origin=Renesas_v1.0.0, default-value=8000000  # This parameter contains the Wdta counter Clock.
        container McuClockReferencePoint [1..*]  # This container defines a reference point in the Mcu Clock tree. It defines the frequency which can be used by other modules as an input value. Lower multiplicity is 1, as even in the simplest case (only one frequency is used), there is one frequency to be defined. This container is not used for implementation.
          float McuClockReferencePointFrequency: 0..4294967295, set at post-build, default-value=0  # This is the frequency for the specific instance of the McuClockReferencePoint container. It shall be given in Hz. This parameter is not used for implementation. So if its used for reference frequency then user has to take care for configuration of valid clock domain associated with it.
      container McuGTMClockSettingsConfig  # This container contains the configuration (parameters) for the CMU Clock settings of the GTM.
        integer McuGTMCMUGCLKNumerator: 1..16777215, set at pre-compile, origin=Renesas_v1.0.1, default-value=1  # This parameter holds the Numerator for the CMU Global Clock Divider.
        integer McuGTMCMUGCLKDenominator: 1..16777215, set at pre-compile, origin=Renesas_v1.0.1, default-value=1  # This parameter holds the Denominator for the CMU Global Clock Divider.
        container McuGTMClockSettings [1..8]  # This container contains the configuration (parameters) for the CMU Clock settings.
          enumeration McuGTMClockSelection: {CMU_CLK0, CMU_CLK1, CMU_CLK2, CMU_CLK3, CMU_CLK4, CMU_CLK5, CMU_CLK6, CMU_CLK7}, set at pre-compile, origin=Renesas_v1.0.1, default-value=CMU_CLK0  # This parameter used to configure the CMU clocks. | CMU_CLK0: CMU clock 0. CMU_CLK1: CMU clock 1. CMU_CLK2: CMU clock 2. CMU_CLK3: CMU clock 3. CMU_CLK4: CMU clock 4. CMU_CLK5: CMU clock 5. CMU_CLK6: CMU clock 6. CMU_CLK7: CMU clock 7.
          integer McuGTMChannelClkSrcDivider: 1..16777215, set at pre-compile, origin=Renesas_v1.0.1, default-value=1  # This parameter holds the Channel Clock Source Divider.
      container McuEcmErrorSourcesCfg  # This container contains the configuration related to all the error sources which are input to ECM.
        container McuEcmErrorSource0  # This container contains all the supported configuration parameters of the related error source from WDTA module.
          boolean McuEcmErrorMaskableInterrupt: set at post-build, origin=Renesas_v1.0.0, default-value=false  # This parameter enables or disables generation of a maskable interrupt when the error occurs from WDTA module. | true: enables generation of a maskable interrupt when the error occurs from WDTA module. false: disables generation of a maskable interrupt when the error occurs from WDTA module.
          boolean McuEcmErrorNonMaskableInterrupt: set at post-build, origin=Renesas_v1.0.0, default-value=false  # This parameter enables or disables generation of a non-maskable interrupt when the error occurs from WDTA module. | true: enables generation of a non-maskable interrupt when the error occurs from WDTA module. false: disables generation of a non-maskable interrupt when the error occurs from WDTA module.
          boolean McuEcmErrorInternalReset: set at post-build, origin=Renesas_v1.0.0, default-value=false  # This parameter enables or disables generation of an internal reset when the error occurs from WDTA module. | true: enables generation of an internal reset when the error occurs from WDTA module. false: disables generation of an internal reset when the error occurs from WDTA module.
          boolean McuEcmErrorNMIDelayTimer: set at post-build, origin=Renesas_v1.0.0, default-value=false  # This parameter enables or disables delay timer start caused by non-maskable interrupts in response to errors from WDTA module. | true: enables delay timer start caused by non-maskable interrupts in response to errors from WDTA module. false: disables delay timer start caused by non-maskable interrupts in response to errors from WDTA module.
          boolean McuEcmErrorMIDelayTimer: set at post-build, origin=Renesas_v1.0.0, default-value=false  # This parameter enables or disables delay timer start caused by maskable interrupts in response to errors from WDTA module. | true: enables delay timer start caused by maskable interrupts in response to errors from WDTA module. false: disables delay timer start caused by maskable interrupts in response to errors from WDTA module.
          boolean McuEcmErrorOutputMask: set at post-build, origin=Renesas_v1.0.0, default-value=true  # This parameter mask or unmask the individual error sources of the error pin output from WDTA module. | true: mask the individual error sources of the error pin output from WDTA module. false: unmask the individual error sources of the error pin output from WDTA module.
          function name McuMiNotification [0..1]: set at post-build, origin=Renesas_v1.0.0, default-value=NULL_PTR, regular-expression=[a-zA-Z][a-zA-Z0-9_]*  # This parameter contains notification function for MI notification. | The syntax for McuMiNotification should be provided as Mcu_EcmMINotification.
          function name McuNmiNotification [0..1]: set at post-build, origin=Renesas_v1.0.0, default-value=NULL_PTR, regular-expression=[a-zA-Z][a-zA-Z0-9_]*  # This parameter contains notification function for NMI notification. | The syntax for McuNmiNotification should be provided as Mcu_EcmNMINotification.
          function name McuEcmInitialNotification [0..1]: set at post-build, origin=Renesas_v1.0.2, default-value=NULL_PTR, regular-expression=[a-zA-Z][a-zA-Z0-9_]*  # This parameter is used for notify the upper layer, if any ECM error has been already detected at system start-up. | The syntax for McuEcmInitialNotification should be provided as Mcu_EcmInitialNotification.
        container McuEcmErrorSource1  # This container contains all the supported configuration parameters of the related error source from Lock step compare module.
          boolean McuEcmErrorMaskableInterrupt: set at post-build, origin=Renesas_v1.0.0, default-value=false  # This parameter enables or disables generation of a maskable interrupt when the error occurs from Lock step compare module. | true: enables generation of a maskable interrupt when the error occurs from Lock step compare module. false: disables generation of a maskable interrupt when the error occurs from Lock step compare module.
          boolean McuEcmErrorNonMaskableInterrupt: set at post-build, origin=Renesas_v1.0.0, default-value=false  # This parameter enables or disables generation of a non-maskable interrupt when the error occurs from Lock step compare module. | true: enables generation of a non-maskable interrupt when the error occurs from Lock step compare module. false: disables generation of a non-maskable interrupt when the error occurs from Lock step compare module.
          boolean McuEcmErrorInternalReset: set at post-build, origin=Renesas_v1.0.0, default-value=false  # This parameter enables or disables generation of an internal reset when the error occurs from Lock step compare module. | true: enables generation of an internal reset when the error occurs from Lock step compare module. false: disables generation of an internal reset when the error occurs from Lock step compare module.
          boolean McuEcmErrorNMIDelayTimer: set at post-build, origin=Renesas_v1.0.0, default-value=false  # This parameter enables or disables delay timer start caused by non-maskable interrupts in response to errors from Lock step compare module. | true: enables delay timer start caused by non-maskable interrupts in response to errors from Lock step compare module. false: disables delay timer start caused by non-maskable interrupts in response to errors from Lock step compare module.
          boolean McuEcmErrorMIDelayTimer: set at post-build, origin=Renesas_v1.0.0, default-value=false  # This parameter enables or disables delay timer start caused by maskable interrupts in response to errors from Lock step compare module. | true: enables delay timer start caused by maskable interrupts in response to errors from Lock step compare module. false: disables delay timer start caused by maskable interrupts in response to errors from Lock step compare module.
          boolean McuEcmErrorOutputMask: set at post-build, origin=Renesas_v1.0.0, default-value=true  # This parameter mask or unmask the individual error sources of the error pin output from Lock step compare module. | true: mask the individual error sources of the error pin output from Lock step compare module. false: unmask the individual error sources of the error pin output from Lock step compare module.
          function name McuMiNotification [0..1]: set at post-build, origin=Renesas_v1.0.0, default-value=NULL_PTR, regular-expression=[a-zA-Z][a-zA-Z0-9_]*  # This parameter contains notification function for MI notification. | The syntax for McuMiNotification should be provided as Mcu_EcmMINotification.
          function name McuNmiNotification [0..1]: set at post-build, origin=Renesas_v1.0.0, default-value=NULL_PTR, regular-expression=[a-zA-Z][a-zA-Z0-9_]*  # This parameter contains notification function for NMI notification. | The syntax for McuNmiNotification should be provided as Mcu_EcmNMINotification.
          function name McuEcmInitialNotification [0..1]: set at post-build, origin=Renesas_v1.0.2, default-value=NULL_PTR, regular-expression=[a-zA-Z][a-zA-Z0-9_]*  # This parameter is used for notify the upper layer, if any ECM error has been already detected at system start-up. | The syntax for McuEcmInitialNotification should be provided as Mcu_EcmInitialNotification.
        container McuEcmErrorSource2  # This container contains all the supported configuration parameters of the related error source from P-bus FS Guard slave (PFSS).
          boolean McuEcmErrorMaskableInterrupt: set at post-build, origin=Renesas_v1.0.0, default-value=false  # This parameter enables or disables generation of a maskable interrupt when the error occurs from P-bus FS Guard slave (PFSS). | true: enables generation of a maskable interrupt when the error occurs from P-bus FS Guard slave (PFSS). false: disables generation of a maskable interrupt when the error occurs from P-bus FS Guard slave (PFSS).
          boolean McuEcmErrorNonMaskableInterrupt: set at post-build, origin=Renesas_v1.0.0, default-value=false  # This parameter enables or disables generation of a non-maskable interrupt when the error occurs from P-bus FS Guard slave (PFSS). | true: enables generation of a non-maskable interrupt when the error occurs from P-bus FS Guard slave (PFSS). false: disables generation of a non-maskable interrupt when the error occurs from P-bus FS Guard slave (PFSS).
          boolean McuEcmErrorInternalReset: set at post-build, origin=Renesas_v1.0.0, default-value=false  # This parameter enables or disables generation of an internal reset when the error occurs from P-bus FS Guard slave (PFSS). | true: enables generation of an internal reset when the error occurs from P-bus FS Guard slave (PFSS). false: disables generation of an internal reset when the error occurs from P-bus FS Guard slave (PFSS).
          boolean McuEcmErrorNMIDelayTimer: set at post-build, origin=Renesas_v1.0.0, default-value=false  # This parameter enables or disables delay timer start caused by non-maskable interrupts in response to errors from P-bus FS Guard slave (PFSS). | true: enables delay timer start caused by non-maskable interrupts in response to errors from P-bus FS Guard slave (PFSS). false: disables delay timer start caused by non-maskable interrupts in response to errors from P-bus FS Guard slave (PFSS).
          boolean McuEcmErrorMIDelayTimer: set at post-build, origin=Renesas_v1.0.0, default-value=false  # This parameter enables or disables delay timer start caused by maskable interrupts in response to errors from P-bus FS Guard slave (PFSS). | true: enables delay timer start caused by maskable interrupts in response to errors P-bus FS Guard slave (PFSS). false: disables delay timer start caused by maskable interrupts in response to errors from P-bus FS Guard slave (PFSS).
          boolean McuEcmErrorOutputMask: set at post-build, origin=Renesas_v1.0.0, default-value=true  # This parameter mask or unmask the individual error sources of the error pin output from P-bus FS Guard slave (PFSS). | true: mask the individual error sources of the error pin output from P-bus FS Guard slave (PFSS). false: unmask the individual error sources of the error pin output from P-bus FS Guard slave (PFSS).
          function name McuMiNotification [0..1]: set at post-build, origin=Renesas_v1.0.0, default-value=NULL_PTR, regular-expression=[a-zA-Z][a-zA-Z0-9_]*  # This parameter contains notification function for MI notification. | The syntax for McuMiNotification should be provided as Mcu_EcmMINotification.
          function name McuNmiNotification [0..1]: set at post-build, origin=Renesas_v1.0.0, default-value=NULL_PTR, regular-expression=[a-zA-Z][a-zA-Z0-9_]*  # This parameter contains notification function for NMI notification. | The syntax for McuNmiNotification should be provided as Mcu_EcmNMINotification.
          function name McuEcmInitialNotification [0..1]: set at post-build, origin=Renesas_v1.0.2, default-value=NULL_PTR, regular-expression=[a-zA-Z][a-zA-Z0-9_]*  # This parameter is used for notify the upper layer, if any ECM error has been already detected at system start-up. | The syntax for McuEcmInitialNotification should be provided as Mcu_EcmInitialNotification.
        container McuEcmErrorSource3  # This container contains all the supported configuration parameters of the related error source from Bus bridge.
          boolean McuEcmErrorMaskableInterrupt: set at post-build, origin=Renesas_v1.0.0, default-value=false  # This parameter enables or disables generation of a maskable interrupt when the error occurs due to Bus bridge. | true: enables generation of a maskable interrupt when the error occurs due to Bus bridge. false: disables generation of a maskable interrupt when the error occurs due to Bus bridge.
          boolean McuEcmErrorNonMaskableInterrupt: set at post-build, origin=Renesas_v1.0.0, default-value=false  # This parameter enables or disables generation of a non-maskable interrupt when the error occurs due to Bus bridge. | true: enables generation of a non-maskable interrupt when the error occurs due to Bus bridge. false: disables generation of a non-maskable interrupt when the error occurs due to Bus bridge.
          boolean McuEcmErrorInternalReset: set at post-build, origin=Renesas_v1.0.0, default-value=false  # This parameter enables or disables generation of an internal reset when the error occurs due to Bus bridge. | true: enables generation of an internal reset when the error occurs due to Bus bridge. false: disables generation of an internal reset when the error occurs due to Bus bridge.
          boolean McuEcmErrorNMIDelayTimer: set at post-build, origin=Renesas_v1.0.0, default-value=false  # This parameter enables or disables delay timer start caused by non-maskable interrupts in response to error occurred due to bus bridge. | true: enables delay timer start caused by non-maskable interrupts in response to error occurred due to bus bridge. false: disables delay timer start caused by non-maskable interrupts in response to error occurred due to bus bridge.
          boolean McuEcmErrorMIDelayTimer: set at post-build, origin=Renesas_v1.0.0, default-value=false  # This parameter enables or disables delay timer start caused by maskable interrupts in response to errors from Bus Bridge. | true: enables delay timer start caused by maskable interrupts in response to error occurred due to bus bridge. false: disables delay timer start caused by maskable interrupts in response to error occurred due to bus bridge.
          boolean McuEcmErrorOutputMask: set at post-build, origin=Renesas_v1.0.0, default-value=true  # This parameter mask or unmask the individual error sources of the error pin output from Bus Bridge. | true: mask the individual error sources of the error pin output from Bus Bridge. false: unmask the individual error sources of the error pin output from Bus Bridge.
          function name McuMiNotification [0..1]: set at post-build, origin=Renesas_v1.0.0, default-value=NULL_PTR, regular-expression=[a-zA-Z][a-zA-Z0-9_]*  # This parameter contains notification function for MI notification. | The syntax for McuMiNotification should be provided as Mcu_EcmMINotification.
          function name McuNmiNotification [0..1]: set at post-build, origin=Renesas_v1.0.0, default-value=NULL_PTR, regular-expression=[a-zA-Z][a-zA-Z0-9_]*  # This parameter contains notification function for NMI notification. | The syntax for McuNmiNotification should be provided as Mcu_EcmNMINotification.
          function name McuEcmInitialNotification [0..1]: set at post-build, origin=Renesas_v1.0.2, default-value=NULL_PTR, regular-expression=[a-zA-Z][a-zA-Z0-9_]*  # This parameter is used for notify the upper layer, if any ECM error has been already detected at system start-up. | The syntax for McuEcmInitialNotification should be provided as Mcu_EcmInitialNotification.
        container McuEcmErrorSource4  # This container contains all the supported configuration parameters of the related error source from Safety Mechanism with Redundancy.
          boolean McuEcmErrorMaskableInterrupt: set at post-build, origin=Renesas_v1.0.0, default-value=false  # This parameter enables or disables generation of a maskable interrupt when the error occurs from Safety Mechanism with Redundancy. | true: enables generation of a maskable interrupt when the error occurs from Safety Mechanism with Redundancy. false: disables generation of a maskable interrupt when the error occurs from Safety Mechanism with Redundancy.
          boolean McuEcmErrorNonMaskableInterrupt: set at post-build, origin=Renesas_v1.0.0, default-value=false  # This parameter enables or disables generation of a non-maskable interrupt when the error occurs from Safety Mechanism with Redundancy. | true: enables generation of a non-maskable interrupt when the error occurs from Safety Mechanism with Redundancy. false: disables generation of a non-maskable interrupt when the error occurs from Safety Mechanism with Redundancy.
          boolean McuEcmErrorInternalReset: set at post-build, origin=Renesas_v1.0.0, default-value=false  # This parameter enables or disables generation of an internal reset when the error occurs from Safety Mechanism with Redundancy. | true: enables generation of an internal reset when the error occurs from Safety Mechanism with Redundancy. false: disables generation of an internal reset when the error occurs from Safety Mechanism with Redundancy.
          boolean McuEcmErrorNMIDelayTimer: set at post-build, origin=Renesas_v1.0.0, default-value=false  # This parameter enables or disables delay timer start caused by non-maskable interrupts in response to errors from Safety Mechanism with Redundancy. | true: enables delay timer start caused by non-maskable interrupts in response to errors from Safety Mechanism with Redundancy. false: disables delay timer start caused by non-maskable interrupts in response to errors from Safety Mechanism with Redundancy.
          boolean McuEcmErrorMIDelayTimer: set at post-build, origin=Renesas_v1.0.0, default-value=false  # This parameter enables or disables delay timer start caused by maskable interrupts in response to errors from Safety Mechanism with Redundancy. | true: enables delay timer start caused by maskable interrupts in response to errors from Safety Mechanism with Redundancy. false: disables delay timer start caused by maskable interrupts in response to errors from Safety Mechanism with Redundancy.
          boolean McuEcmErrorOutputMask: set at post-build, origin=Renesas_v1.0.0, default-value=true  # This parameter mask or unmask the individual error sources of the error pin output from Safety Mechanism with Redundancy. | true: mask the individual error sources of the error pin output from Safety Mechanism with Redundancy. false: unmask the individual error sources of the error pin output from Safety Mechanism with Redundancy.
          function name McuMiNotification [0..1]: set at post-build, origin=Renesas_v1.0.0, default-value=NULL_PTR, regular-expression=[a-zA-Z][a-zA-Z0-9_]*  # This parameter contains notification function for MI notification. | The syntax for McuMiNotification should be provided as Mcu_EcmMINotification.
          function name McuNmiNotification [0..1]: set at post-build, origin=Renesas_v1.0.0, default-value=NULL_PTR, regular-expression=[a-zA-Z][a-zA-Z0-9_]*  # This parameter contains notification function for NMI notification. | The syntax for McuNmiNotification should be provided as Mcu_EcmNMINotification.
          function name McuEcmInitialNotification [0..1]: set at post-build, origin=Renesas_v1.0.2, default-value=NULL_PTR, regular-expression=[a-zA-Z][a-zA-Z0-9_]*  # This parameter is used for notify the upper layer, if any ECM error has been already detected at system start-up. | The syntax for McuEcmInitialNotification should be provided as Mcu_EcmInitialNotification.
        container McuEcmErrorSource6  # This container contains all the supported configuration parameters of the related error source from Temperature sensor.
          boolean McuEcmErrorMaskableInterrupt: set at post-build, origin=Renesas_v1.0.0, default-value=false  # This parameter enables or disables generation of a maskable interrupt when the error occurs from Temperature sensor. | true: enables generation of a maskable interrupt when the error occurs from Temperature sensor. false: disables generation of a maskable interrupt when the error occurs from Temperature sensor.
          boolean McuEcmErrorNonMaskableInterrupt: set at post-build, origin=Renesas_v1.0.0, default-value=false  # This parameter enables or disables generation of a non-maskable interrupt when the error occurs from Temperature sensor. | true: enables generation of a non-maskable interrupt when the error occurs from Temperature sensor. false: disables generation of a non-maskable interrupt when the error occurs from Temperature sensor.
          boolean McuEcmErrorInternalReset: set at post-build, origin=Renesas_v1.0.0, default-value=false  # This parameter enables or disables generation of an internal reset when the error occurs from Temperature sensor. | true: enables generation of an internal reset when the error occurs from Temperature sensor. false: disables generation of an internal reset when the error occurs from Temperature sensor.
          boolean McuEcmErrorNMIDelayTimer: set at post-build, origin=Renesas_v1.0.0, default-value=false  # This parameter enables or disables delay timer start caused by non-maskable interrupts in response to errors from Temperature sensor. | true: enables delay timer start caused by non-maskable interrupts in response to errors from Temperature sensor. false: disables delay timer start caused by non-maskable interrupts in response to errors from Temperature sensor.
          boolean McuEcmErrorMIDelayTimer: set at post-build, origin=Renesas_v1.0.0, default-value=false  # This parameter enables or disables delay timer start caused by maskable interrupts in response to errors from Temperature sensor. | true: enables delay timer start caused by maskable interrupts in response to errors from Temperature sensor. false: disables delay timer start caused by maskable interrupts in response to errors from Temperature sensor.
          boolean McuEcmErrorOutputMask: set at post-build, origin=Renesas_v1.0.0, default-value=true  # This parameter mask or unmask the individual error sources of the error pin output from Temperature sensor. | true: mask the individual error sources of the error pin output from Temperature sensor. false: unmask the individual error sources of the error pin output from Temperature sensor.
          function name McuMiNotification [0..1]: set at post-build, origin=Renesas_v1.0.0, default-value=NULL_PTR, regular-expression=[a-zA-Z][a-zA-Z0-9_]*  # This parameter contains notification function for MI notification. | The syntax for McuMiNotification should be provided as Mcu_EcmMINotification.
          function name McuNmiNotification [0..1]: set at post-build, origin=Renesas_v1.0.0, default-value=NULL_PTR, regular-expression=[a-zA-Z][a-zA-Z0-9_]*  # This parameter contains notification function for NMI notification. | The syntax for McuNmiNotification should be provided as Mcu_EcmNMINotification.
          function name McuEcmInitialNotification [0..1]: set at post-build, origin=Renesas_v1.0.2, default-value=NULL_PTR, regular-expression=[a-zA-Z][a-zA-Z0-9_]*  # This parameter is used for notify the upper layer, if any ECM error has been already detected at system start-up. | The syntax for McuEcmInitialNotification should be provided as Mcu_EcmInitialNotification.
        container McuEcmErrorSource8  # This container contains all the supported configuration parameters of the related error source from Clock monitor for Main Osc(CLMA0).
          boolean McuEcmErrorMaskableInterrupt: set at post-build, origin=Renesas_v1.0.0, default-value=false  # This parameter enables or disables generation of a maskable interrupt when the error occurs from Clock monitor for Main Osc(CLMA0). | true: enables generation of a maskable interrupt when the error occurs from Clock monitor for Main Osc(CLMA0). false: disables generation of a maskable interrupt when the error occurs from Clock monitor for Main Osc(CLMA0).
          boolean McuEcmErrorNonMaskableInterrupt: set at post-build, origin=Renesas_v1.0.0, default-value=false  # This parameter enables or disables generation of a non-maskable interrupt when the error occurs from Clock monitor for Main Osc(CLMA0). | true: enables generation of a non-maskable interrupt when the error occurs from Clock monitor for Main Osc(CLMA0). false: disables generation of a non-maskable interrupt when the error occurs from Clock monitor for Main Osc(CLMA0).
          boolean McuEcmErrorInternalReset: set at post-build, origin=Renesas_v1.0.0, default-value=false  # This parameter enables or disables generation of an internal reset when the error occurs from Clock monitor for Main Osc(CLMA0). | true: enables generation of an internal reset when the error occurs from Clock monitor for Main Osc(CLMA0). false: disables generation of an internal reset when the error occurs from Clock monitor for Main Osc(CLMA0).
          boolean McuEcmErrorNMIDelayTimer: set at post-build, origin=Renesas_v1.0.0, default-value=false  # This parameter enables or disables delay timer start caused by non-maskable interrupts in response to errors from Clock monitor for Main Osc(CLMA0). | true: enables delay timer start caused by non-maskable interrupts in response to errors from Clock monitor for Main Osc(CLMA0). false: disables delay timer start caused by non-maskable interrupts in response to errors from Clock monitor for Main Osc(CLMA0).
          boolean McuEcmErrorMIDelayTimer: set at post-build, origin=Renesas_v1.0.0, default-value=false  # This parameter enables or disables delay timer start caused by maskable interrupts in response to errors from Clock monitor for Main Osc(CLMA0). | true: enables delay timer start caused by maskable interrupts in response to errors from Clock monitor for Main Osc(CLMA0). false: disables delay timer start caused by maskable interrupts in response to errors from Clock monitor for Main Osc(CLMA0).
          boolean McuEcmErrorOutputMask: set at post-build, origin=Renesas_v1.0.0, default-value=true  # This parameter mask or unmask the individual error sources of the error pin output from Clock monitor for Main Osc(CLMA0). | true: mask the individual error sources of the error pin output from Clock monitor for Main Osc(CLMA0). false: unmask the individual error sources of the error pin output from Clock monitor for Main Osc(CLMA0).
          function name McuMiNotification [0..1]: set at post-build, origin=Renesas_v1.0.0, default-value=NULL_PTR, regular-expression=[a-zA-Z][a-zA-Z0-9_]*  # This parameter contains notification function for MI notification. | The syntax for McuMiNotification should be provided as Mcu_EcmMINotification.
          function name McuNmiNotification [0..1]: set at post-build, origin=Renesas_v1.0.0, default-value=NULL_PTR, regular-expression=[a-zA-Z][a-zA-Z0-9_]*  # This parameter contains notification function for NMI notification. | The syntax for McuNmiNotification should be provided as Mcu_EcmNMINotification.
          function name McuEcmInitialNotification [0..1]: set at post-build, origin=Renesas_v1.0.2, default-value=NULL_PTR, regular-expression=[a-zA-Z][a-zA-Z0-9_]*  # This parameter is used for notify the upper layer, if any ECM error has been already detected at system start-up. | The syntax for McuEcmInitialNotification should be provided as Mcu_EcmInitialNotification.
        container McuEcmErrorSource9  # This container contains all the supported configuration parameters of the related error source from Clock monitor for WDT count clock(CLMA2).
          boolean McuEcmErrorMaskableInterrupt: set at post-build, origin=Renesas_v1.0.0, default-value=false  # This parameter enables or disables generation of a maskable interrupt when the error occurs from Clock monitor for WDT count clock(CLMA2). | true: enables generation of a maskable interrupt when the error occurs from Clock monitor for WDT count clock(CLMA2). false: disables generation of a maskable interrupt when the error occurs from Clock monitor for WDT count clock(CLMA2).
          boolean McuEcmErrorNonMaskableInterrupt: set at post-build, origin=Renesas_v1.0.0, default-value=false  # This parameter enables or disables generation of a non-maskable interrupt when the error occurs from Clock monitor for WDT count clock(CLMA2). | true: enables generation of a non-maskable interrupt when the error occurs from Clock monitor for WDT count clock(CLMA2). false: disables generation of a non-maskable interrupt when the error occurs from Clock monitor for WDT count clock(CLMA2).
          boolean McuEcmErrorInternalReset: set at post-build, origin=Renesas_v1.0.0, default-value=false  # This parameter enables or disables generation of an internal reset when the error occurs from Clock monitor for WDT count clock(CLMA2). | true: enables generation of an internal reset when the error occurs from Clock monitor for WDT count clock(CLMA2). false: disables generation of an internal reset when the error occurs from Clock monitor for WDT count clock(CLMA2).
          boolean McuEcmErrorNMIDelayTimer: set at post-build, origin=Renesas_v1.0.0, default-value=false  # This parameter enables or disables delay timer start caused by non-maskable interrupts in response to errors from Clock monitor for WDT count clock(CLMA2). | true: enables delay timer start caused by non-maskable interrupts in response to errors from Clock monitor for WDT count clock(CLMA2). false: disables delay timer start caused by non-maskable interrupts in response to errors from Clock monitor for WDT count clock(CLMA2).
          boolean McuEcmErrorMIDelayTimer: set at post-build, origin=Renesas_v1.0.0, default-value=false  # This parameter enables or disables delay timer start caused by maskable interrupts in response to errors from Clock monitor for WDT count clock(CLMA2). | true: enables delay timer start caused by maskable interrupts in response to errors from Clock monitor for WDT count clock(CLMA2). false: disables delay timer start caused by maskable interrupts in response to errors from Clock monitor for WDT count clock(CLMA2).
          boolean McuEcmErrorOutputMask: set at post-build, origin=Renesas_v1.0.0, default-value=true  # This parameter mask or unmask the individual error sources of the error pin output from Clock monitor for WDT count clock(CLMA2). | true: mask the individual error sources of the error pin output from Clock monitor for WDT count clock(CLMA2). false: unmask the individual error sources of the error pin output from Clock monitor for WDT count clock(CLMA2).
          function name McuMiNotification [0..1]: set at post-build, origin=Renesas_v1.0.0, default-value=NULL_PTR, regular-expression=[a-zA-Z][a-zA-Z0-9_]*  # This parameter contains notification function for MI notification. | The syntax for McuMiNotification should be provided as Mcu_EcmMINotification.
          function name McuNmiNotification [0..1]: set at post-build, origin=Renesas_v1.0.0, default-value=NULL_PTR, regular-expression=[a-zA-Z][a-zA-Z0-9_]*  # This parameter contains notification function for NMI notification. | The syntax for McuNmiNotification should be provided as Mcu_EcmNMINotification.
          function name McuEcmInitialNotification [0..1]: set at post-build, origin=Renesas_v1.0.2, default-value=NULL_PTR, regular-expression=[a-zA-Z][a-zA-Z0-9_]*  # This parameter is used for notify the upper layer, if any ECM error has been already detected at system start-up. | The syntax for McuEcmInitialNotification should be provided as Mcu_EcmInitialNotification.
        container McuEcmErrorSource10  # This container contains all the supported configuration parameters of the related error source from Clock monitor for CPU checker clock(CLMA3).
          boolean McuEcmErrorMaskableInterrupt: set at post-build, origin=Renesas_v1.0.0, default-value=false  # This parameter enables or disables generation of a maskable interrupt when the error occurs from Clock monitor for CPU checker clock(CLMA3). | true: enables generation of a maskable interrupt when the error occurs from Clock monitor for CPU checker clock(CLMA3). false: disables generation of a maskable interrupt when the error occurs from Clock monitor for CPU checker clock(CLMA3).
          boolean McuEcmErrorNonMaskableInterrupt: set at post-build, origin=Renesas_v1.0.0, default-value=false  # This parameter enables or disables generation of a non-maskable interrupt when the error occurs from Clock monitor for CPU checker clock(CLMA3). | true: enables generation of a non-maskable interrupt when the error occurs from Clock monitor for CPU checker clock(CLMA3). false: disables generation of a non-maskable interrupt when the error occurs from Clock monitor for CPU checker clock(CLMA3).
          boolean McuEcmErrorInternalReset: set at post-build, origin=Renesas_v1.0.0, default-value=false  # This parameter enables or disables generation of an internal reset when the error occurs from Clock monitor for CPU checker clock(CLMA3). | true: enables generation of an internal reset when the error occurs from Clock monitor for CPU checker clock(CLMA3). false: disables generation of an internal reset when the error occurs from Clock monitor for CPU checker clock(CLMA3).
          boolean McuEcmErrorNMIDelayTimer: set at post-build, origin=Renesas_v1.0.0, default-value=false  # This parameter enables or disables delay timer start caused by non-maskable interrupts in response to errors from Clock monitor for CPU checker clock(CLMA3). | true: enables delay timer start caused by non-maskable interrupts in response to errors from Clock monitor for CPU checker clock(CLMA3). false: disables delay timer start caused by non-maskable interrupts in response to errors from Clock monitor for CPU checker clock(CLMA3).
          boolean McuEcmErrorMIDelayTimer: set at post-build, origin=Renesas_v1.0.0, default-value=false  # This parameter enables or disables delay timer start caused by maskable interrupts in response to errors from Clock monitor for CPU checker clock(CLMA3). | true: enables delay timer start caused by maskable interrupts in response to errors from Clock monitor for CPU checker clock(CLMA3). false: disables delay timer start caused by maskable interrupts in response to errors from Clock monitor for CPU checker clock(CLMA3).
          boolean McuEcmErrorOutputMask: set at post-build, origin=Renesas_v1.0.0, default-value=true  # This parameter mask or unmask the individual error sources of the error pin output from Clock monitor for CPU checker clock(CLMA3). | true: mask the individual error sources of the error pin output from Clock monitor for CPU checker clock(CLMA3). false: unmask the individual error sources of the error pin output from Clock monitor for CPU checker clock(CLMA3).
          function name McuMiNotification [0..1]: set at post-build, origin=Renesas_v1.0.0, default-value=NULL_PTR, regular-expression=[a-zA-Z][a-zA-Z0-9_]*  # This parameter contains notification function for MI notification. | The syntax for McuMiNotification should be provided as Mcu_EcmMINotification.
          function name McuNmiNotification [0..1]: set at post-build, origin=Renesas_v1.0.0, default-value=NULL_PTR, regular-expression=[a-zA-Z][a-zA-Z0-9_]*  # This parameter contains notification function for NMI notification. | The syntax for McuNmiNotification should be provided as Mcu_EcmNMINotification.
          function name McuEcmInitialNotification [0..1]: set at post-build, origin=Renesas_v1.0.2, default-value=NULL_PTR, regular-expression=[a-zA-Z][a-zA-Z0-9_]*  # This parameter is used for notify the upper layer, if any ECM error has been already detected at system start-up. | The syntax for McuEcmInitialNotification should be provided as Mcu_EcmInitialNotification.
        container McuEcmErrorSource12  # This container contains all the supported configuration parameters of the related error source from Clock monitor for peripheral clock(CLMA1).
          boolean McuEcmErrorMaskableInterrupt: set at post-build, origin=Renesas_v1.0.0, default-value=false  # This parameter enables or disables generation of a maskable interrupt when the error occurs from Clock monitor for peripheral clock(CLMA1). | true: enables generation of a maskable interrupt when the error occurs from Clock monitor for peripheral clock(CLMA1). false: disables generation of a maskable interrupt when the error occurs from Clock monitor for peripheral clock(CLMA1).
          boolean McuEcmErrorNonMaskableInterrupt: set at post-build, origin=Renesas_v1.0.0, default-value=false  # This parameter enables or disables generation of a non-maskable interrupt when the error occurs from Clock monitor for peripheral clock(CLMA1). | true: enables generation of a non-maskable interrupt when the error occurs from Clock monitor for peripheral clock(CLMA1). false: disables generation of a non-maskable interrupt when the error occurs from Clock monitor for peripheral clock(CLMA1).
          boolean McuEcmErrorInternalReset: set at post-build, origin=Renesas_v1.0.0, default-value=false  # This parameter enables or disables generation of an internal reset when the error occurs from Clock monitor for peripheral clock(CLMA1). | true: enables generation of an internal reset when the error occurs from Clock monitor for peripheral clock(CLMA1). false: disables generation of an internal reset when the error occurs from Clock monitor for peripheral clock(CLMA1).
          boolean McuEcmErrorNMIDelayTimer: set at post-build, origin=Renesas_v1.0.0, default-value=false  # This parameter enables or disables delay timer start caused by non-maskable interrupts in response to errors from Clock monitor for peripheral clock(CLMA1). | true: enables delay timer start caused by non-maskable interrupts in response to errors from Clock monitor for peripheral clock(CLMA1). false: disables delay timer start caused by non-maskable interrupts in response to errors from Clock monitor for peripheral clock(CLMA1).
          boolean McuEcmErrorMIDelayTimer: set at post-build, origin=Renesas_v1.0.0, default-value=false  # This parameter enables or disables delay timer start caused by maskable interrupts in response to errors from Clock monitor for peripheral clock(CLMA1). | true: enables delay timer start caused by maskable interrupts in response to errors from Clock monitor for peripheral clock(CLMA1). false: disables delay timer start caused by maskable interrupts in response to errors from Clock monitor for peripheral clock(CLMA1).
          boolean McuEcmErrorOutputMask: set at post-build, origin=Renesas_v1.0.0, default-value=true  # This parameter mask or unmask the individual error sources of the error pin output from Clock monitor for peripheral clock(CLMA1). | true: mask the individual error sources of the error pin output from Clock monitor for peripheral clock(CLMA1). false: unmask the individual error sources of the error pin output from Clock monitor for peripheral clock(CLMA1).
          function name McuMiNotification [0..1]: set at post-build, origin=Renesas_v1.0.0, default-value=NULL_PTR, regular-expression=[a-zA-Z][a-zA-Z0-9_]*  # This parameter contains notification function for MI notification. | The syntax for McuMiNotification should be provided as Mcu_EcmMINotification.
          function name McuNmiNotification [0..1]: set at post-build, origin=Renesas_v1.0.0, default-value=NULL_PTR, regular-expression=[a-zA-Z][a-zA-Z0-9_]*  # This parameter contains notification function for NMI notification. | The syntax for McuNmiNotification should be provided as Mcu_EcmNMINotification.
          function name McuEcmInitialNotification [0..1]: set at post-build, origin=Renesas_v1.0.2, default-value=NULL_PTR, regular-expression=[a-zA-Z][a-zA-Z0-9_]*  # This parameter is used for notify the upper layer, if any ECM error has been already detected at system start-up. | The syntax for McuEcmInitialNotification should be provided as Mcu_EcmInitialNotification.
        container McuEcmErrorSource16  # This container contains all the supported configuration parameters of the related error source from Local RAM ECC(DED).
          boolean McuEcmErrorMaskableInterrupt: set at post-build, origin=Renesas_v1.0.0, default-value=false  # This parameter enables or disables generation of a maskable interrupt when the error occurs from Local RAM ECC(DED). | true: enables generation of a maskable interrupt when the error occurs from Local RAM ECC(DED). false: disables generation of a maskable interrupt when the error occurs from Local RAM ECC(DED).
          boolean McuEcmErrorNonMaskableInterrupt: set at post-build, origin=Renesas_v1.0.0, default-value=false  # This parameter enables or disables generation of a non-maskable interrupt when the error occurs from Local RAM ECC(DED). | true: enables generation of a non-maskable interrupt when the error occurs from Local RAM ECC(DED). false: disables generation of a non-maskable interrupt when the error occurs from Local RAM ECC(DED).
          boolean McuEcmErrorInternalReset: set at post-build, origin=Renesas_v1.0.0, default-value=false  # This parameter enables or disables generation of an internal reset when the error occurs from Local RAM ECC(DED). | true: enables generation of an internal reset when the error occurs from Local RAM ECC(DED). false: disables generation of an internal reset when the error occurs from Local RAM ECC(DED).
          boolean McuEcmErrorNMIDelayTimer: set at post-build, origin=Renesas_v1.0.0, default-value=false  # This parameter enables or disables delay timer start caused by non-maskable interrupts in response to errors from Local RAM ECC(DED). | true: enables delay timer start caused by non-maskable interrupts in response to errors from Local RAM ECC(DED). false: disables delay timer start caused by non-maskable interrupts in response to errors from Local RAM ECC(DED).
          boolean McuEcmErrorMIDelayTimer: set at post-build, origin=Renesas_v1.0.0, default-value=false  # This parameter enables or disables delay timer start caused by maskable interrupts in response to errors from Local RAM ECC(DED). | true: enables delay timer start caused by maskable interrupts in response to errors from Local RAM ECC(DED). false: disables delay timer start caused by maskable interrupts in response to errors from Local RAM ECC(DED).
          boolean McuEcmErrorOutputMask: set at post-build, origin=Renesas_v1.0.0, default-value=true  # This parameter mask or unmask the individual error sources of the error pin output from Local RAM ECC(DED). | true: mask the individual error sources of the error pin output from Local RAM ECC(DED). false: unmask the individual error sources of the error pin output from Local RAM ECC(DED).
          function name McuMiNotification [0..1]: set at post-build, origin=Renesas_v1.0.0, default-value=NULL_PTR, regular-expression=[a-zA-Z][a-zA-Z0-9_]*  # This parameter contains notification function for MI notification. | The syntax for McuMiNotification should be provided as Mcu_EcmMINotification.
          function name McuNmiNotification [0..1]: set at post-build, origin=Renesas_v1.0.0, default-value=NULL_PTR, regular-expression=[a-zA-Z][a-zA-Z0-9_]*  # This parameter contains notification function for NMI notification. | The syntax for McuNmiNotification should be provided as Mcu_EcmNMINotification.
          function name McuEcmInitialNotification [0..1]: set at post-build, origin=Renesas_v1.0.2, default-value=NULL_PTR, regular-expression=[a-zA-Z][a-zA-Z0-9_]*  # This parameter is used for notify the upper layer, if any ECM error has been already detected at system start-up. | The syntax for McuEcmInitialNotification should be provided as Mcu_EcmInitialNotification.
        container McuEcmErrorSource17  # This container contains all the supported configuration parameters of the related error source from Global RAM ECC(DED).
          boolean McuEcmErrorMaskableInterrupt: set at post-build, origin=Renesas_v1.0.0, default-value=false  # This parameter enables or disables generation of a maskable interrupt when the error occurs from Global RAM ECC(DED). | true: enables generation of a maskable interrupt when the error occurs from Global RAM ECC(DED). false: disables generation of a maskable interrupt when the error occurs from Global RAM ECC(DED).
          boolean McuEcmErrorNonMaskableInterrupt: set at post-build, origin=Renesas_v1.0.0, default-value=false  # This parameter enables or disables generation of a non-maskable interrupt when the error occurs from Global RAM ECC(DED). | true: enables generation of a non-maskable interrupt when the error occurs from Global RAM ECC(DED). false: disables generation of a non-maskable interrupt when the error occurs from Global RAM ECC(DED).
          boolean McuEcmErrorInternalReset: set at post-build, origin=Renesas_v1.0.0, default-value=false  # This parameter enables or disables generation of an internal reset when the error occurs from Global RAM ECC(DED). | true: enables generation of an internal reset when the error occurs from Global RAM ECC(DED). false: disables generation of an internal reset when the error occurs from Global RAM ECC(DED).
          boolean McuEcmErrorNMIDelayTimer: set at post-build, origin=Renesas_v1.0.0, default-value=false  # This parameter enables or disables delay timer start caused by non-maskable interrupts in response to errors from Global RAM ECC(DED). | true: enables delay timer start caused by non-maskable interrupts in response to errors from Global RAM ECC(DED). false: disables delay timer start caused by non-maskable interrupts in response to errors from Global RAM ECC(DED).
          boolean McuEcmErrorMIDelayTimer: set at post-build, origin=Renesas_v1.0.0, default-value=false  # This parameter enables or disables delay timer start caused by maskable interrupts in response to errors from Global RAM ECC(DED). | true: enables delay timer start caused by maskable interrupts in response to errors from Global RAM ECC(DED). false: disables delay timer start caused by maskable interrupts in response to errors from Global RAM ECC(DED).
          boolean McuEcmErrorOutputMask: set at post-build, origin=Renesas_v1.0.0, default-value=true  # This parameter mask or unmask the individual error sources of the error pin output from Global RAM ECC(DED). | true: mask the individual error sources of the error pin output from Global RAM ECC(DED). false: unmask the individual error sources of the error pin output from Global RAM ECC(DED).
          function name McuMiNotification [0..1]: set at post-build, origin=Renesas_v1.0.0, default-value=NULL_PTR, regular-expression=[a-zA-Z][a-zA-Z0-9_]*  # This parameter contains notification function for MI notification. | The syntax for McuMiNotification should be provided as Mcu_EcmMINotification.
          function name McuNmiNotification [0..1]: set at post-build, origin=Renesas_v1.0.0, default-value=NULL_PTR, regular-expression=[a-zA-Z][a-zA-Z0-9_]*  # This parameter contains notification function for NMI notification. | The syntax for McuNmiNotification should be provided as Mcu_EcmNMINotification.
          function name McuEcmInitialNotification [0..1]: set at post-build, origin=Renesas_v1.0.2, default-value=NULL_PTR, regular-expression=[a-zA-Z][a-zA-Z0-9_]*  # This parameter is used for notify the upper layer, if any ECM error has been already detected at system start-up. | The syntax for McuEcmInitialNotification should be provided as Mcu_EcmInitialNotification.
        container McuEcmErrorSource18  # This container contains all the supported configuration parameters of the related error source from Instruction cache RAM ECC.
          boolean McuEcmErrorMaskableInterrupt: set at post-build, origin=Renesas_v1.0.0, default-value=false  # This parameter enables or disables generation of a maskable interrupt when the error occurs from Instruction cache RAM ECC. | true: enables generation of a maskable interrupt when the error occurs from Instruction cache RAM ECC. false: disables generation of a maskable interrupt when the error occurs from Instruction cache RAM ECC.
          boolean McuEcmErrorNonMaskableInterrupt: set at post-build, origin=Renesas_v1.0.0, default-value=false  # This parameter enables or disables generation of a non-maskable interrupt when the error occurs from Instruction cache RAM ECC. | true: enables generation of a non-maskable interrupt when the error occurs from Instruction cache RAM ECC. false: disables generation of a non-maskable interrupt when the error occurs from Instruction cache RAM ECC.
          boolean McuEcmErrorInternalReset: set at post-build, origin=Renesas_v1.0.0, default-value=false  # This parameter enables or disables generation of an internal reset when the error occurs from Instruction cache RAM ECC. | true: enables generation of an internal reset when the error occurs from Instruction cache RAM ECC. false: disables generation of an internal reset when the error occurs from Instruction cache RAM ECC.
          boolean McuEcmErrorNMIDelayTimer: set at post-build, origin=Renesas_v1.0.0, default-value=false  # This parameter enables or disables delay timer start caused by non-maskable interrupts in response to errors from Instruction cache RAM ECC. | true: enables delay timer start caused by non-maskable interrupts in response to errors from Instruction cache RAM ECC. false: disables delay timer start caused by non-maskable interrupts in response to errors from Instruction cache RAM ECC.
          boolean McuEcmErrorMIDelayTimer: set at post-build, origin=Renesas_v1.0.0, default-value=false  # This parameter enables or disables delay timer start caused by maskable interrupts in response to errors from Instruction cache RAM ECC. | true: enables delay timer start caused by maskable interrupts in response to errors from Instruction cache RAM ECC. false: disables delay timer start caused by maskable interrupts in response to errors from Instruction cache RAM ECC.
          boolean McuEcmErrorOutputMask: set at post-build, origin=Renesas_v1.0.0, default-value=true  # This parameter mask or unmask the individual error sources of the error pin output from Instruction cache RAM ECC. | true: mask the individual error sources of the error pin output from Instruction cache RAM ECC. false: unmask the individual error sources of the error pin output from Instruction cache RAM ECC.
          function name McuMiNotification [0..1]: set at post-build, origin=Renesas_v1.0.0, default-value=NULL_PTR, regular-expression=[a-zA-Z][a-zA-Z0-9_]*  # This parameter contains notification function for MI notification. | The syntax for McuMiNotification should be provided as Mcu_EcmMINotification.
          function name McuNmiNotification [0..1]: set at post-build, origin=Renesas_v1.0.0, default-value=NULL_PTR, regular-expression=[a-zA-Z][a-zA-Z0-9_]*  # This parameter contains notification function for NMI notification. | The syntax for McuNmiNotification should be provided as Mcu_EcmNMINotification.
          function name McuEcmInitialNotification [0..1]: set at post-build, origin=Renesas_v1.0.2, default-value=NULL_PTR, regular-expression=[a-zA-Z][a-zA-Z0-9_]*  # This parameter is used for notify the upper layer, if any ECM error has been already detected at system start-up. | The syntax for McuEcmInitialNotification should be provided as Mcu_EcmInitialNotification.
        container McuEcmErrorSource19  # This container contains all the supported configuration parameters of the related error source from Code flash ECC(DED).
          boolean McuEcmErrorMaskableInterrupt: set at post-build, origin=Renesas_v1.0.0, default-value=false  # This parameter enables or disables generation of a maskable interrupt when the error occurs from Code flash ECC(DED). | true: enables generation of a maskable interrupt when the error occurs from Code flash ECC(DED). false: disables generation of a maskable interrupt when the error occurs from Code flash ECC(DED) .
          boolean McuEcmErrorNonMaskableInterrupt: set at post-build, origin=Renesas_v1.0.0, default-value=false  # This parameter enables or disables generation of a non-maskable interrupt when the error occurs from Code flash ECC(DED). | true: enables generation of a non-maskable interrupt when the error occurs from Code flash ECC(DED). false: disables generation of a non-maskable interrupt when the error occurs from Code flash ECC(DED).
          boolean McuEcmErrorInternalReset: set at post-build, origin=Renesas_v1.0.0, default-value=false  # This parameter enables or disables generation of an internal reset when the error occurs from Code flash ECC(DED). | true: enables generation of an internal reset when the error occurs from Code flash ECC(DED). false: disables generation of an internal reset when the error occurs from Code flash ECC(DED).
          boolean McuEcmErrorNMIDelayTimer: set at post-build, origin=Renesas_v1.0.0, default-value=false  # This parameter enables or disables delay timer start caused by non-maskable interrupts in response to errors from Code flash ECC(DED). | true: enables delay timer start caused by non-maskable interrupts in response to errors from Code flash ECC(DED). false: disables delay timer start caused by non-maskable interrupts in response to errors from Code flash ECC(DED).
          boolean McuEcmErrorMIDelayTimer: set at post-build, origin=Renesas_v1.0.0, default-value=false  # This parameter enables or disables delay timer start caused by maskable interrupts in response to errors from Code flash ECC(DED). | true: enables delay timer start caused by maskable interrupts in response to errors from Code flash ECC(DED). false: disables delay timer start caused by maskable interrupts in response to errors from Code flash ECC(DED).
          boolean McuEcmErrorOutputMask: set at post-build, origin=Renesas_v1.0.0, default-value=true  # This parameter mask or unmask the individual error sources of the error pin output from Code flash ECC(DED). | true: mask the individual error sources of the error pin output from Code flash ECC(DED). false: unmask the individual error sources of the error pin output from Code flash ECC(DED).
          function name McuMiNotification [0..1]: set at post-build, origin=Renesas_v1.0.0, default-value=NULL_PTR, regular-expression=[a-zA-Z][a-zA-Z0-9_]*  # This parameter contains notification function for MI notification. | The syntax for McuMiNotification should be provided as Mcu_EcmMINotification.
          function name McuNmiNotification [0..1]: set at post-build, origin=Renesas_v1.0.0, default-value=NULL_PTR, regular-expression=[a-zA-Z][a-zA-Z0-9_]*  # This parameter contains notification function for NMI notification. | The syntax for McuNmiNotification should be provided as Mcu_EcmNMINotification.
          function name McuEcmInitialNotification [0..1]: set at post-build, origin=Renesas_v1.0.2, default-value=NULL_PTR, regular-expression=[a-zA-Z][a-zA-Z0-9_]*  # This parameter is used for notify the upper layer, if any ECM error has been already detected at system start-up. | The syntax for McuEcmInitialNotification should be provided as Mcu_EcmInitialNotification.
        container McuEcmErrorSource20  # This container contains all the supported configuration parameters of the related error source from Data flash ECC(DED).
          boolean McuEcmErrorMaskableInterrupt: set at post-build, origin=Renesas_v1.0.0, default-value=false  # This parameter enables or disables generation of a maskable interrupt when the error occurs from Data flash ECC(DED). | true: enables generation of a maskable interrupt when the error occurs from Data flash ECC(DED). false: disables generation of a maskable interrupt when the error occurs from Data flash ECC(DED).
          boolean McuEcmErrorNonMaskableInterrupt: set at post-build, origin=Renesas_v1.0.0, default-value=false  # This parameter enables or disables generation of a non-maskable interrupt when the error occurs from Data flash ECC(DED). | true: enables generation of a non-maskable interrupt when the error occurs from Data flash ECC(DED). false: disables generation of a non-maskable interrupt when the error occurs from Data flash ECC(DED).
          boolean McuEcmErrorInternalReset: set at post-build, origin=Renesas_v1.0.0, default-value=false  # This parameter enables or disables generation of an internal reset when the error occurs from Data flash ECC(DED). | true: enables generation of an internal reset when the error occurs from Data flash ECC(DED). false: disables generation of an internal reset when the error occurs from Data flash ECC.
          boolean McuEcmErrorNMIDelayTimer: set at post-build, origin=Renesas_v1.0.0, default-value=false  # This parameter enables or disables delay timer start caused by non-maskable interrupts in response to errors from Data flash ECC(DED). | true: enables delay timer start caused by non-maskable interrupts in response to errors from Data flash ECC(DED). false: disables delay timer start caused by non-maskable interrupts in response to errors from Data flash ECC(DED).
          boolean McuEcmErrorMIDelayTimer: set at post-build, origin=Renesas_v1.0.0, default-value=false  # This parameter enables or disables delay timer start caused by maskable interrupts in response to errors from Data flash ECC(DED). | true: enables delay timer start caused by maskable interrupts in response to errors from Data flash ECC(DED). false: disables delay timer start caused by maskable interrupts in response to errors from Data flash ECC(DED).
          boolean McuEcmErrorOutputMask: set at post-build, origin=Renesas_v1.0.0, default-value=true  # This parameter mask or unmask the individual error sources of the error pin output from Data flash ECC(DED). | true: mask the individual error sources of the error pin output from Data flash ECC(DED). false: unmask the individual error sources of the error pin output from Data flash ECC(DED).
          function name McuMiNotification [0..1]: set at post-build, origin=Renesas_v1.0.0, default-value=NULL_PTR, regular-expression=[a-zA-Z][a-zA-Z0-9_]*  # This parameter contains notification function for MI notification. | The syntax for McuMiNotification should be provided as Mcu_EcmMINotification.
          function name McuNmiNotification [0..1]: set at post-build, origin=Renesas_v1.0.0, default-value=NULL_PTR, regular-expression=[a-zA-Z][a-zA-Z0-9_]*  # This parameter contains notification function for NMI notification. | The syntax for McuNmiNotification should be provided as Mcu_EcmNMINotification.
          function name McuEcmInitialNotification [0..1]: set at post-build, origin=Renesas_v1.0.2, default-value=NULL_PTR, regular-expression=[a-zA-Z][a-zA-Z0-9_]*  # This parameter is used for notify the upper layer, if any ECM error has been already detected at system start-up. | The syntax for McuEcmInitialNotification should be provided as Mcu_EcmInitialNotification.
        container McuEcmErrorSource21  # This container contains all the supported configuration parameters of the related error source from CSIH RAM ECC error(DED).
          boolean McuEcmErrorMaskableInterrupt: set at post-build, origin=Renesas_v1.0.0, default-value=false  # This parameter enables or disables generation of a maskable interrupt when the error occurs from CSIH RAM ECC error(DED). | true: enables generation of a maskable interrupt when the error occurs from CSIH RAM ECC error(DED). false: disables generation of a maskable interrupt when the error occurs from CSIH RAM ECC error(DED).
          boolean McuEcmErrorNonMaskableInterrupt: set at post-build, origin=Renesas_v1.0.0, default-value=false  # This parameter enables or disables generation of a non-maskable interrupt when the error occurs from CSIH RAM ECC error(DED). | true: enables generation of a non-maskable interrupt when the error occurs from CSIH RAM ECC error(DED). false: disables generation of a non-maskable interrupt when the error occurs from CSIH RAM ECC error(DED).
          boolean McuEcmErrorInternalReset: set at post-build, origin=Renesas_v1.0.0, default-value=false  # This parameter enables or disables generation of an internal reset when the error occurs from CSIH RAM ECC error(DED). | true: enables generation of an internal reset when the error occurs from CSIH RAM ECC error(DED). false: disables generation of an internal reset when the error occurs from CSIH RAM ECC error(DED).
          boolean McuEcmErrorNMIDelayTimer: set at post-build, origin=Renesas_v1.0.0, default-value=false  # This parameter enables or disables delay timer start caused by non-maskable interrupts in response to errors from CSIH RAM ECC error(DED). | true: enables delay timer start caused by non-maskable interrupts in response to errors from CSIH RAM ECC error(DED). false: disables delay timer start caused by non-maskable interrupts in response to errors from CSIH RAM ECC error(DED).
          boolean McuEcmErrorMIDelayTimer: set at post-build, origin=Renesas_v1.0.0, default-value=false  # This parameter enables or disables delay timer start caused by maskable interrupts in response to errors from CSIH RAM ECC error(DED). | true: enables delay timer start caused by maskable interrupts in response to errors from CSIH RAM ECC error(DED). false: disables delay timer start caused by maskable interrupts in response to errors from CSIH RAM ECC error(DED).
          boolean McuEcmErrorOutputMask: set at post-build, origin=Renesas_v1.0.0, default-value=true  # This parameter mask or unmask the individual error sources of the error pin output from CSIH RAM ECC error(DED). | true: mask the individual error sources of the error pin output from CSIH RAM ECC error(DED). false: unmask the individual error sources of the error pin output from CSIH RAM ECC error(DED).
          function name McuMiNotification [0..1]: set at post-build, origin=Renesas_v1.0.0, default-value=NULL_PTR, regular-expression=[a-zA-Z][a-zA-Z0-9_]*  # This parameter contains notification function for MI notification. | The syntax for McuMiNotification should be provided as Mcu_EcmMINotification.
          function name McuNmiNotification [0..1]: set at post-build, origin=Renesas_v1.0.0, default-value=NULL_PTR, regular-expression=[a-zA-Z][a-zA-Z0-9_]*  # This parameter contains notification function for NMI notification. | The syntax for McuNmiNotification should be provided as Mcu_EcmNMINotification.
          function name McuEcmInitialNotification [0..1]: set at post-build, origin=Renesas_v1.0.2, default-value=NULL_PTR, regular-expression=[a-zA-Z][a-zA-Z0-9_]*  # This parameter is used for notify the upper layer, if any ECM error has been already detected at system start-up. | The syntax for McuEcmInitialNotification should be provided as Mcu_EcmInitialNotification.
        container McuEcmErrorSource22  # This container contains all the supported configuration parameters of the related error source from CAN RAM ECC error(DED).
          boolean McuEcmErrorMaskableInterrupt: set at post-build, origin=Renesas_v1.0.0, default-value=false  # This parameter enables or disables generation of a maskable interrupt when the error occurs from CAN RAM ECC error(DED). | true: enables generation of a maskable interrupt when the error occurs from CAN RAM ECC error(DED). false: disables generation of a maskable interrupt when the error occurs from CAN RAM ECC error(DED).
          boolean McuEcmErrorNonMaskableInterrupt: set at post-build, origin=Renesas_v1.0.0, default-value=false  # This parameter enables or disables generation of a non-maskable interrupt when the error occurs from CAN RAM ECC error(DED). | true: enables generation of a non-maskable interrupt when the error occurs from CAN RAM ECC error(DED). false: disables generation of a non-maskable interrupt when the error occurs from CAN RAM ECC error(DED).
          boolean McuEcmErrorInternalReset: set at post-build, origin=Renesas_v1.0.0, default-value=false  # This parameter enables or disables generation of an internal reset when the error occurs from CAN RAM ECC error(DED). | true: enables generation of an internal reset when the error occurs from CAN RAM ECC error(DED). false: disables generation of an internal reset when the error occurs from CAN RAM ECC error(DED).
          boolean McuEcmErrorNMIDelayTimer: set at post-build, origin=Renesas_v1.0.0, default-value=false  # This parameter enables or disables delay timer start caused by non-maskable interrupts in response to errors from CAN RAM ECC error(DED). | true: enables delay timer start caused by non-maskable interrupts in response to errors from CAN RAM ECC error(DED). false: disables delay timer start caused by non-maskable interrupts in response to errors from CAN RAM ECC error(DED).
          boolean McuEcmErrorMIDelayTimer: set at post-build, origin=Renesas_v1.0.0, default-value=false  # This parameter enables or disables delay timer start caused by maskable interrupts in response to errors from CAN RAM ECC error(DED). | true: enables delay timer start caused by maskable interrupts in response to errors from CAN RAM ECC error(DED). false: disables delay timer start caused by maskable interrupts in response to errors from CAN RAM ECC error(DED).
          boolean McuEcmErrorOutputMask: set at post-build, origin=Renesas_v1.0.0, default-value=true  # This parameter mask or unmask the individual error sources of the error pin output from CAN RAM ECC error(DED). | true: mask the individual error sources of the error pin output from CAN RAM ECC error(DED). false: unmask the individual error sources of the error pin output from CAN RAM ECC error(DED).
          function name McuMiNotification [0..1]: set at post-build, origin=Renesas_v1.0.0, default-value=NULL_PTR, regular-expression=[a-zA-Z][a-zA-Z0-9_]*  # This parameter contains notification function for MI notification. | The syntax for McuMiNotification should be provided as Mcu_EcmMINotification.
          function name McuNmiNotification [0..1]: set at post-build, origin=Renesas_v1.0.0, default-value=NULL_PTR, regular-expression=[a-zA-Z][a-zA-Z0-9_]*  # This parameter contains notification function for NMI notification. | The syntax for McuNmiNotification should be provided as Mcu_EcmNMINotification.
          function name McuEcmInitialNotification [0..1]: set at post-build, origin=Renesas_v1.0.2, default-value=NULL_PTR, regular-expression=[a-zA-Z][a-zA-Z0-9_]*  # This parameter is used for notify the upper layer, if any ECM error has been already detected at system start-up. | The syntax for McuEcmInitialNotification should be provided as Mcu_EcmInitialNotification.
        container McuEcmErrorSource23  # This container contains all the supported configuration parameters of the related error source from Ethernet RAM ECC error(DED).
          boolean McuEcmErrorMaskableInterrupt: set at post-build, origin=Renesas_v1.0.0, default-value=false  # This parameter enables or disables generation of a maskable interrupt when the error occurs from Ethernet RAM ECC error(DED). | true: enables generation of a maskable interrupt when the error occurs from Ethernet RAM ECC error(DED). false: disables generation of a maskable interrupt when the error occurs from Ethernet RAM ECC error(DED).
          boolean McuEcmErrorNonMaskableInterrupt: set at post-build, origin=Renesas_v1.0.0, default-value=false  # This parameter enables or disables generation of a non-maskable interrupt when the error occurs from Ethernet RAM ECC error(DED). | true: enables generation of a non-maskable interrupt when the error occurs from Ethernet RAM ECC error(DED). false: disables generation of a non-maskable interrupt when the error occurs from Ethernet RAM ECC error(DED).
          boolean McuEcmErrorInternalReset: set at post-build, origin=Renesas_v1.0.0, default-value=false  # This parameter enables or disables generation of an internal reset when the error occurs from Ethernet RAM ECC error(DED). | true: enables generation of an internal reset when the error occurs from Ethernet RAM ECC error(DED). false: disables generation of an internal reset when the error occurs from Ethernet RAM ECC error(DED).
          boolean McuEcmErrorNMIDelayTimer: set at post-build, origin=Renesas_v1.0.0, default-value=false  # This parameter enables or disables delay timer start caused by non-maskable interrupts in response to errors from Ethernet RAM ECC error(DED). | true: enables delay timer start caused by non-maskable interrupts in response to errors from Ethernet RAM ECC error(DED). false: disables delay timer start caused by non-maskable interrupts in response to errors from Ethernet RAM ECC error(DED).
          boolean McuEcmErrorMIDelayTimer: set at post-build, origin=Renesas_v1.0.0, default-value=false  # This parameter enables or disables delay timer start caused by maskable interrupts in response to errors from Ethernet RAM ECC error(DED). | true: enables delay timer start caused by maskable interrupts in response to errors from Ethernet RAM ECC error(DED). false: disables delay timer start caused by maskable interrupts in response to errors from Ethernet RAM ECC error(DED).
          boolean McuEcmErrorOutputMask: set at post-build, origin=Renesas_v1.0.0, default-value=true  # This parameter mask or unmask the individual error sources of the error pin output from Ethernet RAM ECC error(DED). | true: mask the individual error sources of the error pin output from Ethernet RAM ECC error(DED). false: unmask the individual error sources of the error pin output from Ethernet RAM ECC error(DED).
          function name McuMiNotification [0..1]: set at post-build, origin=Renesas_v1.0.0, default-value=NULL_PTR, regular-expression=[a-zA-Z][a-zA-Z0-9_]*  # This parameter contains notification function for MI notification. | The syntax for McuMiNotification should be provided as Mcu_EcmMINotification.
          function name McuNmiNotification [0..1]: set at post-build, origin=Renesas_v1.0.0, default-value=NULL_PTR, regular-expression=[a-zA-Z][a-zA-Z0-9_]*  # This parameter contains notification function for NMI notification. | The syntax for McuNmiNotification should be provided as Mcu_EcmNMINotification.
          function name McuEcmInitialNotification [0..1]: set at post-build, origin=Renesas_v1.0.2, default-value=NULL_PTR, regular-expression=[a-zA-Z][a-zA-Z0-9_]*  # This parameter is used for notify the upper layer, if any ECM error has been already detected at system start-up. | The syntax for McuEcmInitialNotification should be provided as Mcu_EcmInitialNotification.
        container McuEcmErrorSource24  # This container contains all the supported configuration parameters of the related error source from FlexRay RAM ECC error (DED).
          boolean McuEcmErrorMaskableInterrupt: set at post-build, origin=Renesas_v1.0.0, default-value=false  # This parameter enables or disables generation of a maskable interrupt when the error occurs from FlexRay RAM ECC error (DED). | true: enables generation of a maskable interrupt when the error occurs from FlexRay RAM ECC error (DED). false: disables generation of a maskable interrupt when the error occurs from FlexRay RAM ECC error (DED).
          boolean McuEcmErrorNonMaskableInterrupt: set at post-build, origin=Renesas_v1.0.0, default-value=false  # This parameter enables or disables generation of a non-maskable interrupt when the error occurs from FlexRay RAM ECC error (DED). | true: enables generation of a non-maskable interrupt when the error occurs from FlexRay RAM ECC error (DED). false: disables generation of a non-maskable interrupt when the error occurs from FlexRay RAM ECC error (DED).
          boolean McuEcmErrorInternalReset: set at post-build, origin=Renesas_v1.0.0, default-value=false  # This parameter enables or disables generation of an internal reset when the error occurs from FlexRay RAM ECC error (DED). | true: enables generation of an internal reset when the error occurs from FlexRay RAM ECC error (DED). false: disables generation of an internal reset when the error occurs from FlexRay RAM ECC error (DED).
          boolean McuEcmErrorNMIDelayTimer: set at post-build, origin=Renesas_v1.0.0, default-value=false  # This parameter enables or disables delay timer start caused by non-maskable interrupts in response to errors from FlexRay RAM ECC error (DED). | true: enables delay timer start caused by non-maskable interrupts in response to errors from FlexRay RAM ECC error (DED). false: disables delay timer start caused by non-maskable interrupts in response to errors from FlexRay RAM ECC error (DED).
          boolean McuEcmErrorMIDelayTimer: set at post-build, origin=Renesas_v1.0.0, default-value=false  # This parameter enables or disables delay timer start caused by maskable interrupts in response to errors from FlexRay RAM ECC error (DED). | true: enables delay timer start caused by maskable interrupts in response to errors from FlexRay RAM ECC error (DED). false: disables delay timer start caused by maskable interrupts in response to errors from FlexRay RAM ECC error (DED).
          boolean McuEcmErrorOutputMask: set at post-build, origin=Renesas_v1.0.0, default-value=true  # This parameter mask or unmask the individual error sources of the error pin output from FlexRay RAM ECC error (DED). | true: mask the individual error sources of the error pin output from FlexRay RAM ECC error (DED). false: unmask the individual error sources of the error pin output from FlexRay RAM ECC error (DED).
          function name McuMiNotification [0..1]: set at post-build, origin=Renesas_v1.0.0, default-value=NULL_PTR, regular-expression=[a-zA-Z][a-zA-Z0-9_]*  # This parameter contains notification function for MI notification. | The syntax for McuMiNotification should be provided as Mcu_EcmMINotification.
          function name McuNmiNotification [0..1]: set at post-build, origin=Renesas_v1.0.0, default-value=NULL_PTR, regular-expression=[a-zA-Z][a-zA-Z0-9_]*  # This parameter contains notification function for NMI notification. | The syntax for McuNmiNotification should be provided as Mcu_EcmNMINotification.
          function name McuEcmInitialNotification [0..1]: set at post-build, origin=Renesas_v1.0.2, default-value=NULL_PTR, regular-expression=[a-zA-Z][a-zA-Z0-9_]*  # This parameter is used for notify the upper layer, if any ECM error has been already detected at system start-up. | The syntax for McuEcmInitialNotification should be provided as Mcu_EcmInitialNotification.
        container McuEcmErrorSource25  # This container contains all the supported configuration parameters of the related error source from GTM RAM ECC error(DED) .
          boolean McuEcmErrorMaskableInterrupt: set at post-build, origin=Renesas_v1.0.0, default-value=false  # This parameter enables or disables generation of a maskable interrupt when the error occurs from GTM RAM ECC error(DED). | true: enables generation of a maskable interrupt when the error occurs from GTM RAM ECC error(DED). false: disables generation of a maskable interrupt when the error occurs from GTM RAM ECC error(DED).
          boolean McuEcmErrorNonMaskableInterrupt: set at post-build, origin=Renesas_v1.0.0, default-value=false  # This parameter enables or disables generation of a non-maskable interrupt when the error occurs from GTM RAM ECC error(DED). | true: enables generation of a non-maskable interrupt when the error occurs from GTM RAM ECC error(DED). false: disables generation of a non-maskable interrupt when the error occurs from GTM RAM ECC error(DED).
          boolean McuEcmErrorInternalReset: set at post-build, origin=Renesas_v1.0.0, default-value=false  # This parameter enables or disables generation of an internal reset when the error occurs from GTM RAM ECC error(DED). | true: enables generation of an internal reset when the error occurs from GTM RAM ECC error(DED). false: disables generation of an internal reset when the error occurs from GTM RAM ECC error(DED).
          boolean McuEcmErrorNMIDelayTimer: set at post-build, origin=Renesas_v1.0.0, default-value=false  # This parameter enables or disables delay timer start caused by non-maskable interrupts in response to errors from GTM RAM ECC error(DED). | true: enables delay timer start caused by non-maskable interrupts in response to errors from GTM RAM ECC error(DED). false: disables delay timer start caused by non-maskable interrupts in response to errors from GTM RAM ECC error(DED).
          boolean McuEcmErrorMIDelayTimer: set at post-build, origin=Renesas_v1.0.0, default-value=false  # This parameter enables or disables delay timer start caused by maskable interrupts in response to errors from GTM RAM ECC error(DED). | true: enables delay timer start caused by maskable interrupts in response to errors from GTM RAM ECC error(DED). false: disables delay timer start caused by maskable interrupts in response to errors from GTM RAM ECC error(DED).
          boolean McuEcmErrorOutputMask: set at post-build, origin=Renesas_v1.0.0, default-value=true  # This parameter mask or unmask the individual error sources of the error pin output from GTM RAM ECC error(DED). | true: mask the individual error sources of the error pin output from GTM RAM ECC error(DED). false: unmask the individual error sources of the error pin output from GTM RAM ECC error(DED).
          function name McuMiNotification [0..1]: set at post-build, origin=Renesas_v1.0.0, default-value=NULL_PTR, regular-expression=[a-zA-Z][a-zA-Z0-9_]*  # This parameter contains notification function for MI notification. | The syntax for McuMiNotification should be provided as Mcu_EcmMINotification.
          function name McuNmiNotification [0..1]: set at post-build, origin=Renesas_v1.0.0, default-value=NULL_PTR, regular-expression=[a-zA-Z][a-zA-Z0-9_]*  # This parameter contains notification function for NMI notification. | The syntax for McuNmiNotification should be provided as Mcu_EcmNMINotification.
          function name McuEcmInitialNotification [0..1]: set at post-build, origin=Renesas_v1.0.2, default-value=NULL_PTR, regular-expression=[a-zA-Z][a-zA-Z0-9_]*  # This parameter is used for notify the upper layer, if any ECM error has been already detected at system start-up. | The syntax for McuEcmInitialNotification should be provided as Mcu_EcmInitialNotification.
        container McuEcmErrorSource28  # This container contains all the supported configuration parameters of the related error source from Bus ECC error (DED).
          boolean McuEcmErrorMaskableInterrupt: set at post-build, origin=Renesas_v1.0.0, default-value=false  # This parameter enables or disables generation of a maskable interrupt when the error occurs from Bus ECC error (DED). | true: enables generation of a maskable interrupt when the error occurs from Bus ECC error (DED). false: disables generation of a maskable interrupt when the error occurs from Bus ECC error (DED).
          boolean McuEcmErrorNonMaskableInterrupt: set at post-build, origin=Renesas_v1.0.0, default-value=false  # This parameter enables or disables generation of a non-maskable interrupt when the error occurs from Bus ECC error (DED). | true: enables generation of a non-maskable interrupt when the error occurs from Bus ECC error (DED). false: disables generation of a non-maskable interrupt when the error occurs from Bus ECC error (DED).
          boolean McuEcmErrorInternalReset: set at post-build, origin=Renesas_v1.0.0, default-value=false  # This parameter enables or disables generation of an internal reset when the error occurs from Bus ECC error (DED). | true: enables generation of an internal reset when the error occurs from Bus ECC error (DED). false: disables generation of an internal reset when the error occurs from Bus ECC error (DED).
          boolean McuEcmErrorNMIDelayTimer: set at post-build, origin=Renesas_v1.0.0, default-value=false  # This parameter enables or disables delay timer start caused by non-maskable interrupts in response to errors Bus ECC error (DED). | true: enables delay timer start caused by non-maskable interrupts in response to errors from Bus ECC error (DED). false: disables delay timer start caused by non-maskable interrupts in response to errors from Bus ECC error (DED).
          boolean McuEcmErrorMIDelayTimer: set at post-build, origin=Renesas_v1.0.0, default-value=false  # This parameter enables or disables delay timer start caused by maskable interrupts in response to errors from Bus ECC error (DED). | true: enables delay timer start caused by maskable interrupts in response to errors from Bus ECC error (DED). false: disables delay timer start caused by maskable interrupts in response to errors from Bus ECC error (DED).
          boolean McuEcmErrorOutputMask: set at post-build, origin=Renesas_v1.0.0, default-value=true  # This parameter mask or unmask the individual error sources of the error pin output from Bus ECC error (DED). | true: mask the individual error sources of the error pin output from Bus ECC error (DED). false: unmask the individual error sources of the error pin output from Bus ECC error (DED).
          function name McuMiNotification [0..1]: set at post-build, origin=Renesas_v1.0.0, default-value=NULL_PTR, regular-expression=[a-zA-Z][a-zA-Z0-9_]*  # This parameter contains notification function for MI notification. | The syntax for McuMiNotification should be provided as Mcu_EcmMINotification.
          function name McuNmiNotification [0..1]: set at post-build, origin=Renesas_v1.0.0, default-value=NULL_PTR, regular-expression=[a-zA-Z][a-zA-Z0-9_]*  # This parameter contains notification function for NMI notification. | The syntax for McuNmiNotification should be provided as Mcu_EcmNMINotification.
          function name McuEcmInitialNotification [0..1]: set at post-build, origin=Renesas_v1.0.2, default-value=NULL_PTR, regular-expression=[a-zA-Z][a-zA-Z0-9_]*  # This parameter is used for notify the upper layer, if any ECM error has been already detected at system start-up. | The syntax for McuEcmInitialNotification should be provided as Mcu_EcmInitialNotification.
        container McuEcmErrorSource29  # This container contains all the supported configuration parameters of the related error source from Bus ECC error (SED).
          boolean McuEcmErrorMaskableInterrupt: set at post-build, origin=Renesas_v1.0.0, default-value=false  # This parameter enables or disables generation of a maskable interrupt when the error occurs from Bus ECC error (SED). | true: enables generation of a maskable interrupt when the error occurs from Bus ECC error (SED). false: disables generation of a maskable interrupt when the error occurs from Bus ECC error (SED).
          boolean McuEcmErrorNonMaskableInterrupt: set at post-build, origin=Renesas_v1.0.0, default-value=false  # This parameter enables or disables generation of a non-maskable interrupt when the error occurs from Bus ECC error (SED). | true: enables generation of a non-maskable interrupt when the error occurs from Bus ECC error (SED). false: disables generation of a non-maskable interrupt when the error occurs from Bus ECC error (SED).
          boolean McuEcmErrorInternalReset: set at post-build, origin=Renesas_v1.0.0, default-value=false  # This parameter enables or disables generation of an internal reset when the error occurs from Bus ECC error (SED). | true: enables generation of an internal reset when the error occurs from Bus ECC error (SED). false: disables generation of an internal reset when the error occurs from Bus ECC error (SED).
          boolean McuEcmErrorNMIDelayTimer: set at post-build, origin=Renesas_v1.0.0, default-value=false  # This parameter enables or disables delay timer start caused by non-maskable interrupts in response to errors Bus ECC error (SED). | true: enables delay timer start caused by non-maskable interrupts in response to errors from Bus ECC error (SED). false: disables delay timer start caused by non-maskable interrupts in response to errors from Bus ECC error (SED).
          boolean McuEcmErrorMIDelayTimer: set at post-build, origin=Renesas_v1.0.0, default-value=false  # This parameter enables or disables delay timer start caused by maskable interrupts in response to errors from Bus ECC error (SED). | true: enables delay timer start caused by maskable interrupts in response to errors from Bus ECC error (SED). false: disables delay timer start caused by maskable interrupts in response to errors from Bus ECC error (SED).
          boolean McuEcmErrorOutputMask: set at post-build, origin=Renesas_v1.0.0, default-value=true  # This parameter mask or unmask the individual error sources of the error pin output from Bus ECC error (SED). | true: mask the individual error sources of the error pin output from Bus ECC error (SED). false: unmask the individual error sources of the error pin output from Bus ECC error (SED).
          function name McuMiNotification [0..1]: set at post-build, origin=Renesas_v1.0.0, default-value=NULL_PTR, regular-expression=[a-zA-Z][a-zA-Z0-9_]*  # This parameter contains notification function for MI notification. | The syntax for McuMiNotification should be provided as Mcu_EcmMINotification.
          function name McuNmiNotification [0..1]: set at post-build, origin=Renesas_v1.0.0, default-value=NULL_PTR, regular-expression=[a-zA-Z][a-zA-Z0-9_]*  # This parameter contains notification function for NMI notification. | The syntax for McuNmiNotification should be provided as Mcu_EcmNMINotification.
          function name McuEcmInitialNotification [0..1]: set at post-build, origin=Renesas_v1.0.2, default-value=NULL_PTR, regular-expression=[a-zA-Z][a-zA-Z0-9_]*  # This parameter is used for notify the upper layer, if any ECM error has been already detected at system start-up. | The syntax for McuEcmInitialNotification should be provided as Mcu_EcmInitialNotification.
        container McuEcmErrorSource32  # This container contains all the supported configuration parameters of the related error source from Local RAM error address overflow.
          boolean McuEcmErrorMaskableInterrupt: set at post-build, origin=Renesas_v1.0.0, default-value=false  # This parameter enables or disables generation of a maskable interrupt when the error occurs from Local RAM error address overflow. | true: enables generation of a maskable interrupt when the error occurs from Local RAM error address overflow. false: disables generation of a maskable interrupt when the error occurs from Local RAM error address overflow.
          boolean McuEcmErrorNonMaskableInterrupt: set at post-build, origin=Renesas_v1.0.0, default-value=false  # This parameter enables or disables generation of a non-maskable interrupt when the error occurs from Local RAM error address overflow. | true: enables generation of a non-maskable interrupt when the error occurs from Local RAM error address overflow. false: disables generation of a non-maskable interrupt when the error occurs from Local RAM error address overflow.
          boolean McuEcmErrorInternalReset: set at post-build, origin=Renesas_v1.0.0, default-value=false  # This parameter enables or disables generation of an internal reset when the error occurs from Local RAM error address overflow. | true: enables generation of an internal reset when the error occurs from Local RAM error address overflow. false: disables generation of an internal reset when the error occurs from Local RAM error address overflow.
          boolean McuEcmErrorNMIDelayTimer: set at post-build, origin=Renesas_v1.0.0, default-value=false  # This parameter enables or disables delay timer start caused by non-maskable interrupts in response to errors from Local RAM error address overflow. | true: enables delay timer start caused by non-maskable interrupts in response to errors from Local RAM error address overflow. false: disables delay timer start caused by non-maskable interrupts in response to errors from Local RAM error address overflow.
          boolean McuEcmErrorMIDelayTimer: set at post-build, origin=Renesas_v1.0.0, default-value=false  # This parameter enables or disables delay timer start caused by maskable interrupts in response to errors from Local RAM error address overflow. | true: enables delay timer start caused by maskable interrupts in response to errors from Local RAM error address overflow. false: disables delay timer start caused by maskable interrupts in response to errors from Local RAM error address overflow.
          boolean McuEcmErrorOutputMask: set at post-build, origin=Renesas_v1.0.0, default-value=true  # This parameter mask or unmask the individual error sources of the error pin output from Local RAM error address overflow. | true: mask the individual error sources of the error pin output from Local RAM error address overflow. false: unmask the individual error sources of the error pin output from Local RAM error address overflow.
          function name McuMiNotification [0..1]: set at post-build, origin=Renesas_v1.0.0, default-value=NULL_PTR, regular-expression=[a-zA-Z][a-zA-Z0-9_]*  # This parameter contains notification function for MI notification. | The syntax for McuMiNotification should be provided as Mcu_EcmMINotification.
          function name McuNmiNotification [0..1]: set at post-build, origin=Renesas_v1.0.0, default-value=NULL_PTR, regular-expression=[a-zA-Z][a-zA-Z0-9_]*  # This parameter contains notification function for NMI notification. | The syntax for McuNmiNotification should be provided as Mcu_EcmNMINotification.
          function name McuEcmInitialNotification [0..1]: set at post-build, origin=Renesas_v1.0.2, default-value=NULL_PTR, regular-expression=[a-zA-Z][a-zA-Z0-9_]*  # This parameter is used for notify the upper layer, if any ECM error has been already detected at system start-up. | The syntax for McuEcmInitialNotification should be provided as Mcu_EcmInitialNotification.
        container McuEcmErrorSource33  # This container contains all the supported configuration parameters of the related error source from Global RAM error address overflow.
          boolean McuEcmErrorMaskableInterrupt: set at post-build, origin=Renesas_v1.0.0, default-value=false  # This parameter enables or disables generation of a maskable interrupt when the error occurs from Global RAM error address overflow. | true: enables generation of a maskable interrupt when the error occurs from Global RAM error address overflow. false: disables generation of a maskable interrupt when the error occurs from Global RAM error address overflow.
          boolean McuEcmErrorNonMaskableInterrupt: set at post-build, origin=Renesas_v1.0.0, default-value=false  # This parameter enables or disables generation of a non-maskable interrupt when the error occurs from Global RAM error address overflow. | true: enables generation of a non-maskable interrupt when the error occurs from Global RAM error address overflow. false: disables generation of a non-maskable interrupt when the error occurs from Global RAM error address overflow.
          boolean McuEcmErrorInternalReset: set at post-build, origin=Renesas_v1.0.0, default-value=false  # This parameter enables or disables generation of an internal reset when the error occurs from Global RAM error address overflow. | true: enables generation of an internal reset when the error occurs from Global RAM error address overflow. false: disables generation of an internal reset when the error occurs from Global RAM error address overflow.
          boolean McuEcmErrorNMIDelayTimer: set at post-build, origin=Renesas_v1.0.0, default-value=false  # This parameter enables or disables delay timer start caused by non-maskable interrupts in response to errors from Global RAM error address overflow. | true: enables delay timer start caused by non-maskable interrupts in response to errors from Global RAM error address overflow. false: disables delay timer start caused by non-maskable interrupts in response to errors from Global RAM error address overflow.
          boolean McuEcmErrorMIDelayTimer: set at post-build, origin=Renesas_v1.0.0, default-value=false  # This parameter enables or disables delay timer start caused by maskable interrupts in response to errors from Global RAM error address overflow. | true: enables delay timer start caused by maskable interrupts in response to errors from Global RAM error address overflow. false: disables delay timer start caused by maskable interrupts in response to errors from Global RAM error address overflow.
          boolean McuEcmErrorOutputMask: set at post-build, origin=Renesas_v1.0.0, default-value=true  # This parameter mask or unmask the individual error sources of the error pin output from Global RAM error address overflow. | true: mask the individual error sources of the error pin output from Global RAM error address overflow. false: unmask the individual error sources of the error pin output from Global RAM error address overflow.
          function name McuMiNotification [0..1]: set at post-build, origin=Renesas_v1.0.0, default-value=NULL_PTR, regular-expression=[a-zA-Z][a-zA-Z0-9_]*  # This parameter contains notification function for MI notification. | The syntax for McuMiNotification should be provided as Mcu_EcmMINotification.
          function name McuNmiNotification [0..1]: set at post-build, origin=Renesas_v1.0.0, default-value=NULL_PTR, regular-expression=[a-zA-Z][a-zA-Z0-9_]*  # This parameter contains notification function for NMI notification. | The syntax for McuNmiNotification should be provided as Mcu_EcmNMINotification.
          function name McuEcmInitialNotification [0..1]: set at post-build, origin=Renesas_v1.0.2, default-value=NULL_PTR, regular-expression=[a-zA-Z][a-zA-Z0-9_]*  # This parameter is used for notify the upper layer, if any ECM error has been already detected at system start-up. | The syntax for McuEcmInitialNotification should be provided as Mcu_EcmInitialNotification.
        container McuEcmErrorSource35  # This container contains all the supported configuration parameters of the related error source from Code Flash ECC error address overflow.
          boolean McuEcmErrorMaskableInterrupt: set at post-build, origin=Renesas_v1.0.0, default-value=false  # This parameter enables or disables generation of a maskable interrupt when the error occurs from Code Flash ECC error address overflow. | true: enables generation of a maskable interrupt when the error occurs from Code Flash ECC error address overflow. false: disables generation of a maskable interrupt when the error occurs from Code Flash ECC error address overflow.
          boolean McuEcmErrorNonMaskableInterrupt: set at post-build, origin=Renesas_v1.0.0, default-value=false  # This parameter enables or disables generation of a non-maskable interrupt when the error occurs from Code Flash ECC error address overflow. | true: enables generation of a non-maskable interrupt when the error occurs from Code Flash ECC error address overflow. false: disables generation of a non-maskable interrupt when the error occurs from Code Flash ECC error address overflow.
          boolean McuEcmErrorInternalReset: set at post-build, origin=Renesas_v1.0.0, default-value=false  # This parameter enables or disables generation of an internal reset when the error occurs from Code Flash ECC error address overflow. | true: enables generation of an internal reset when the error occurs from Code Flash ECC error address overflow. false: disables generation of an internal reset when the error occurs from Code Flash ECC error address overflow.
          boolean McuEcmErrorNMIDelayTimer: set at post-build, origin=Renesas_v1.0.0, default-value=false  # This parameter enables or disables delay timer start caused by non-maskable interrupts in response to errors from Code Flash ECC error address overflow. | true: enables delay timer start caused by non-maskable interrupts in response to errors from Code Flash ECC error address overflow. false: disables delay timer start caused by non-maskable interrupts in response to errors from Code Flash ECC error address overflow.
          boolean McuEcmErrorMIDelayTimer: set at post-build, origin=Renesas_v1.0.0, default-value=false  # This parameter enables or disables delay timer start caused by maskable interrupts in response to errors from Code Flash ECC error address overflow. | true: enables delay timer start caused by maskable interrupts in response to errors from Code Flash ECC error address overflow. false: disables delay timer start caused by maskable interrupts in response to errors from Code Flash ECC error address overflow.
          boolean McuEcmErrorOutputMask: set at post-build, origin=Renesas_v1.0.0, default-value=true  # This parameter mask or unmask the individual error sources of the error pin output from Code Flash ECC error address overflow. | true: mask the individual error sources of the error pin output from Code Flash ECC error address overflow. false: unmask the individual error sources of the error pin output from Code Flash ECC error address overflow.
          function name McuMiNotification [0..1]: set at post-build, origin=Renesas_v1.0.0, default-value=NULL_PTR, regular-expression=[a-zA-Z][a-zA-Z0-9_]*  # This parameter contains notification function for MI notification. | The syntax for McuMiNotification should be provided as Mcu_EcmMINotification.
          function name McuNmiNotification [0..1]: set at post-build, origin=Renesas_v1.0.0, default-value=NULL_PTR, regular-expression=[a-zA-Z][a-zA-Z0-9_]*  # This parameter contains notification function for NMI notification. | The syntax for McuNmiNotification should be provided as Mcu_EcmNMINotification.
          function name McuEcmInitialNotification [0..1]: set at post-build, origin=Renesas_v1.0.2, default-value=NULL_PTR, regular-expression=[a-zA-Z][a-zA-Z0-9_]*  # This parameter is used for notify the upper layer, if any ECM error has been already detected at system start-up. | The syntax for McuEcmInitialNotification should be provided as Mcu_EcmInitialNotification.
