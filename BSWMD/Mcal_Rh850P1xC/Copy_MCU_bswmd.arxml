[part 2 of 2: package /Renesas/EcucDefs_Mcu]
AUTOSAR XML (schema 4-0-3)
package /Renesas/EcucDefs_Mcu  (continued)
  module definition Mcu: refined-module-def=Mcu, variants post-build  (continued)
    container McuModuleConfiguration: multiple-configuration-container=true  (continued)
      container McuEcmErrorSourcesCfg  (continued)
        container McuEcmErrorSource36  # This container contains all the supported configuration parameters of the related error source from Data Flash ECC error address overflow.
          boolean McuEcmErrorMaskableInterrupt: set at post-build, origin=Renesas_v1.0.0, default-value=false  # This parameter enables or disables generation of a maskable interrupt when the error occurs from Data Flash ECC error address overflow. | true: enables generation of a maskable interrupt when the error occurs from Data Flash ECC error address overflow. false: disables generation of a maskable interrupt when the error occurs from Data Flash ECC error address overflow.
          boolean McuEcmErrorNonMaskableInterrupt: set at post-build, origin=Renesas_v1.0.0, default-value=false  # This parameter enables or disables generation of a non-maskable interrupt when the error occurs from Data Flash ECC error address overflow. | true: enables generation of a non-maskable interrupt when the error occurs from Data Flash ECC error address overflow. false: disables generation of a non-maskable interrupt when the error occurs from Data Flash ECC error address overflow.
          boolean McuEcmErrorInternalReset: set at post-build, origin=Renesas_v1.0.0, default-value=false  # This parameter enables or disables generation of an internal reset when the error occurs from Data Flash ECC error address overflow. | true: enables generation of an internal reset when the error occurs from Data Flash ECC error address overflow. false: disables generation of an internal reset when the error occurs from Data Flash ECC error address overflow.
          boolean McuEcmErrorNMIDelayTimer: set at post-build, origin=Renesas_v1.0.0, default-value=false  # This parameter enables or disables delay timer start caused by non-maskable interrupts in response to errors from Data Flash ECC error address overflow. | true: enables delay timer start caused by non-maskable interrupts in response to errors from Data Flash ECC error address overflow. false: disables delay timer start caused by non-maskable interrupts in response to errors from Data Flash ECC error address overflow.
          boolean McuEcmErrorMIDelayTimer: set at post-build, origin=Renesas_v1.0.0, default-value=false  # This parameter enables or disables delay timer start caused by maskable interrupts in response to errors from Data Flash ECC error address overflow. | true: enables delay timer start caused by maskable interrupts in response to errors Data Flash ECC error address overflow. false: disables delay timer start caused by maskable interrupts in response to errors from Data Flash ECC error address overflow.
          boolean McuEcmErrorOutputMask: set at post-build, origin=Renesas_v1.0.0, default-value=true  # This parameter mask or unmask the individual error sources of the error pin output from Data Flash ECC error address overflow. | true: mask the individual error sources of the error pin output from Data Flash ECC error address overflow. false: unmask the individual error sources of the error pin output from Data Flash ECC error address overflow.
          function name McuMiNotification [0..1]: set at post-build, origin=Renesas_v1.0.0, default-value=NULL_PTR, regular-expression=[a-zA-Z][a-zA-Z0-9_]*  # This parameter contains notification function for MI notification. | The syntax for McuMiNotification should be provided as Mcu_EcmMINotification.
          function name McuNmiNotification [0..1]: set at post-build, origin=Renesas_v1.0.0, default-value=NULL_PTR, regular-expression=[a-zA-Z][a-zA-Z0-9_]*  # This parameter contains notification function for NMI notification. | The syntax for McuNmiNotification should be provided as Mcu_EcmNMINotification.
          function name McuEcmInitialNotification [0..1]: set at post-build, origin=Renesas_v1.0.2, default-value=NULL_PTR, regular-expression=[a-zA-Z][a-zA-Z0-9_]*  # This parameter is used for notify the upper layer, if any ECM error has been already detected at system start-up. | The syntax for McuEcmInitialNotification should be provided as Mcu_EcmInitialNotification.
        container McuEcmErrorSource37  # This container contains all the supported configuration parameters of the related error source from peripheral RAM ECC error address overflow.
          boolean McuEcmErrorMaskableInterrupt: set at post-build, origin=Renesas_v1.0.0, default-value=false  # This parameter enables or disables generation of a maskable interrupt when the error occurs due to peripheral RAM ECC error address overflow. | true: enables generation of a maskable interrupt when the error occurs due to peripheral RAM ECC error address overflow. false: disables generation of a maskable interrupt when the error occurs due to peripheral RAM ECC error address overflow.
          boolean McuEcmErrorNonMaskableInterrupt: set at post-build, origin=Renesas_v1.0.0, default-value=false  # This parameter enables or disables generation of a non-maskable interrupt when the error occurs due to peripheral RAM ECC error address overflow. | true: enables generation of a non-maskable interrupt when the error occurs due to peripheral RAM ECC error address overflow. false: disables generation of a non-maskable interrupt when the error occurs due to peripheral RAM ECC error address overflow.
          boolean McuEcmErrorInternalReset: set at post-build, origin=Renesas_v1.0.0, default-value=false  # This parameter enables or disables generation of an internal reset when the error occurs due to peripheral RAM ECC error address overflow. | true: enables generation of an internal reset when the error occurs due to peripheral RAM ECC error address overflow. false: disables generation of an internal reset when the error occurs due to peripheral RAM ECC error address overflow.
          boolean McuEcmErrorNMIDelayTimer: set at post-build, origin=Renesas_v1.0.0, default-value=false  # This parameter enables or disables delay timer start caused by non-maskable interrupts in response to error occurred due to peripheral RAM ECC error address overflow. | true: enables delay timer start caused by non-maskable interrupts in response to error occurred due to peripheral RAM ECC error address overflow. false: disables delay timer start caused by non-maskable interrupts in response to error occurred due to peripheral RAM ECC error address overflow.
          boolean McuEcmErrorMIDelayTimer: set at post-build, origin=Renesas_v1.0.0, default-value=false  # This parameter enables or disables delay timer start caused by maskable interrupts in response to errors from peripheral RAM ECC error address overflow. | true: enables delay timer start caused by maskable interrupts in response to error occurred due to peripheral RAM ECC error address overflow. false: disables delay timer start caused by maskable interrupts in response to error occurred due to peripheral RAM ECC error address overflow.
          boolean McuEcmErrorOutputMask: set at post-build, origin=Renesas_v1.0.0, default-value=true  # This parameter mask or unmask the individual error sources of the error pin output from peripheral RAM ECC error address overflow. | true: mask the individual error sources of the error pin output from peripheral RAM ECC error address overflow. false: unmask the individual error sources of the error pin output from peripheral RAM ECC error address overflow.
          function name McuMiNotification [0..1]: set at post-build, origin=Renesas_v1.0.0, default-value=NULL_PTR, regular-expression=[a-zA-Z][a-zA-Z0-9_]*  # This parameter contains notification function for MI notification. | The syntax for McuMiNotification should be provided as Mcu_EcmMINotification.
          function name McuNmiNotification [0..1]: set at post-build, origin=Renesas_v1.0.0, default-value=NULL_PTR, regular-expression=[a-zA-Z][a-zA-Z0-9_]*  # This parameter contains notification function for NMI notification. | The syntax for McuNmiNotification should be provided as Mcu_EcmNMINotification.
          function name McuEcmInitialNotification [0..1]: set at post-build, origin=Renesas_v1.0.2, default-value=NULL_PTR, regular-expression=[a-zA-Z][a-zA-Z0-9_]*  # This parameter is used for notify the upper layer, if any ECM error has been already detected at system start-up. | The syntax for McuEcmInitialNotification should be provided as Mcu_EcmInitialNotification.
        container McuEcmErrorSource40  # This container contains all the supported configuration parameters of the related error source from DTS RAM ECC(DED).
          boolean McuEcmErrorMaskableInterrupt: set at post-build, origin=Renesas_v1.0.0, default-value=false  # This parameter enables or disables generation of a maskable interrupt when the error occurs from DTS RAM ECC(DED). | true: enables generation of a maskable interrupt when the error occurs from DTS RAM ECC(DED). false: disables generation of a maskable interrupt when the error occurs from DTS RAM ECC(DED).
          boolean McuEcmErrorNonMaskableInterrupt: set at post-build, origin=Renesas_v1.0.0, default-value=false  # This parameter enables or disables generation of a non-maskable interrupt when the error occurs from DTS RAM ECC(DED). | true: enables generation of a non-maskable interrupt when the error occurs from DTS RAM ECC(DED). false: disables generation of a non-maskable interrupt when the error occurs from DTS RAM ECC(DED).
          boolean McuEcmErrorInternalReset: set at post-build, origin=Renesas_v1.0.0, default-value=false  # This parameter enables or disables generation of an internal reset when the error occurs from DTS RAM ECC(DED). | true: enables generation of an internal reset when the error occurs from DTS RAM ECC(DED). false: disables generation of an internal reset when the error occurs from DTS RAM ECC(DED).
          boolean McuEcmErrorNMIDelayTimer: set at post-build, origin=Renesas_v1.0.0, default-value=false  # This parameter enables or disables delay timer start caused by non-maskable interrupts in response to errors from DTS RAM ECC(DED). | true: enables delay timer start caused by non-maskable interrupts in response to errors from DTS RAM ECC(DED). false: disables delay timer start caused by non-maskable interrupts in response to errors from DTS RAM ECC(DED).
          boolean McuEcmErrorMIDelayTimer: set at post-build, origin=Renesas_v1.0.0, default-value=false  # This parameter enables or disables delay timer start caused by maskable interrupts in response to errors from DTS RAM ECC(DED). | true: enables delay timer start caused by maskable interrupts in response to errors from DTS RAM ECC(DED). false: disables delay timer start caused by maskable interrupts in response to errors from DTS RAM ECC(DED).
          boolean McuEcmErrorOutputMask: set at post-build, origin=Renesas_v1.0.0, default-value=true  # This parameter mask or unmask the individual error sources of the error pin output from DTS RAM ECC(DED). | true: mask the individual error sources of the error pin output from DTS RAM ECC(DED). false: unmask the individual error sources of the error pin output from DTS RAM ECC(DED).
          function name McuMiNotification [0..1]: set at post-build, origin=Renesas_v1.0.0, default-value=NULL_PTR, regular-expression=[a-zA-Z][a-zA-Z0-9_]*  # This parameter contains notification function for MI notification. | The syntax for McuMiNotification should be provided as Mcu_EcmMINotification.
          function name McuNmiNotification [0..1]: set at post-build, origin=Renesas_v1.0.0, default-value=NULL_PTR, regular-expression=[a-zA-Z][a-zA-Z0-9_]*  # This parameter contains notification function for NMI notification. | The syntax for McuNmiNotification should be provided as Mcu_EcmNMINotification.
          function name McuEcmInitialNotification [0..1]: set at post-build, origin=Renesas_v1.0.2, default-value=NULL_PTR, regular-expression=[a-zA-Z][a-zA-Z0-9_]*  # This parameter is used for notify the upper layer, if any ECM error has been already detected at system start-up. | The syntax for McuEcmInitialNotification should be provided as Mcu_EcmInitialNotification.
        container McuEcmErrorSource41  # This container contains all the supported configuration parameters of the related error source from DTS RAM ECC(SED).
          boolean McuEcmErrorMaskableInterrupt: set at post-build, origin=Renesas_v1.0.0, default-value=false  # This parameter enables or disables generation of a maskable interrupt when the error occurs from DTS RAM ECC(SED). | true: enables generation of a maskable interrupt when the error occurs from DTS RAM ECC(SED). false: disables generation of a maskable interrupt when the error occurs from DTS RAM ECC(SED).
          boolean McuEcmErrorNonMaskableInterrupt: set at post-build, origin=Renesas_v1.0.0, default-value=false  # This parameter enables or disables generation of a non-maskable interrupt when the error occurs from DTS RAM ECC(SED). | true: enables generation of a non-maskable interrupt when the error occurs from DTS RAM ECC(SED). false: disables generation of a non-maskable interrupt when the error occurs from DTS RAM ECC(SED).
          boolean McuEcmErrorInternalReset: set at post-build, origin=Renesas_v1.0.0, default-value=false  # This parameter enables or disables generation of an internal reset when the error occurs from DTS RAM ECC(SED). | true: enables generation of an internal reset when the error occurs from DTS RAM ECC(SED). false: disables generation of an internal reset when the error occurs from DTS RAM ECC(SED).
          boolean McuEcmErrorNMIDelayTimer: set at post-build, origin=Renesas_v1.0.0, default-value=false  # This parameter enables or disables delay timer start caused by non-maskable interrupts in response to errors from DTS RAM ECC(SED). | true: enables delay timer start caused by non-maskable interrupts in response to errors from DTS RAM ECC(SED). false: disables delay timer start caused by non-maskable interrupts in response to errors from DTS RAM ECC(SED).
          boolean McuEcmErrorMIDelayTimer: set at post-build, origin=Renesas_v1.0.0, default-value=false  # This parameter enables or disables delay timer start caused by maskable interrupts in response to errors from DTS RAM ECC(SED). | true: enables delay timer start caused by maskable interrupts in response to errors from DTS RAM ECC(SED). false: disables delay timer start caused by maskable interrupts in response to errors from DTS RAM ECC(SED).
          boolean McuEcmErrorOutputMask: set at post-build, origin=Renesas_v1.0.0, default-value=true  # This parameter mask or unmask the individual error sources of the error pin output from DTS RAM ECC(SED). | true: mask the individual error sources of the error pin output from DTS RAM ECC(SED). false: unmask the individual error sources of the error pin output from DTS RAM ECC(SED).
          function name McuMiNotification [0..1]: set at post-build, origin=Renesas_v1.0.0, default-value=NULL_PTR, regular-expression=[a-zA-Z][a-zA-Z0-9_]*  # This parameter contains notification function for MI notification. | The syntax for McuMiNotification should be provided as Mcu_EcmMINotification.
          function name McuNmiNotification [0..1]: set at post-build, origin=Renesas_v1.0.0, default-value=NULL_PTR, regular-expression=[a-zA-Z][a-zA-Z0-9_]*  # This parameter contains notification function for NMI notification. | The syntax for McuNmiNotification should be provided as Mcu_EcmNMINotification.
          function name McuEcmInitialNotification [0..1]: set at post-build, origin=Renesas_v1.0.2, default-value=NULL_PTR, regular-expression=[a-zA-Z][a-zA-Z0-9_]*  # This parameter is used for notify the upper layer, if any ECM error has been already detected at system start-up. | The syntax for McuEcmInitialNotification should be provided as Mcu_EcmInitialNotification.
        container McuEcmErrorSource48  # This container contains all the supported configuration parameters of the related error source from Local RAM ECC(SED).
          boolean McuEcmErrorMaskableInterrupt: set at post-build, origin=Renesas_v1.0.0, default-value=false  # This parameter enables or disables generation of a maskable interrupt when the error occurs from Local RAM ECC(SED). | true: enables generation of a maskable interrupt when the error occurs from Local RAM ECC(SED). false: disables generation of a maskable interrupt when the error occurs from Local RAM ECC(SED).
          boolean McuEcmErrorNonMaskableInterrupt: set at post-build, origin=Renesas_v1.0.0, default-value=false  # This parameter enables or disables generation of a non-maskable interrupt when the error occurs from Local RAM ECC(SED). | true: enables generation of a non-maskable interrupt when the error occurs from Local RAM ECC(SED). false: disables generation of a non-maskable interrupt when the error occurs from Local RAM ECC(SED).
          boolean McuEcmErrorInternalReset: set at post-build, origin=Renesas_v1.0.0, default-value=false  # This parameter enables or disables generation of an internal reset when the error occurs from Local RAM ECC(SED). | true: enables generation of an internal reset when the error occurs from Local RAM ECC(SED). false: disables generation of an internal reset when the error occurs from Local RAM ECC(SED).
          boolean McuEcmErrorNMIDelayTimer: set at post-build, origin=Renesas_v1.0.0, default-value=false  # This parameter enables or disables delay timer start caused by non-maskable interrupts in response to errors from Local RAM ECC(SED). | true: enables delay timer start caused by non-maskable interrupts in response to errors from Local RAM ECC(SED). false: disables delay timer start caused by non-maskable interrupts in response to errors from Local RAM ECC(SED).
          boolean McuEcmErrorMIDelayTimer: set at post-build, origin=Renesas_v1.0.0, default-value=false  # This parameter enables or disables delay timer start caused by maskable interrupts in response to errors from Local RAM ECC(SED). | true: enables delay timer start caused by maskable interrupts in response to errors from Local RAM ECC(SED). false: disables delay timer start caused by maskable interrupts in response to errors from Local RAM ECC(SED).
          boolean McuEcmErrorOutputMask: set at post-build, origin=Renesas_v1.0.0, default-value=true  # This parameter mask or unmask the individual error sources of the error pin output from Local RAM ECC(SED). | true: mask the individual error sources of the error pin output from Local RAM ECC(SED). false: unmask the individual error sources of the error pin output from Local RAM ECC(SED).
          function name McuMiNotification [0..1]: set at post-build, origin=Renesas_v1.0.0, default-value=NULL_PTR, regular-expression=[a-zA-Z][a-zA-Z0-9_]*  # This parameter contains notification function for MI notification. | The syntax for McuMiNotification should be provided as Mcu_EcmMINotification.
          function name McuNmiNotification [0..1]: set at post-build, origin=Renesas_v1.0.0, default-value=NULL_PTR, regular-expression=[a-zA-Z][a-zA-Z0-9_]*  # This parameter contains notification function for NMI notification. | The syntax for McuNmiNotification should be provided as Mcu_EcmNMINotification.
          function name McuEcmInitialNotification [0..1]: set at post-build, origin=Renesas_v1.0.2, default-value=NULL_PTR, regular-expression=[a-zA-Z][a-zA-Z0-9_]*  # This parameter is used for notify the upper layer, if any ECM error has been already detected at system start-up. | The syntax for McuEcmInitialNotification should be provided as Mcu_EcmInitialNotification.
        container McuEcmErrorSource49  # This container contains all the supported configuration parameters of the related error source from Clock monitor for Global RAM ECC(SED).
          boolean McuEcmErrorMaskableInterrupt: set at post-build, origin=Renesas_v1.0.0, default-value=false  # This parameter enables or disables generation of a maskable interrupt when the error occurs from Clock monitor for Global RAM ECC(SED). | true: enables generation of a maskable interrupt when the error occurs from Clock monitor for Global RAM ECC(SED). false: disables generation of a maskable interrupt when the error occurs from Clock monitor for Global RAM ECC(SED).
          boolean McuEcmErrorNonMaskableInterrupt: set at post-build, origin=Renesas_v1.0.0, default-value=false  # This parameter enables or disables generation of a non-maskable interrupt when the error occurs from Clock monitor for Global RAM ECC(SED). | true: enables generation of a non-maskable interrupt when the error occurs from Clock monitor for Global RAM ECC(SED). false: disables generation of a non-maskable interrupt when the error occurs from Clock monitor for Global RAM ECC(SED).
          boolean McuEcmErrorInternalReset: set at post-build, origin=Renesas_v1.0.0, default-value=false  # This parameter enables or disables generation of an internal reset when the error occurs from Clock monitor for Global RAM ECC(SED). | true: enables generation of an internal reset when the error occurs from Clock monitor for Global RAM ECC(SED). false: disables generation of an internal reset when the error occurs from Clock monitor for Global RAM ECC(SED).
          boolean McuEcmErrorNMIDelayTimer: set at post-build, origin=Renesas_v1.0.0, default-value=false  # This parameter enables or disables delay timer start caused by non-maskable interrupts in response to errors from Clock monitor for Global RAM ECC(SED). | true: enables delay timer start caused by non-maskable interrupts in response to errors from Clock monitor for Global RAM ECC(SED). false: disables delay timer start caused by non-maskable interrupts in response to errors from Clock monitor for Global RAM ECC(SED).
          boolean McuEcmErrorMIDelayTimer: set at post-build, origin=Renesas_v1.0.0, default-value=false  # This parameter enables or disables delay timer start caused by maskable interrupts in response to errors from Clock monitor for Global RAM ECC(SED). | true: enables delay timer start caused by maskable interrupts in response to errors from Clock monitor for Global RAM ECC(SED). false: disables delay timer start caused by maskable interrupts in response to errors from Clock monitor for Global RAM ECC(SED).
          boolean McuEcmErrorOutputMask: set at post-build, origin=Renesas_v1.0.0, default-value=true  # This parameter mask or unmask the individual error sources of the error pin output from Clock monitor for Global RAM ECC(SED). | true: mask the individual error sources of the error pin output from Clock monitor for Global RAM ECC(SED). false: unmask the individual error sources of the error pin output from Clock monitor for Global RAM ECC(SED).
          function name McuMiNotification [0..1]: set at post-build, origin=Renesas_v1.0.0, default-value=NULL_PTR, regular-expression=[a-zA-Z][a-zA-Z0-9_]*  # This parameter contains notification function for MI notification. | The syntax for McuMiNotification should be provided as Mcu_EcmMINotification.
          function name McuNmiNotification [0..1]: set at post-build, origin=Renesas_v1.0.0, default-value=NULL_PTR, regular-expression=[a-zA-Z][a-zA-Z0-9_]*  # This parameter contains notification function for NMI notification. | The syntax for McuNmiNotification should be provided as Mcu_EcmNMINotification.
          function name McuEcmInitialNotification [0..1]: set at post-build, origin=Renesas_v1.0.2, default-value=NULL_PTR, regular-expression=[a-zA-Z][a-zA-Z0-9_]*  # This parameter is used for notify the upper layer, if any ECM error has been already detected at system start-up. | The syntax for McuEcmInitialNotification should be provided as Mcu_EcmInitialNotification.
        container McuEcmErrorSource51  # This container contains all the supported configuration parameters of the related error source from Code flash ECC(SED).
          boolean McuEcmErrorMaskableInterrupt: set at post-build, origin=Renesas_v1.0.0, default-value=false  # This parameter enables or disables generation of a maskable interrupt when the error occurs from Code flash ECC(SED). | true: enables generation of a maskable interrupt when the error occurs from Code flash ECC(SED). false: disables generation of a maskable interrupt when the error occurs from Code flash ECC(SED).
          boolean McuEcmErrorNonMaskableInterrupt: set at post-build, origin=Renesas_v1.0.0, default-value=false  # This parameter enables or disables generation of a non-maskable interrupt when the error occurs from Code flash ECC(SED). | true: enables generation of a non-maskable interrupt when the error occurs from Code flash ECC(SED). false: disables generation of a non-maskable interrupt when the error occurs from Code flash ECC(SED).
          boolean McuEcmErrorInternalReset: set at post-build, origin=Renesas_v1.0.0, default-value=false  # This parameter enables or disables generation of an internal reset when the error occurs from Code flash ECC(SED). | true: enables generation of an internal reset when the error occurs from Code flash ECC(SED). false: disables generation of an internal reset when the error occurs from Code flash ECC(SED).
          boolean McuEcmErrorNMIDelayTimer: set at post-build, origin=Renesas_v1.0.0, default-value=false  # This parameter enables or disables delay timer start caused by non-maskable interrupts in response to errors from Code flash ECC(SED). | true: enables delay timer start caused by non-maskable interrupts in response to errors from Code flash ECC(SED). false: disables delay timer start caused by non-maskable interrupts in response to errors from Code flash ECC(SED).
          boolean McuEcmErrorMIDelayTimer: set at post-build, origin=Renesas_v1.0.0, default-value=false  # This parameter enables or disables delay timer start caused by maskable interrupts in response to errors from Code flash ECC(SED). | true: enables delay timer start caused by maskable interrupts in response to errors from Code flash ECC(SED). false: disables delay timer start caused by maskable interrupts in response to errors from Code flash ECC(SED).
          boolean McuEcmErrorOutputMask: set at post-build, origin=Renesas_v1.0.0, default-value=true  # This parameter mask or unmask the individual error sources of the error pin output from Code flash ECC(SED). | true: mask the individual error sources of the error pin output from Code flash ECC(SED). false: unmask the individual error sources of the error pin output from Code flash ECC(SED).
          function name McuMiNotification [0..1]: set at post-build, origin=Renesas_v1.0.0, default-value=NULL_PTR, regular-expression=[a-zA-Z][a-zA-Z0-9_]*  # This parameter contains notification function for MI notification. | The syntax for McuMiNotification should be provided as Mcu_EcmMINotification.
          function name McuNmiNotification [0..1]: set at post-build, origin=Renesas_v1.0.0, default-value=NULL_PTR, regular-expression=[a-zA-Z][a-zA-Z0-9_]*  # This parameter contains notification function for NMI notification. | The syntax for McuNmiNotification should be provided as Mcu_EcmNMINotification.
          function name McuEcmInitialNotification [0..1]: set at post-build, origin=Renesas_v1.0.2, default-value=NULL_PTR, regular-expression=[a-zA-Z][a-zA-Z0-9_]*  # This parameter is used for notify the upper layer, if any ECM error has been already detected at system start-up. | The syntax for McuEcmInitialNotification should be provided as Mcu_EcmInitialNotification.
        container McuEcmErrorSource52  # This container contains all the supported configuration parameters of the related error source from Data flash ECC(SED).
          boolean McuEcmErrorMaskableInterrupt: set at post-build, origin=Renesas_v1.0.0, default-value=false  # This parameter enables or disables generation of a maskable interrupt when the error occurs from Data flash ECC(SED). | true: enables generation of a maskable interrupt when the error occurs from Data flash ECC(SED). false: disables generation of a maskable interrupt when the error occurs from Data flash ECC(SED).
          boolean McuEcmErrorNonMaskableInterrupt: set at post-build, origin=Renesas_v1.0.0, default-value=false  # This parameter enables or disables generation of a non-maskable interrupt when the error occurs from Data flash ECC(SED). | true: enables generation of a non-maskable interrupt when the error occurs from Data flash ECC(SED). false: disables generation of a non-maskable interrupt when the error occurs from Data flash ECC(SED).
          boolean McuEcmErrorInternalReset: set at post-build, origin=Renesas_v1.0.0, default-value=false  # This parameter enables or disables generation of an internal reset when the error occurs from Data flash ECC(SED). | true: enables generation of an internal reset when the error occurs from Data flash ECC(SED). false: disables generation of an internal reset when the error occurs from Data flash ECC(SED).
          boolean McuEcmErrorNMIDelayTimer: set at post-build, origin=Renesas_v1.0.0, default-value=false  # This parameter enables or disables delay timer start caused by non-maskable interrupts in response to errors from Data flash ECC(SED). | true: enables delay timer start caused by non-maskable interrupts in response to errors from Data flash ECC(SED). false: disables delay timer start caused by non-maskable interrupts in response to errors from Data flash ECC(SED).
          boolean McuEcmErrorMIDelayTimer: set at post-build, origin=Renesas_v1.0.0, default-value=false  # This parameter enables or disables delay timer start caused by maskable interrupts in response to errors from Data flash ECC(SED). | true: enables delay timer start caused by maskable interrupts in response to errors from Data flash ECC(SED). false: disables delay timer start caused by maskable interrupts in response to errors from Data flash ECC(SED).
          boolean McuEcmErrorOutputMask: set at post-build, origin=Renesas_v1.0.0, default-value=true  # This parameter mask or unmask the individual error sources of the error pin output from Data flash ECC(SED). | true: mask the individual error sources of the error pin output from Data flash ECC(SED). false: unmask the individual error sources of the error pin output from Data flash ECC(SED).
          function name McuMiNotification [0..1]: set at post-build, origin=Renesas_v1.0.0, default-value=NULL_PTR, regular-expression=[a-zA-Z][a-zA-Z0-9_]*  # This parameter contains notification function for MI notification. | The syntax for McuMiNotification should be provided as Mcu_EcmMINotification.
          function name McuNmiNotification [0..1]: set at post-build, origin=Renesas_v1.0.0, default-value=NULL_PTR, regular-expression=[a-zA-Z][a-zA-Z0-9_]*  # This parameter contains notification function for NMI notification. | The syntax for McuNmiNotification should be provided as Mcu_EcmNMINotification.
          function name McuEcmInitialNotification [0..1]: set at post-build, origin=Renesas_v1.0.2, default-value=NULL_PTR, regular-expression=[a-zA-Z][a-zA-Z0-9_]*  # This parameter is used for notify the upper layer, if any ECM error has been already detected at system start-up. | The syntax for McuEcmInitialNotification should be provided as Mcu_EcmInitialNotification.
        container McuEcmErrorSource53  # This container contains all the supported configuration parameters of the related error source from CSIH RAM ECC error(SED).
          boolean McuEcmErrorMaskableInterrupt: set at post-build, origin=Renesas_v1.0.0, default-value=false  # This parameter enables or disables generation of a maskable interrupt when the error occurs from CSIH RAM ECC error(SED). | true: enables generation of a maskable interrupt when the error occurs from CSIH RAM ECC error(SED). false: disables generation of a maskable interrupt when the error occurs from CSIH RAM ECC error(SED).
          boolean McuEcmErrorNonMaskableInterrupt: set at post-build, origin=Renesas_v1.0.0, default-value=false  # This parameter enables or disables generation of a non-maskable interrupt when the error occurs from CSIH RAM ECC error(SED). | true: enables generation of a non-maskable interrupt when the error occurs from CSIH RAM ECC error(SED). false: disables generation of a non-maskable interrupt when the error occurs from CSIH RAM ECC error(SED).
          boolean McuEcmErrorInternalReset: set at post-build, origin=Renesas_v1.0.0, default-value=false  # This parameter enables or disables generation of an internal reset when the error occurs from CSIH RAM ECC error(SED). | true: enables generation of an internal reset when the error occurs from CSIH RAM ECC error(SED). false: disables generation of an internal reset when the error occurs from CSIH RAM ECC error(SED).
          boolean McuEcmErrorNMIDelayTimer: set at post-build, origin=Renesas_v1.0.0, default-value=false  # This parameter enables or disables delay timer start caused by non-maskable interrupts in response to errors from CSIH RAM ECC error(SED). | true: enables delay timer start caused by non-maskable interrupts in response to errors from CSIH RAM ECC error(SED). false: disables delay timer start caused by non-maskable interrupts in response to errors from CSIH RAM ECC error(SED).
          boolean McuEcmErrorMIDelayTimer: set at post-build, origin=Renesas_v1.0.0, default-value=false  # This parameter enables or disables delay timer start caused by maskable interrupts in response to errors from CSIH RAM ECC error(SED). | true: enables delay timer start caused by maskable interrupts in response to errors from CSIH RAM ECC error(SED). false: disables delay timer start caused by maskable interrupts in response to errors from CSIH RAM ECC error(SED).
          boolean McuEcmErrorOutputMask: set at post-build, origin=Renesas_v1.0.0, default-value=true  # This parameter mask or unmask the individual error sources of the error pin output from CSIH RAM ECC error(SED). | true: mask the individual error sources of the error pin output from CSIH RAM ECC error(SED). false: unmask the individual error sources of the error pin output from CSIH RAM ECC error(SED).
          function name McuMiNotification [0..1]: set at post-build, origin=Renesas_v1.0.0, default-value=NULL_PTR, regular-expression=[a-zA-Z][a-zA-Z0-9_]*  # This parameter contains notification function for MI notification. | The syntax for McuMiNotification should be provided as Mcu_EcmMINotification.
          function name McuNmiNotification [0..1]: set at post-build, origin=Renesas_v1.0.0, default-value=NULL_PTR, regular-expression=[a-zA-Z][a-zA-Z0-9_]*  # This parameter contains notification function for NMI notification. | The syntax for McuNmiNotification should be provided as Mcu_EcmNMINotification.
          function name McuEcmInitialNotification [0..1]: set at post-build, origin=Renesas_v1.0.2, default-value=NULL_PTR, regular-expression=[a-zA-Z][a-zA-Z0-9_]*  # This parameter is used for notify the upper layer, if any ECM error has been already detected at system start-up. | The syntax for McuEcmInitialNotification should be provided as Mcu_EcmInitialNotification.
        container McuEcmErrorSource54  # This container contains all the supported configuration parameters of the related error source from CAN RAM ECC error(SED).
          boolean McuEcmErrorMaskableInterrupt: set at post-build, origin=Renesas_v1.0.0, default-value=false  # This parameter enables or disables generation of a maskable interrupt when the error occurs from CAN RAM ECC error(SED). | true: enables generation of a maskable interrupt when the error occurs from CAN RAM ECC error(SED). false: disables generation of a maskable interrupt when the error occurs from CAN RAM ECC error(SED).
          boolean McuEcmErrorNonMaskableInterrupt: set at post-build, origin=Renesas_v1.0.0, default-value=false  # This parameter enables or disables generation of a non-maskable interrupt when the error occurs from CAN RAM ECC error(SED). | true: enables generation of a non-maskable interrupt when the error occurs from CAN RAM ECC error(SED). false: disables generation of a non-maskable interrupt when the error occurs from CAN RAM ECC error(SED).
          boolean McuEcmErrorInternalReset: set at post-build, origin=Renesas_v1.0.0, default-value=false  # This parameter enables or disables generation of an internal reset when the error occurs from CAN RAM ECC error(SED). | true: enables generation of an internal reset when the error occurs from CAN RAM ECC error(SED). false: disables generation of an internal reset when the error occurs from CAN RAM ECC error(SED).
          boolean McuEcmErrorNMIDelayTimer: set at post-build, origin=Renesas_v1.0.0, default-value=false  # This parameter enables or disables delay timer start caused by non-maskable interrupts in response to errors from CAN RAM ECC error(SED). | true: enables delay timer start caused by non-maskable interrupts in response to errors from CAN RAM ECC error(SED). false: disables delay timer start caused by non-maskable interrupts in response to errors from CAN RAM ECC error(SED).
          boolean McuEcmErrorMIDelayTimer: set at post-build, origin=Renesas_v1.0.0, default-value=false  # This parameter enables or disables delay timer start caused by maskable interrupts in response to errors from CAN RAM ECC error(SED). | true: enables delay timer start caused by maskable interrupts in response to errors from CAN RAM ECC error(SED). false: disables delay timer start caused by maskable interrupts in response to errors from CAN RAM ECC error(SED).
          boolean McuEcmErrorOutputMask: set at post-build, origin=Renesas_v1.0.0, default-value=true  # This parameter mask or unmask the individual error sources of the error pin output from CAN RAM ECC error(SED). | true: mask the individual error sources of the error pin output from CAN RAM ECC error(SED). false: unmask the individual error sources of the error pin output from CAN RAM ECC error(SED).
          function name McuMiNotification [0..1]: set at post-build, origin=Renesas_v1.0.0, default-value=NULL_PTR, regular-expression=[a-zA-Z][a-zA-Z0-9_]*  # This parameter contains notification function for MI notification. | The syntax for McuMiNotification should be provided as Mcu_EcmMINotification.
          function name McuNmiNotification [0..1]: set at post-build, origin=Renesas_v1.0.0, default-value=NULL_PTR, regular-expression=[a-zA-Z][a-zA-Z0-9_]*  # This parameter contains notification function for NMI notification. | The syntax for McuNmiNotification should be provided as Mcu_EcmNMINotification.
          function name McuEcmInitialNotification [0..1]: set at post-build, origin=Renesas_v1.0.2, default-value=NULL_PTR, regular-expression=[a-zA-Z][a-zA-Z0-9_]*  # This parameter is used for notify the upper layer, if any ECM error has been already detected at system start-up. | The syntax for McuEcmInitialNotification should be provided as Mcu_EcmInitialNotification.
        container McuEcmErrorSource55  # This container contains all the supported configuration parameters of the related error source from Ethernet RAM ECC error(SED).
          boolean McuEcmErrorMaskableInterrupt: set at post-build, origin=Renesas_v1.0.0, default-value=false  # This parameter enables or disables generation of a maskable interrupt when the error occurs from Ethernet RAM ECC error(SED). | true: enables generation of a maskable interrupt when the error occurs from Ethernet RAM ECC error(SED). false: disables generation of a maskable interrupt when the error occurs from Ethernet RAM ECC error(SED).
          boolean McuEcmErrorNonMaskableInterrupt: set at post-build, origin=Renesas_v1.0.0, default-value=false  # This parameter enables or disables generation of a non-maskable interrupt when the error occurs from Ethernet RAM ECC error(SED). | true: enables generation of a non-maskable interrupt when the error occurs from Ethernet RAM ECC error(SED). false: disables generation of a non-maskable interrupt when the error occurs from Ethernet RAM ECC error(SED).
          boolean McuEcmErrorInternalReset: set at post-build, origin=Renesas_v1.0.0, default-value=false  # This parameter enables or disables generation of an internal reset when the error occurs from Ethernet RAM ECC error(SED). | true: enables generation of an internal reset when the error occurs from Ethernet RAM ECC error(SED). false: disables generation of an internal reset when the error occurs from Ethernet RAM ECC error(SED).
          boolean McuEcmErrorNMIDelayTimer: set at post-build, origin=Renesas_v1.0.0, default-value=false  # This parameter enables or disables delay timer start caused by non-maskable interrupts in response to errors from Ethernet RAM ECC error(SED). | true: enables delay timer start caused by non-maskable interrupts in response to errors from Ethernet RAM ECC error(SED). false: disables delay timer start caused by non-maskable interrupts in response to errors from Ethernet RAM ECC error(SED).
          boolean McuEcmErrorMIDelayTimer: set at post-build, origin=Renesas_v1.0.0, default-value=false  # This parameter enables or disables delay timer start caused by maskable interrupts in response to errors from Ethernet RAM ECC error(SED). | true: enables delay timer start caused by maskable interrupts in response to errors from Ethernet RAM ECC error(SED). false: disables delay timer start caused by maskable interrupts in response to errors from Ethernet RAM ECC error(SED).
          boolean McuEcmErrorOutputMask: set at post-build, origin=Renesas_v1.0.0, default-value=true  # This parameter mask or unmask the individual error sources of the error pin output from Ethernet RAM ECC error(SED). | true: mask the individual error sources of the error pin output from Ethernet RAM ECC error(SED). false: unmask the individual error sources of the error pin output from Ethernet RAM ECC error(SED).
          function name McuMiNotification [0..1]: set at post-build, origin=Renesas_v1.0.0, default-value=NULL_PTR, regular-expression=[a-zA-Z][a-zA-Z0-9_]*  # This parameter contains notification function for MI notification. | The syntax for McuMiNotification should be provided as Mcu_EcmMINotification.
          function name McuNmiNotification [0..1]: set at post-build, origin=Renesas_v1.0.0, default-value=NULL_PTR, regular-expression=[a-zA-Z][a-zA-Z0-9_]*  # This parameter contains notification function for NMI notification. | The syntax for McuNmiNotification should be provided as Mcu_EcmNMINotification.
          function name McuEcmInitialNotification [0..1]: set at post-build, origin=Renesas_v1.0.2, default-value=NULL_PTR, regular-expression=[a-zA-Z][a-zA-Z0-9_]*  # This parameter is used for notify the upper layer, if any ECM error has been already detected at system start-up. | The syntax for McuEcmInitialNotification should be provided as Mcu_EcmInitialNotification.
        container McuEcmErrorSource56  # This container contains all the supported configuration parameters of the related error source from FlexRay RAM ECC error(SED).
          boolean McuEcmErrorMaskableInterrupt: set at post-build, origin=Renesas_v1.0.0, default-value=false  # This parameter enables or disables generation of a maskable interrupt when the error occurs from FlexRay RAM ECC error(SED). | true: enables generation of a maskable interrupt when the error occurs from FlexRay RAM ECC error(SED). false: disables generation of a maskable interrupt when the error occurs from FlexRay RAM ECC error(SED).
          boolean McuEcmErrorNonMaskableInterrupt: set at post-build, origin=Renesas_v1.0.0, default-value=false  # This parameter enables or disables generation of a non-maskable interrupt when the error occurs from FlexRay RAM ECC error(SED). | true: enables generation of a non-maskable interrupt when the error occurs from FlexRay RAM ECC error(SED). false: disables generation of a non-maskable interrupt when the error occurs from FlexRay RAM ECC error(SED).
          boolean McuEcmErrorInternalReset: set at post-build, origin=Renesas_v1.0.0, default-value=false  # This parameter enables or disables generation of an internal reset when the error occurs from FlexRay RAM ECC error(SED). | true: enables generation of an internal reset when the error occurs from FlexRay RAM ECC error(SED). false: disables generation of an internal reset when the error occurs from FlexRay RAM ECC error(SED).
          boolean McuEcmErrorNMIDelayTimer: set at post-build, origin=Renesas_v1.0.0, default-value=false  # This parameter enables or disables delay timer start caused by non-maskable interrupts in response to errors from FlexRay RAM ECC error(SED). | true: enables delay timer start caused by non-maskable interrupts in response to errors from FlexRay RAM ECC error(SED). false: disables delay timer start caused by non-maskable interrupts in response to errors from FlexRay RAM ECC error(SED).
          boolean McuEcmErrorMIDelayTimer: set at post-build, origin=Renesas_v1.0.0, default-value=false  # This parameter enables or disables delay timer start caused by maskable interrupts in response to errors from FlexRay RAM ECC error(SED). | true: enables delay timer start caused by maskable interrupts in response to errors from FlexRay RAM ECC error(SED). false: disables delay timer start caused by maskable interrupts in response to errors from FlexRay RAM ECC error(SED).
          boolean McuEcmErrorOutputMask: set at post-build, origin=Renesas_v1.0.0, default-value=true  # This parameter mask or unmask the individual error sources of the error pin output from FlexRay RAM ECC error(SED). | true: mask the individual error sources of the error pin output from FlexRay RAM ECC error(SED). false: unmask the individual error sources of the error pin output from FlexRay RAM ECC error(SED).
          function name McuMiNotification [0..1]: set at post-build, origin=Renesas_v1.0.0, default-value=NULL_PTR, regular-expression=[a-zA-Z][a-zA-Z0-9_]*  # This parameter contains notification function for MI notification. | The syntax for McuMiNotification should be provided as Mcu_EcmMINotification.
          function name McuNmiNotification [0..1]: set at post-build, origin=Renesas_v1.0.0, default-value=NULL_PTR, regular-expression=[a-zA-Z][a-zA-Z0-9_]*  # This parameter contains notification function for NMI notification. | The syntax for McuNmiNotification should be provided as Mcu_EcmNMINotification.
          function name McuEcmInitialNotification [0..1]: set at post-build, origin=Renesas_v1.0.2, default-value=NULL_PTR, regular-expression=[a-zA-Z][a-zA-Z0-9_]*  # This parameter is used for notify the upper layer, if any ECM error has been already detected at system start-up. | The syntax for McuEcmInitialNotification should be provided as Mcu_EcmInitialNotification.
        container McuEcmErrorSource57  # This container contains all the supported configuration parameters of the related error source from GTM RAM ECC error(SED).
          boolean McuEcmErrorMaskableInterrupt: set at post-build, origin=Renesas_v1.0.0, default-value=false  # This parameter enables or disables generation of a maskable interrupt when the error occurs from GTM RAM ECC error(SED). | true: enables generation of a maskable interrupt when the error occurs from GTM RAM ECC error(SED). false: disables generation of a maskable interrupt when the error occurs from GTM RAM ECC error(SED) .
          boolean McuEcmErrorNonMaskableInterrupt: set at post-build, origin=Renesas_v1.0.0, default-value=false  # This parameter enables or disables generation of a non-maskable interrupt when the error occurs from GTM RAM ECC error(SED). | true: enables generation of a non-maskable interrupt when the error occurs from GTM RAM ECC error(SED). false: disables generation of a non-maskable interrupt when the error occurs from GTM RAM ECC error(SED).
          boolean McuEcmErrorInternalReset: set at post-build, origin=Renesas_v1.0.0, default-value=false  # This parameter enables or disables generation of an internal reset when the error occurs from GTM RAM ECC error(SED). | true: enables generation of an internal reset when the error occurs from GTM RAM ECC error(SED). false: disables generation of an internal reset when the error occurs from GTM RAM ECC error(SED).
          boolean McuEcmErrorNMIDelayTimer: set at post-build, origin=Renesas_v1.0.0, default-value=false  # This parameter enables or disables delay timer start caused by non-maskable interrupts in response to errors from GTM RAM ECC error(SED). | true: enables delay timer start caused by non-maskable interrupts in response to errors from GTM RAM ECC error(SED). false: disables delay timer start caused by non-maskable interrupts in response to errors from GTM RAM ECC error(SED).
          boolean McuEcmErrorMIDelayTimer: set at post-build, origin=Renesas_v1.0.0, default-value=false  # This parameter enables or disables delay timer start caused by maskable interrupts in response to errors from GTM RAM ECC error(SED). | true: enables delay timer start caused by maskable interrupts in response to errors from GTM RAM ECC error(SED). false: disables delay timer start caused by maskable interrupts in response to errors from GTM RAM ECC error(SED).
          boolean McuEcmErrorOutputMask: set at post-build, origin=Renesas_v1.0.0, default-value=true  # This parameter mask or unmask the individual error sources of the error pin output from GTM RAM ECC error(SED). | true: mask the individual error sources of the error pin output from GTM RAM ECC error(SED). false: unmask the individual error sources of the error pin output from GTM RAM ECC error(SED).
          function name McuMiNotification [0..1]: set at post-build, origin=Renesas_v1.0.0, default-value=NULL_PTR, regular-expression=[a-zA-Z][a-zA-Z0-9_]*  # This parameter contains notification function for MI notification. | The syntax for McuMiNotification should be provided as Mcu_EcmMINotification.
          function name McuNmiNotification [0..1]: set at post-build, origin=Renesas_v1.0.0, default-value=NULL_PTR, regular-expression=[a-zA-Z][a-zA-Z0-9_]*  # This parameter contains notification function for NMI notification. | The syntax for McuNmiNotification should be provided as Mcu_EcmNMINotification.
          function name McuEcmInitialNotification [0..1]: set at post-build, origin=Renesas_v1.0.2, default-value=NULL_PTR, regular-expression=[a-zA-Z][a-zA-Z0-9_]*  # This parameter is used for notify the upper layer, if any ECM error has been already detected at system start-up. | The syntax for McuEcmInitialNotification should be provided as Mcu_EcmInitialNotification.
        container McuEcmErrorSource64  # This container contains all the supported configuration parameters of the related error source from PE Guard error.
          boolean McuEcmErrorMaskableInterrupt: set at post-build, origin=Renesas_v1.0.0, default-value=false  # This parameter enables or disables generation of a maskable interrupt when the error occurs from PE Guard error. | true: enables generation of a maskable interrupt when the error occurs from PE Guard error. false: disables generation of a maskable interrupt when the error occurs from PE Guard error.
          boolean McuEcmErrorNonMaskableInterrupt: set at post-build, origin=Renesas_v1.0.0, default-value=false  # This parameter enables or disables generation of a non-maskable interrupt when the error occurs from PE Guard error. | true: enables generation of a non-maskable interrupt when the error occurs from PE Guard error. false: disables generation of a non-maskable interrupt when the error occurs from PE Guard error.
          boolean McuEcmErrorInternalReset: set at post-build, origin=Renesas_v1.0.0, default-value=false  # This parameter enables or disables generation of an internal reset when the error occurs from PE Guard error. | true: enables generation of an internal reset when the error occurs from PE Guard error. false: disables generation of an internal reset when the error occurs from Data flash ECC.
          boolean McuEcmErrorNMIDelayTimer: set at post-build, origin=Renesas_v1.0.0, default-value=false  # This parameter enables or disables delay timer start caused by non-maskable interrupts in response to errors from PE Guard error. | true: enables delay timer start caused by non-maskable interrupts in response to errors from PE Guard error. false: disables delay timer start caused by non-maskable interrupts in response to errors from PE Guard error.
          boolean McuEcmErrorMIDelayTimer: set at post-build, origin=Renesas_v1.0.0, default-value=false  # This parameter enables or disables delay timer start caused by maskable interrupts in response to errors from PE Guard error. | true: enables delay timer start caused by maskable interrupts in response to errors from PE Guard error. false: disables delay timer start caused by maskable interrupts in response to errors from PE Guard error.
          boolean McuEcmErrorOutputMask: set at post-build, origin=Renesas_v1.0.0, default-value=true  # This parameter mask or unmask the individual error sources of the error pin output from PE Guard error. | true: mask the individual error sources of the error pin output from PE Guard error. false: unmask the individual error sources of the error pin output from PE Guard error.
          function name McuMiNotification [0..1]: set at post-build, origin=Renesas_v1.0.0, default-value=NULL_PTR, regular-expression=[a-zA-Z][a-zA-Z0-9_]*  # This parameter contains notification function for MI notification. | The syntax for McuMiNotification should be provided as Mcu_EcmMINotification.
          function name McuNmiNotification [0..1]: set at post-build, origin=Renesas_v1.0.0, default-value=NULL_PTR, regular-expression=[a-zA-Z][a-zA-Z0-9_]*  # This parameter contains notification function for NMI notification. | The syntax for McuNmiNotification should be provided as Mcu_EcmNMINotification.
          function name McuEcmInitialNotification [0..1]: set at post-build, origin=Renesas_v1.0.2, default-value=NULL_PTR, regular-expression=[a-zA-Z][a-zA-Z0-9_]*  # This parameter is used for notify the upper layer, if any ECM error has been already detected at system start-up. | The syntax for McuEcmInitialNotification should be provided as Mcu_EcmInitialNotification.
        container McuEcmErrorSource65  # This container contains all the supported configuration parameters of the related error source from Global RAM Guard error.
          boolean McuEcmErrorMaskableInterrupt: set at post-build, origin=Renesas_v1.0.0, default-value=false  # This parameter enables or disables generation of a maskable interrupt when the error occurs from Global RAM Guard error. | true: enables generation of a maskable interrupt when the error occurs from Global RAM Guard error. false: disables generation of a maskable interrupt when the error occurs from Global RAM Guard error.
          boolean McuEcmErrorNonMaskableInterrupt: set at post-build, origin=Renesas_v1.0.0, default-value=false  # This parameter enables or disables generation of a non-maskable interrupt when the error occurs from Global RAM Guard error. | true: enables generation of a non-maskable interrupt when the error occurs from Global RAM Guard error. false: disables generation of a non-maskable interrupt when the error occurs from Global RAM Guard error.
          boolean McuEcmErrorInternalReset: set at post-build, origin=Renesas_v1.0.0, default-value=false  # This parameter enables or disables generation of an internal reset when the error occurs from Global RAM Guard error. | true: enables generation of an internal reset when the error occurs from Global RAM Guard error. false: disables generation of an internal reset when the error occurs from Global RAM Guard error.
          boolean McuEcmErrorNMIDelayTimer: set at post-build, origin=Renesas_v1.0.0, default-value=false  # This parameter enables or disables delay timer start caused by non-maskable interrupts in response to errors from Global RAM Guard error. | true: enables delay timer start caused by non-maskable interrupts in response to errors from Global RAM Guard error. false: disables delay timer start caused by non-maskable interrupts in response to errors from Global RAM Guard error.
          boolean McuEcmErrorMIDelayTimer: set at post-build, origin=Renesas_v1.0.0, default-value=false  # This parameter enables or disables delay timer start caused by maskable interrupts in response to errors from Global RAM Guard error. | true: enables delay timer start caused by maskable interrupts in response to errors from Global RAM Guard error. false: disables delay timer start caused by maskable interrupts in response to errors from Global RAM Guard error.
          boolean McuEcmErrorOutputMask: set at post-build, origin=Renesas_v1.0.0, default-value=true  # This parameter mask or unmask the individual error sources of the error pin output from Global RAM Guard error. | true: mask the individual error sources of the error pin output from Global RAM Guard error. false: unmask the individual error sources of the error pin output from Global RAM Guard error.
          function name McuMiNotification [0..1]: set at post-build, origin=Renesas_v1.0.0, default-value=NULL_PTR, regular-expression=[a-zA-Z][a-zA-Z0-9_]*  # This parameter contains notification function for MI notification. | The syntax for McuMiNotification should be provided as Mcu_EcmMINotification.
          function name McuNmiNotification [0..1]: set at post-build, origin=Renesas_v1.0.0, default-value=NULL_PTR, regular-expression=[a-zA-Z][a-zA-Z0-9_]*  # This parameter contains notification function for NMI notification. | The syntax for McuNmiNotification should be provided as Mcu_EcmNMINotification.
          function name McuEcmInitialNotification [0..1]: set at post-build, origin=Renesas_v1.0.2, default-value=NULL_PTR, regular-expression=[a-zA-Z][a-zA-Z0-9_]*  # This parameter is used for notify the upper layer, if any ECM error has been already detected at system start-up. | The syntax for McuEcmInitialNotification should be provided as Mcu_EcmInitialNotification.
        container McuEcmErrorSource66  # This container contains all the supported configuration parameters of the related error source from MEMC Guard error.
          boolean McuEcmErrorMaskableInterrupt: set at post-build, origin=Renesas_v1.0.0, default-value=false  # This parameter enables or disables generation of a maskable interrupt when the error occurs from MEMC Guard error. | true: enables generation of a maskable interrupt when the error occurs from MEMC Guard error. false: disables generation of a maskable interrupt when the error occurs from MEMC Guard error.
          boolean McuEcmErrorNonMaskableInterrupt: set at post-build, origin=Renesas_v1.0.0, default-value=false  # This parameter enables or disables generation of a non-maskable interrupt when the error occurs from MEMC Guard error. | true: enables generation of a non-maskable interrupt when the error occurs from MEMC Guard error. false: disables generation of a non-maskable interrupt when the error occurs from MEMC Guard error.
          boolean McuEcmErrorInternalReset: set at post-build, origin=Renesas_v1.0.0, default-value=false  # This parameter enables or disables generation of an internal reset when the error occurs from MEMC Guard error. | true: enables generation of an internal reset when the error occurs from MEMC Guard error. false: disables generation of an internal reset when the error occurs from MEMC Guard error.
          boolean McuEcmErrorNMIDelayTimer: set at post-build, origin=Renesas_v1.0.0, default-value=false  # This parameter enables or disables delay timer start caused by non-maskable interrupts in response to errors from MEMC Guard error. | true: enables delay timer start caused by non-maskable interrupts in response to errors from MEMC Guard error. false: disables delay timer start caused by non-maskable interrupts in response to errors from MEMC Guard error.
          boolean McuEcmErrorMIDelayTimer: set at post-build, origin=Renesas_v1.0.0, default-value=false  # This parameter enables or disables delay timer start caused by maskable interrupts in response to errors from MEMC Guard error. | true: enables delay timer start caused by maskable interrupts in response to errors from MEMC Guard error. false: disables delay timer start caused by maskable interrupts in response to errors from MEMC Guard error.
          boolean McuEcmErrorOutputMask: set at post-build, origin=Renesas_v1.0.0, default-value=true  # This parameter mask or unmask the individual error sources of the error pin output from MEMC Guard error. | true: mask the individual error sources of the error pin output from MEMC Guard error. false: unmask the individual error sources of the error pin output from MEMC Guard error.
          function name McuMiNotification [0..1]: set at post-build, origin=Renesas_v1.0.0, default-value=NULL_PTR, regular-expression=[a-zA-Z][a-zA-Z0-9_]*  # This parameter contains notification function for MI notification. | The syntax for McuMiNotification should be provided as Mcu_EcmMINotification.
          function name McuNmiNotification [0..1]: set at post-build, origin=Renesas_v1.0.0, default-value=NULL_PTR, regular-expression=[a-zA-Z][a-zA-Z0-9_]*  # This parameter contains notification function for NMI notification. | The syntax for McuNmiNotification should be provided as Mcu_EcmNMINotification.
          function name McuEcmInitialNotification [0..1]: set at post-build, origin=Renesas_v1.0.2, default-value=NULL_PTR, regular-expression=[a-zA-Z][a-zA-Z0-9_]*  # This parameter is used for notify the upper layer, if any ECM error has been already detected at system start-up. | The syntax for McuEcmInitialNotification should be provided as Mcu_EcmInitialNotification.
        container McuEcmErrorSource67  # This container contains all the supported configuration parameters of the related error source from Slave Guard error.
          boolean McuEcmErrorMaskableInterrupt: set at post-build, origin=Renesas_v1.0.0, default-value=false  # This parameter enables or disables generation of a maskable interrupt when the error occurs from Slave Guard error. | true: enables generation of a maskable interrupt when the error occurs from Slave Guard error. false: disables generation of a maskable interrupt when the error occurs from Slave Guard error.
          boolean McuEcmErrorNonMaskableInterrupt: set at post-build, origin=Renesas_v1.0.0, default-value=false  # This parameter enables or disables generation of a non-maskable interrupt when the error occurs from Slave Guard error. | true: enables generation of a non-maskable interrupt when the error occurs from Slave Guard error. false: disables generation of a non-maskable interrupt when the error occurs from Slave Guard error.
          boolean McuEcmErrorInternalReset: set at post-build, origin=Renesas_v1.0.0, default-value=false  # This parameter enables or disables generation of an internal reset when the error occurs from Slave Guard error. | true: enables generation of an internal reset when the error occurs from Slave Guard error. false: disables generation of an internal reset when the error occurs from Slave Guard error.
          boolean McuEcmErrorNMIDelayTimer: set at post-build, origin=Renesas_v1.0.0, default-value=false  # This parameter enables or disables delay timer start caused by non-maskable interrupts in response to errors from Slave Guard error. | true: enables delay timer start caused by non-maskable interrupts in response to errors from Slave Guard error. false: disables delay timer start caused by non-maskable interrupts in response to errors from Slave Guard error.
          boolean McuEcmErrorMIDelayTimer: set at post-build, origin=Renesas_v1.0.0, default-value=false  # This parameter enables or disables delay timer start caused by maskable interrupts in response to errors from Slave Guard error. | true: enables delay timer start caused by maskable interrupts in response to errors from Slave Guard error. false: disables delay timer start caused by maskable interrupts in response to errors from Slave Guard error.
          boolean McuEcmErrorOutputMask: set at post-build, origin=Renesas_v1.0.0, default-value=true  # This parameter mask or unmask the individual error sources of the error pin output from Slave Guard error. | true: mask the individual error sources of the error pin output from Slave Guard error. false: unmask the individual error sources of the error pin output from Slave Guard error.
          function name McuMiNotification [0..1]: set at post-build, origin=Renesas_v1.0.0, default-value=NULL_PTR, regular-expression=[a-zA-Z][a-zA-Z0-9_]*  # This parameter contains notification function for MI notification. | The syntax for McuMiNotification should be provided as Mcu_EcmMINotification.
          function name McuNmiNotification [0..1]: set at post-build, origin=Renesas_v1.0.0, default-value=NULL_PTR, regular-expression=[a-zA-Z][a-zA-Z0-9_]*  # This parameter contains notification function for NMI notification. | The syntax for McuNmiNotification should be provided as Mcu_EcmNMINotification.
          function name McuEcmInitialNotification [0..1]: set at post-build, origin=Renesas_v1.0.2, default-value=NULL_PTR, regular-expression=[a-zA-Z][a-zA-Z0-9_]*  # This parameter is used for notify the upper layer, if any ECM error has been already detected at system start-up. | The syntax for McuEcmInitialNotification should be provided as Mcu_EcmInitialNotification.
        container McuEcmErrorSource72  # This container contains all the supported configuration parameters of the related error source from Code flash unmapped area access by PE1/PE2.
          boolean McuEcmErrorMaskableInterrupt: set at post-build, origin=Renesas_v1.0.0, default-value=false  # This parameter enables or disables generation of a maskable interrupt when the error occurs from Code flash unmapped area access by PE1/PE2. | true: enables generation of a maskable interrupt when the error occurs from Code flash unmapped area access by PE1/PE2. false: disables generation of a maskable interrupt when the error occurs from Code flash unmapped area access by PE1/PE2.
          boolean McuEcmErrorNonMaskableInterrupt: set at post-build, origin=Renesas_v1.0.0, default-value=false  # This parameter enables or disables generation of a non-maskable interrupt when the error occurs from Code flash unmapped area access by PE1/PE2. | true: enables generation of a non-maskable interrupt when the error occurs from Code flash unmapped area access by PE1/PE2. false: disables generation of a non-maskable interrupt when the error occurs from Code flash unmapped area access by PE1/PE2.
          boolean McuEcmErrorInternalReset: set at post-build, origin=Renesas_v1.0.0, default-value=false  # This parameter enables or disables generation of an internal reset when the error occurs from Code flash unmapped area access by PE1/PE2. | true: enables generation of an internal reset when the error occurs from Code flash unmapped area access by PE1/PE2. false: disables generation of an internal reset when the error occurs from Code flash unmapped area access by PE1/PE2.
          boolean McuEcmErrorNMIDelayTimer: set at post-build, origin=Renesas_v1.0.0, default-value=false  # This parameter enables or disables delay timer start caused by non-maskable interrupts in response to errors from Code flash unmapped area access by PE1/PE2. | true: enables delay timer start caused by non-maskable interrupts in response to errors from Code flash unmapped area access by PE1/PE2. false: disables delay timer start caused by non-maskable interrupts in response to errors from Code flash unmapped area access by PE1/PE2.
          boolean McuEcmErrorMIDelayTimer: set at post-build, origin=Renesas_v1.0.0, default-value=false  # This parameter enables or disables delay timer start caused by maskable interrupts in response to errors from Code flash unmapped area access by PE1/PE2. | true: enables delay timer start caused by maskable interrupts in response to errors from Code flash unmapped area access by PE1/PE2. false: disables delay timer start caused by maskable interrupts in response to errors from Code flash unmapped area access by PE1/PE2.
          boolean McuEcmErrorOutputMask: set at post-build, origin=Renesas_v1.0.0, default-value=true  # This parameter mask or unmask the individual error sources of the error pin output from Code flash unmapped area access by PE1/PE2. | true: mask the individual error sources of the error pin output from Code flash unmapped area access by PE1/PE2. false: unmask the individual error sources of the error pin output from Code flash unmapped area access by PE1/PE2.
          function name McuMiNotification [0..1]: set at post-build, origin=Renesas_v1.0.0, default-value=NULL_PTR, regular-expression=[a-zA-Z][a-zA-Z0-9_]*  # This parameter contains notification function for MI notification. | The syntax for McuMiNotification should be provided as Mcu_EcmMINotification.
          function name McuNmiNotification [0..1]: set at post-build, origin=Renesas_v1.0.0, default-value=NULL_PTR, regular-expression=[a-zA-Z][a-zA-Z0-9_]*  # This parameter contains notification function for NMI notification. | The syntax for McuNmiNotification should be provided as Mcu_EcmNMINotification.
          function name McuEcmInitialNotification [0..1]: set at post-build, origin=Renesas_v1.0.2, default-value=NULL_PTR, regular-expression=[a-zA-Z][a-zA-Z0-9_]*  # This parameter is used for notify the upper layer, if any ECM error has been already detected at system start-up. | The syntax for McuEcmInitialNotification should be provided as Mcu_EcmInitialNotification.
        container McuEcmErrorSource73  # This container contains all the supported configuration parameters of the related error source from Global RAM unmapped area access by PE1/PE2 .
          boolean McuEcmErrorMaskableInterrupt: set at post-build, origin=Renesas_v1.0.0, default-value=false  # This parameter enables or disables generation of a maskable interrupt when the error occurs from Global RAM unmapped area access by PE1/PE2. | true: enables generation of a maskable interrupt when the error occurs from Global RAM unmapped area access by PE1/PE2. false: disables generation of a maskable interrupt when the error occurs from Global RAM unmapped area access by PE1/PE2.
          boolean McuEcmErrorNonMaskableInterrupt: set at post-build, origin=Renesas_v1.0.0, default-value=false  # This parameter enables or disables generation of a non-maskable interrupt when the error occurs from Global RAM unmapped area access by PE1/PE2. | true: enables generation of a non-maskable interrupt when the error occurs from Global RAM unmapped area access by PE1/PE2. false: disables generation of a non-maskable interrupt when the error occurs from Global RAM unmapped area access by PE1/PE2.
          boolean McuEcmErrorInternalReset: set at post-build, origin=Renesas_v1.0.0, default-value=false  # This parameter enables or disables generation of an internal reset when the error occurs from Global RAM unmapped area access by PE1/PE2. | true: enables generation of an internal reset when the error occurs from Global RAM unmapped area access by PE1/PE2. false: disables generation of an internal reset when the error occurs from Global RAM unmapped area access by PE1/PE2.
          boolean McuEcmErrorNMIDelayTimer: set at post-build, origin=Renesas_v1.0.0, default-value=false  # This parameter enables or disables delay timer start caused by non-maskable interrupts in response to errors from Global RAM unmapped area access by PE1/PE2. | true: enables delay timer start caused by non-maskable interrupts in response to errors from Global RAM unmapped area access by PE1/PE2. false: disables delay timer start caused by non-maskable interrupts in response to errors from Global RAM unmapped area access by PE1/PE2.
          boolean McuEcmErrorMIDelayTimer: set at post-build, origin=Renesas_v1.0.0, default-value=false  # This parameter enables or disables delay timer start caused by maskable interrupts in response to errors from Global RAM unmapped area access by PE1/PE2. | true: enables delay timer start caused by maskable interrupts in response to errors from Global RAM unmapped area access by PE1/PE2. false: disables delay timer start caused by maskable interrupts in response to errors from Global RAM unmapped area access by PE1/PE2.
          boolean McuEcmErrorOutputMask: set at post-build, origin=Renesas_v1.0.0, default-value=true  # This parameter mask or unmask the individual error sources of the error pin output from Global RAM unmapped area access by PE1/PE2. | true: mask the individual error sources of the error pin output from Global RAM unmapped area access by PE1/PE2. false: unmask the individual error sources of the error pin output from Global RAM unmapped area access by PE1/PE2.
          function name McuMiNotification [0..1]: set at post-build, origin=Renesas_v1.0.0, default-value=NULL_PTR, regular-expression=[a-zA-Z][a-zA-Z0-9_]*  # This parameter contains notification function for MI notification. | The syntax for McuMiNotification should be provided as Mcu_EcmMINotification.
          function name McuNmiNotification [0..1]: set at post-build, origin=Renesas_v1.0.0, default-value=NULL_PTR, regular-expression=[a-zA-Z][a-zA-Z0-9_]*  # This parameter contains notification function for NMI notification. | The syntax for McuNmiNotification should be provided as Mcu_EcmNMINotification.
          function name McuEcmInitialNotification [0..1]: set at post-build, origin=Renesas_v1.0.2, default-value=NULL_PTR, regular-expression=[a-zA-Z][a-zA-Z0-9_]*  # This parameter is used for notify the upper layer, if any ECM error has been already detected at system start-up. | The syntax for McuEcmInitialNotification should be provided as Mcu_EcmInitialNotification.
        container McuEcmErrorSource74  # This container contains all the supported configuration parameters of the related error source from LPB unmapped area access by PE1/PE2.
          boolean McuEcmErrorMaskableInterrupt: set at post-build, origin=Renesas_v1.0.0, default-value=false  # This parameter enables or disables generation of a maskable interrupt when the error occurs from LPB unmapped area access by PE1/PE2. | true: enables generation of a maskable interrupt when the error occurs from LPB unmapped area access by PE1/PE2. false: disables generation of a maskable interrupt when the error occurs from LPB unmapped area access by PE1/PE2.
          boolean McuEcmErrorNonMaskableInterrupt: set at post-build, origin=Renesas_v1.0.0, default-value=false  # This parameter enables or disables generation of a non-maskable interrupt when the error occurs from LPB unmapped area access by PE1/PE2. | true: enables generation of a non-maskable interrupt when the error occurs from LPB unmapped area access by PE1/PE2. false: disables generation of a non-maskable interrupt when the error occurs from LPB unmapped area access by PE1/PE2.
          boolean McuEcmErrorInternalReset: set at post-build, origin=Renesas_v1.0.0, default-value=false  # This parameter enables or disables generation of an internal reset when the error occurs from LPB unmapped area access by PE1/PE2. | true: enables generation of an internal reset when the error occurs from LPB unmapped area access by PE1/PE2. false: disables generation of an internal reset when the error occurs from LPB unmapped area access by PE1/PE2.
          boolean McuEcmErrorNMIDelayTimer: set at post-build, origin=Renesas_v1.0.0, default-value=false  # This parameter enables or disables delay timer start caused by non-maskable interrupts in response to errors LPB unmapped area access by PE1/PE2. | true: enables delay timer start caused by non-maskable interrupts in response to errors from LPB unmapped area access by PE1/PE2. false: disables delay timer start caused by non-maskable interrupts in response to errors from LPB unmapped area access by PE1/PE2.
          boolean McuEcmErrorMIDelayTimer: set at post-build, origin=Renesas_v1.0.0, default-value=false  # This parameter enables or disables delay timer start caused by maskable interrupts in response to errors from LPB unmapped area access by PE1/PE2. | true: enables delay timer start caused by maskable interrupts in response to errors from LPB unmapped area access by PE1/PE2. false: disables delay timer start caused by maskable interrupts in response to errors from LPB unmapped area access by PE1/PE2.
          boolean McuEcmErrorOutputMask: set at post-build, origin=Renesas_v1.0.0, default-value=true  # This parameter mask or unmask the individual error sources of the error pin output from LPB unmapped area access by PE1/PE2. | true: mask the individual error sources of the error pin output from LPB unmapped area access by PE1/PE2. false: unmask the individual error sources of the error pin output from LPB unmapped area access by PE1/PE2.
          function name McuMiNotification [0..1]: set at post-build, origin=Renesas_v1.0.0, default-value=NULL_PTR, regular-expression=[a-zA-Z][a-zA-Z0-9_]*  # This parameter contains notification function for MI notification. | The syntax for McuMiNotification should be provided as Mcu_EcmMINotification.
          function name McuNmiNotification [0..1]: set at post-build, origin=Renesas_v1.0.0, default-value=NULL_PTR, regular-expression=[a-zA-Z][a-zA-Z0-9_]*  # This parameter contains notification function for NMI notification. | The syntax for McuNmiNotification should be provided as Mcu_EcmNMINotification.
          function name McuEcmInitialNotification [0..1]: set at post-build, origin=Renesas_v1.0.2, default-value=NULL_PTR, regular-expression=[a-zA-Z][a-zA-Z0-9_]*  # This parameter is used for notify the upper layer, if any ECM error has been already detected at system start-up. | The syntax for McuEcmInitialNotification should be provided as Mcu_EcmInitialNotification.
        container McuEcmErrorSource75  # This container contains all the supported configuration parameters of the related error source from PBUS unmapped area access error.
          boolean McuEcmErrorMaskableInterrupt: set at post-build, origin=Renesas_v1.0.0, default-value=false  # This parameter enables or disables generation of a maskable interrupt when the error occurs from PBUS unmapped area access error. | true: enables generation of a maskable interrupt when the error occurs from PBUS unmapped area access error. false: disables generation of a maskable interrupt when the error occurs from PBUS unmapped area access error.
          boolean McuEcmErrorNonMaskableInterrupt: set at post-build, origin=Renesas_v1.0.0, default-value=false  # This parameter enables or disables generation of a non-maskable interrupt when the error occurs from PBUS unmapped area access error. | true: enables generation of a non-maskable interrupt when the error occurs from PBUS unmapped area access error. false: disables generation of a non-maskable interrupt when the error occurs from PBUS unmapped area access error.
          boolean McuEcmErrorInternalReset: set at post-build, origin=Renesas_v1.0.0, default-value=false  # This parameter enables or disables generation of an internal reset when the error occurs from PBUS unmapped area access error. | true: enables generation of an internal reset when the error occurs from PBUS unmapped area access error. false: disables generation of an internal reset when the error occurs from PBUS unmapped area access error.
          boolean McuEcmErrorNMIDelayTimer: set at post-build, origin=Renesas_v1.0.0, default-value=false  # This parameter enables or disables delay timer start caused by non-maskable interrupts in response to errors PBUS unmapped area access error. | true: enables delay timer start caused by non-maskable interrupts in response to errors from PBUS unmapped area access error. false: disables delay timer start caused by non-maskable interrupts in response to errors from PBUS unmapped area access error.
          boolean McuEcmErrorMIDelayTimer: set at post-build, origin=Renesas_v1.0.0, default-value=false  # This parameter enables or disables delay timer start caused by maskable interrupts in response to errors from PBUS unmapped area access error. | true: enables delay timer start caused by maskable interrupts in response to errors from PBUS unmapped area access error. false: disables delay timer start caused by maskable interrupts in response to errors from PBUS unmapped area access error.
          boolean McuEcmErrorOutputMask: set at post-build, origin=Renesas_v1.0.0, default-value=true  # This parameter mask or unmask the individual error sources of the error pin output from PBUS unmapped area access error. | true: mask the individual error sources of the error pin output from PBUS unmapped area access error. false: unmask the individual error sources of the error pin output from PBUS unmapped area access error.
          function name McuMiNotification [0..1]: set at post-build, origin=Renesas_v1.0.0, default-value=NULL_PTR, regular-expression=[a-zA-Z][a-zA-Z0-9_]*  # This parameter contains notification function for MI notification. | The syntax for McuMiNotification should be provided as Mcu_EcmMINotification.
          function name McuNmiNotification [0..1]: set at post-build, origin=Renesas_v1.0.0, default-value=NULL_PTR, regular-expression=[a-zA-Z][a-zA-Z0-9_]*  # This parameter contains notification function for NMI notification. | The syntax for McuNmiNotification should be provided as Mcu_EcmNMINotification.
          function name McuEcmInitialNotification [0..1]: set at post-build, origin=Renesas_v1.0.2, default-value=NULL_PTR, regular-expression=[a-zA-Z][a-zA-Z0-9_]*  # This parameter is used for notify the upper layer, if any ECM error has been already detected at system start-up. | The syntax for McuEcmInitialNotification should be provided as Mcu_EcmInitialNotification.
        container McuEcmErrorSource76  # This container contains all the supported configuration parameters of the related error source from HBUS unmapped area access error.
          boolean McuEcmErrorMaskableInterrupt: set at post-build, origin=Renesas_v1.0.0, default-value=false  # This parameter enables or disables generation of a maskable interrupt when the error occurs from HBUS unmapped area access error. | true: enables generation of a maskable interrupt when the error occurs from HBUS unmapped area access error. false: disables generation of a maskable interrupt when the error occurs from HBUS unmapped area access error.
          boolean McuEcmErrorNonMaskableInterrupt: set at post-build, origin=Renesas_v1.0.0, default-value=false  # This parameter enables or disables generation of a non-maskable interrupt when the error occurs from HBUS unmapped area access error. | true: enables generation of a non-maskable interrupt when the error occurs from HBUS unmapped area access error. false: disables generation of a non-maskable interrupt when the error occurs from HBUS unmapped area access error.
          boolean McuEcmErrorInternalReset: set at post-build, origin=Renesas_v1.0.0, default-value=false  # This parameter enables or disables generation of an internal reset when the error occurs from HBUS unmapped area access error. | true: enables generation of an internal reset when the error occurs from HBUS unmapped area access error. false: disables generation of an internal reset when the error occurs from HBUS unmapped area access error.
          boolean McuEcmErrorNMIDelayTimer: set at post-build, origin=Renesas_v1.0.0, default-value=false  # This parameter enables or disables delay timer start caused by non-maskable interrupts in response to errors from HBUS unmapped area access error. | true: enables delay timer start caused by non-maskable interrupts in response to errors from HBUS unmapped area access error. false: disables delay timer start caused by non-maskable interrupts in response to errors from HBUS unmapped area access error.
          boolean McuEcmErrorMIDelayTimer: set at post-build, origin=Renesas_v1.0.0, default-value=false  # This parameter enables or disables delay timer start caused by maskable interrupts in response to errors from HBUS unmapped area access error. | true: enables delay timer start caused by maskable interrupts in response to errors from HBUS unmapped area access error. false: disables delay timer start caused by maskable interrupts in response to errors from HBUS unmapped area access error.
          boolean McuEcmErrorOutputMask: set at post-build, origin=Renesas_v1.0.0, default-value=true  # This parameter mask or unmask the individual error sources of the error pin output from HBUS unmapped area access error. | true: mask the individual error sources of the error pin output from HBUS unmapped area access error. false: unmask the individual error sources of the error pin output from HBUS unmapped area access error.
          function name McuMiNotification [0..1]: set at post-build, origin=Renesas_v1.0.0, default-value=NULL_PTR, regular-expression=[a-zA-Z][a-zA-Z0-9_]*  # This parameter contains notification function for MI notification. | The syntax for McuMiNotification should be provided as Mcu_EcmMINotification.
          function name McuNmiNotification [0..1]: set at post-build, origin=Renesas_v1.0.0, default-value=NULL_PTR, regular-expression=[a-zA-Z][a-zA-Z0-9_]*  # This parameter contains notification function for NMI notification. | The syntax for McuNmiNotification should be provided as Mcu_EcmNMINotification.
          function name McuEcmInitialNotification [0..1]: set at post-build, origin=Renesas_v1.0.2, default-value=NULL_PTR, regular-expression=[a-zA-Z][a-zA-Z0-9_]*  # This parameter is used for notify the upper layer, if any ECM error has been already detected at system start-up. | The syntax for McuEcmInitialNotification should be provided as Mcu_EcmInitialNotification.
        container McuEcmErrorSource77  # This container contains all the supported configuration parameters of the related error source from Code flash unmapped area access via GVCI.
          boolean McuEcmErrorMaskableInterrupt: set at post-build, origin=Renesas_v1.0.0, default-value=false  # This parameter enables or disables generation of a maskable interrupt when the error occurs from Code flash unmapped area access via GVCI. | true: enables generation of a maskable interrupt when the error occurs from Code flash unmapped area access via GVCI. false: disables generation of a maskable interrupt when the error occurs from Code flash unmapped area access via GVCI.
          boolean McuEcmErrorNonMaskableInterrupt: set at post-build, origin=Renesas_v1.0.0, default-value=false  # This parameter enables or disables generation of a non-maskable interrupt when the error occurs from Code flash unmapped area access via GVCI. | true: enables generation of a non-maskable interrupt when the error occurs from Code flash unmapped area access via GVCI. false: disables generation of a non-maskable interrupt when the error occurs from Code flash unmapped area access via GVCI.
          boolean McuEcmErrorInternalReset: set at post-build, origin=Renesas_v1.0.0, default-value=false  # This parameter enables or disables generation of an internal reset when the error occurs from Code flash unmapped area access via GVCI. | true: enables generation of an internal reset when the error occurs from Code flash unmapped area access via GVCI. false: disables generation of an internal reset when the error occurs from Code flash unmapped area access via GVCI.
          boolean McuEcmErrorNMIDelayTimer: set at post-build, origin=Renesas_v1.0.0, default-value=false  # This parameter enables or disables delay timer start caused by non-maskable interrupts in response to errors from Code flash unmapped area access via GVCI. | true: enables delay timer start caused by non-maskable interrupts in response to errors from Code flash unmapped area access via GVCI. false: disables delay timer start caused by non-maskable interrupts in response to errors from Code flash unmapped area access via GVCI.
          boolean McuEcmErrorMIDelayTimer: set at post-build, origin=Renesas_v1.0.0, default-value=false  # This parameter enables or disables delay timer start caused by maskable interrupts in response to errors from Code flash unmapped area access via GVCI. | true: enables delay timer start caused by maskable interrupts in response to errors from Code flash unmapped area access via GVCI. false: disables delay timer start caused by maskable interrupts in response to errors from Code flash unmapped area access via GVCI.
          boolean McuEcmErrorOutputMask: set at post-build, origin=Renesas_v1.0.0, default-value=true  # This parameter mask or unmask the individual error sources of the error pin output from Code flash unmapped area access via GVCI. | true: mask the individual error sources of the error pin output from Code flash unmapped area access via GVCI. false: unmask the individual error sources of the error pin output from Code flash unmapped area access via GVCI.
          function name McuMiNotification [0..1]: set at post-build, origin=Renesas_v1.0.0, default-value=NULL_PTR, regular-expression=[a-zA-Z][a-zA-Z0-9_]*  # This parameter contains notification function for MI notification. | The syntax for McuMiNotification should be provided as Mcu_EcmMINotification.
          function name McuNmiNotification [0..1]: set at post-build, origin=Renesas_v1.0.0, default-value=NULL_PTR, regular-expression=[a-zA-Z][a-zA-Z0-9_]*  # This parameter contains notification function for NMI notification. | The syntax for McuNmiNotification should be provided as Mcu_EcmNMINotification.
          function name McuEcmInitialNotification [0..1]: set at post-build, origin=Renesas_v1.0.2, default-value=NULL_PTR, regular-expression=[a-zA-Z][a-zA-Z0-9_]*  # This parameter is used for notify the upper layer, if any ECM error has been already detected at system start-up. | The syntax for McuEcmInitialNotification should be provided as Mcu_EcmInitialNotification.
        container McuEcmErrorSource78  # This container contains all the supported configuration parameters of the related error source from Global RAM unmapped area access via GVCI/HBus.
          boolean McuEcmErrorMaskableInterrupt: set at post-build, origin=Renesas_v1.0.0, default-value=false  # This parameter enables or disables generation of a maskable interrupt when the error occurs from Global RAM unmapped area access via GVCI/HBus. | true: enables generation of a maskable interrupt when the error occurs from Global RAM unmapped area access via GVCI/HBus. false: disables generation of a maskable interrupt when the error occurs from Global RAM unmapped area access via GVCI/HBus.
          boolean McuEcmErrorNonMaskableInterrupt: set at post-build, origin=Renesas_v1.0.0, default-value=false  # This parameter enables or disables generation of a non-maskable interrupt when the error occurs from Global RAM unmapped area access via GVCI/HBus. | true: enables generation of a non-maskable interrupt when the error occurs from Global RAM unmapped area access via GVCI/HBus. false: disables generation of a non-maskable interrupt when the error occurs from Global RAM unmapped area access via GVCI/HBus.
          boolean McuEcmErrorInternalReset: set at post-build, origin=Renesas_v1.0.0, default-value=false  # This parameter enables or disables generation of an internal reset when the error occurs from Global RAM unmapped area access via GVCI/HBus. | true: enables generation of an internal reset when the error occurs from Global RAM unmapped area access via GVCI/HBus. false: disables generation of an internal reset when the error occurs from Global RAM unmapped area access via GVCI/HBus.
          boolean McuEcmErrorNMIDelayTimer: set at post-build, origin=Renesas_v1.0.0, default-value=false  # This parameter enables or disables delay timer start caused by non-maskable interrupts in response to errors from Global RAM unmapped area access via GVCI/HBus. | true: enables delay timer start caused by non-maskable interrupts in response to errors from Global RAM unmapped area access via GVCI/HBus. false: disables delay timer start caused by non-maskable interrupts in response to errors from Global RAM unmapped area access via GVCI/HBus.
          boolean McuEcmErrorMIDelayTimer: set at post-build, origin=Renesas_v1.0.0, default-value=false  # This parameter enables or disables delay timer start caused by maskable interrupts in response to errors from Global RAM unmapped area access via GVCI/HBus. | true: enables delay timer start caused by maskable interrupts in response to errors from Global RAM unmapped area access via GVCI/HBus. false: disables delay timer start caused by maskable interrupts in response to errors from Global RAM unmapped area access via GVCI/HBus.
          boolean McuEcmErrorOutputMask: set at post-build, origin=Renesas_v1.0.0, default-value=true  # This parameter mask or unmask the individual error sources of the error pin output from Global RAM unmapped area access via GVCI/HBus. | true: mask the individual error sources of the error pin output from Global RAM unmapped area access via GVCI/HBus. false: unmask the individual error sources of the error pin output from Global RAM unmapped area access via GVCI/HBus.
          function name McuMiNotification [0..1]: set at post-build, origin=Renesas_v1.0.0, default-value=NULL_PTR, regular-expression=[a-zA-Z][a-zA-Z0-9_]*  # This parameter contains notification function for MI notification. | The syntax for McuMiNotification should be provided as Mcu_EcmMINotification.
          function name McuNmiNotification [0..1]: set at post-build, origin=Renesas_v1.0.0, default-value=NULL_PTR, regular-expression=[a-zA-Z][a-zA-Z0-9_]*  # This parameter contains notification function for NMI notification. | The syntax for McuNmiNotification should be provided as Mcu_EcmNMINotification.
          function name McuEcmInitialNotification [0..1]: set at post-build, origin=Renesas_v1.0.2, default-value=NULL_PTR, regular-expression=[a-zA-Z][a-zA-Z0-9_]*  # This parameter is used for notify the upper layer, if any ECM error has been already detected at system start-up. | The syntax for McuEcmInitialNotification should be provided as Mcu_EcmInitialNotification.
        container McuEcmErrorSource79  # This container contains all the supported configuration parameters of the related error source from Reserved Area unmapped access via from HBus.
          boolean McuEcmErrorMaskableInterrupt: set at post-build, origin=Renesas_v1.0.0, default-value=false  # This parameter enables or disables generation of a maskable interrupt when the error occurs from Reserved Area unmapped access via from HBus. | true: enables generation of a maskable interrupt when the error occurs from Reserved Area unmapped access via from HBus. false: disables generation of a maskable interrupt when the error occurs from Reserved Area unmapped access via from HBus.
          boolean McuEcmErrorNonMaskableInterrupt: set at post-build, origin=Renesas_v1.0.0, default-value=false  # This parameter enables or disables generation of a non-maskable interrupt when the error occurs from Reserved Area unmapped access via from HBus. | true: enables generation of a non-maskable interrupt when the error occurs from Reserved Area unmapped access via from HBus. false: disables generation of a non-maskable interrupt when the error occurs from Reserved Area unmapped access via from HBus.
          boolean McuEcmErrorInternalReset: set at post-build, origin=Renesas_v1.0.0, default-value=false  # This parameter enables or disables generation of an internal reset when the error occurs from Reserved Area unmapped access via from HBus. | true: enables generation of an internal reset when the error occurs from Reserved Area unmapped access via from HBus. false: disables generation of an internal reset when the error occurs from Reserved Area unmapped access via from HBus.
          boolean McuEcmErrorNMIDelayTimer: set at post-build, origin=Renesas_v1.0.0, default-value=false  # This parameter enables or disables delay timer start caused by non-maskable interrupts in response to errors from Reserved Area unmapped access via from HBus. | true: enables delay timer start caused by non-maskable interrupts in response to errors from Reserved Area unmapped access via from HBus. false: disables delay timer start caused by non-maskable interrupts in response to errors from Reserved Area unmapped access via from HBus.
          boolean McuEcmErrorMIDelayTimer: set at post-build, origin=Renesas_v1.0.0, default-value=false  # This parameter enables or disables delay timer start caused by maskable interrupts in response to errors from Reserved Area unmapped access via from HBus. | true: enables delay timer start caused by maskable interrupts in response to errors from Reserved Area unmapped access via from HBus. false: disables delay timer start caused by maskable interrupts in response to errors from Reserved Area unmapped access via from HBus.
          boolean McuEcmErrorOutputMask: set at post-build, origin=Renesas_v1.0.0, default-value=true  # This parameter mask or unmask the individual error sources of the error pin output from Reserved Area unmapped access via from HBus. | true: mask the individual error sources of the error pin output from Reserved Area unmapped access via from HBus. false: unmask the individual error sources of the error pin output from Reserved Area unmapped access via from HBus.
          function name McuMiNotification [0..1]: set at post-build, origin=Renesas_v1.0.0, default-value=NULL_PTR, regular-expression=[a-zA-Z][a-zA-Z0-9_]*  # This parameter contains notification function for MI notification. | The syntax for McuMiNotification should be provided as Mcu_EcmMINotification.
          function name McuNmiNotification [0..1]: set at post-build, origin=Renesas_v1.0.0, default-value=NULL_PTR, regular-expression=[a-zA-Z][a-zA-Z0-9_]*  # This parameter contains notification function for NMI notification. | The syntax for McuNmiNotification should be provided as Mcu_EcmNMINotification.
          function name McuEcmInitialNotification [0..1]: set at post-build, origin=Renesas_v1.0.2, default-value=NULL_PTR, regular-expression=[a-zA-Z][a-zA-Z0-9_]*  # This parameter is used for notify the upper layer, if any ECM error has been already detected at system start-up. | The syntax for McuEcmInitialNotification should be provided as Mcu_EcmInitialNotification.
        container McuEcmErrorSource80  # This container contains all the supported configuration parameters of the related error source from DMA Transfer error.
          boolean McuEcmErrorMaskableInterrupt: set at post-build, origin=Renesas_v1.0.0, default-value=false  # This parameter enables or disables generation of a maskable interrupt when the error occurs from DMA Transfer error. | true: enables generation of a maskable interrupt when the error occurs from DMA Transfer error. false: disables generation of a maskable interrupt when the error occurs from DMA Transfer error.
          boolean McuEcmErrorNonMaskableInterrupt: set at post-build, origin=Renesas_v1.0.0, default-value=false  # This parameter enables or disables generation of a non-maskable interrupt when the error occurs from DMA Transfer error. | true: enables generation of a non-maskable interrupt when the error occurs from DMA Transfer error. false: disables generation of a non-maskable interrupt when the error occurs from DMA Transfer error.
          boolean McuEcmErrorInternalReset: set at post-build, origin=Renesas_v1.0.0, default-value=false  # This parameter enables or disables generation of an internal reset when the error occurs from DMA Transfer error. | true: enables generation of an internal reset when the error occurs from DMA Transfer error. false: disables generation of an internal reset when the error occurs from DMA Transfer error.
          boolean McuEcmErrorNMIDelayTimer: set at post-build, origin=Renesas_v1.0.0, default-value=false  # This parameter enables or disables delay timer start caused by non-maskable interrupts in response to errors from DMA Transfer error. | true: enables delay timer start caused by non-maskable interrupts in response to errors from DMA Transfer error. false: disables delay timer start caused by non-maskable interrupts in response to errors from DMA Transfer error.
          boolean McuEcmErrorMIDelayTimer: set at post-build, origin=Renesas_v1.0.0, default-value=false  # This parameter enables or disables delay timer start caused by maskable interrupts in response to errors from DMA Transfer error. | true: enables delay timer start caused by maskable interrupts in response to errors from DMA Transfer error. false: disables delay timer start caused by maskable interrupts in response to errors from DMA Transfer error.
          boolean McuEcmErrorOutputMask: set at post-build, origin=Renesas_v1.0.0, default-value=true  # This parameter mask or unmask the individual error sources of the error pin output from DMA Transfer error. | true: mask the individual error sources of the error pin output from DMA Transfer error. false: unmask the individual error sources of the error pin output from DMA Transfer error.
          function name McuMiNotification [0..1]: set at post-build, origin=Renesas_v1.0.0, default-value=NULL_PTR, regular-expression=[a-zA-Z][a-zA-Z0-9_]*  # This parameter contains notification function for MI notification. | The syntax for McuMiNotification should be provided as Mcu_EcmMINotification.
          function name McuNmiNotification [0..1]: set at post-build, origin=Renesas_v1.0.0, default-value=NULL_PTR, regular-expression=[a-zA-Z][a-zA-Z0-9_]*  # This parameter contains notification function for NMI notification. | The syntax for McuNmiNotification should be provided as Mcu_EcmNMINotification.
          function name McuEcmInitialNotification [0..1]: set at post-build, origin=Renesas_v1.0.2, default-value=NULL_PTR, regular-expression=[a-zA-Z][a-zA-Z0-9_]*  # This parameter is used for notify the upper layer, if any ECM error has been already detected at system start-up. | The syntax for McuEcmInitialNotification should be provided as Mcu_EcmInitialNotification.
        container McuEcmErrorSource81  # This container contains all the supported configuration parameters of the related error source from DMA Unmapped access error.
          boolean McuEcmErrorMaskableInterrupt: set at post-build, origin=Renesas_v1.0.0, default-value=false  # This parameter enables or disables generation of a maskable interrupt when the error occurs from DMA Unmapped access error. | true: enables generation of a maskable interrupt when the error occurs from DMA Unmapped access error. false: disables generation of a maskable interrupt when the error occurs from DMA Unmapped access error.
          boolean McuEcmErrorNonMaskableInterrupt: set at post-build, origin=Renesas_v1.0.0, default-value=false  # This parameter enables or disables generation of a non-maskable interrupt when the error occurs from DMA Unmapped access error. | true: enables generation of a non-maskable interrupt when the error occurs from DMA Unmapped access error. false: disables generation of a non-maskable interrupt when the error occurs from DMA Unmapped access error.
          boolean McuEcmErrorInternalReset: set at post-build, origin=Renesas_v1.0.0, default-value=false  # This parameter enables or disables generation of an internal reset when the error occurs from DMA Unmapped access error. | true: enables generation of an internal reset when the error occurs from DMA Unmapped access error. false: disables generation of an internal reset when the error occurs from DMA Unmapped access error.
          boolean McuEcmErrorNMIDelayTimer: set at post-build, origin=Renesas_v1.0.0, default-value=false  # This parameter enables or disables delay timer start caused by non-maskable interrupts in response to errors from DMA Unmapped access error. | true: enables delay timer start caused by non-maskable interrupts in response to errors from DMA Unmapped access error. false: disables delay timer start caused by non-maskable interrupts in response to errors from DMA Unmapped access error.
          boolean McuEcmErrorMIDelayTimer: set at post-build, origin=Renesas_v1.0.0, default-value=false  # This parameter enables or disables delay timer start caused by maskable interrupts in response to errors from DMA Unmapped access error. | true: enables delay timer start caused by maskable interrupts in response to errors from DMA Unmapped access error. false: disables delay timer start caused by maskable interrupts in response to errors from DMA Unmapped access error.
          boolean McuEcmErrorOutputMask: set at post-build, origin=Renesas_v1.0.0, default-value=true  # This parameter mask or unmask the individual error sources of the error pin output from DMA Unmapped access error. | true: mask the individual error sources of the error pin output from DMA Unmapped access error. false: unmask the individual error sources of the error pin output from DMA Unmapped access error.
          function name McuMiNotification [0..1]: set at post-build, origin=Renesas_v1.0.0, default-value=NULL_PTR, regular-expression=[a-zA-Z][a-zA-Z0-9_]*  # This parameter contains notification function for MI notification. | The syntax for McuMiNotification should be provided as Mcu_EcmMINotification.
          function name McuNmiNotification [0..1]: set at post-build, origin=Renesas_v1.0.0, default-value=NULL_PTR, regular-expression=[a-zA-Z][a-zA-Z0-9_]*  # This parameter contains notification function for NMI notification. | The syntax for McuNmiNotification should be provided as Mcu_EcmNMINotification.
          function name McuEcmInitialNotification [0..1]: set at post-build, origin=Renesas_v1.0.2, default-value=NULL_PTR, regular-expression=[a-zA-Z][a-zA-Z0-9_]*  # This parameter is used for notify the upper layer, if any ECM error has been already detected at system start-up. | The syntax for McuEcmInitialNotification should be provided as Mcu_EcmInitialNotification.
        container McuEcmErrorSource82  # This container contains all the supported configuration parameters of the related error source from Flash Sequence error.
          boolean McuEcmErrorMaskableInterrupt: set at post-build, origin=Renesas_v1.0.0, default-value=false  # This parameter enables or disables generation of a maskable interrupt when the error occurs from Flash Sequence error. | true: enables generation of a maskable interrupt when the error occurs from Flash Sequence error. false: disables generation of a maskable interrupt when the error occurs from Flash Sequence error .
          boolean McuEcmErrorNonMaskableInterrupt: set at post-build, origin=Renesas_v1.0.0, default-value=false  # This parameter enables or disables generation of a non-maskable interrupt when the error occurs from Flash Sequence error. | true: enables generation of a non-maskable interrupt when the error occurs from Flash Sequence error. false: disables generation of a non-maskable interrupt when the error occurs from Flash Sequence error.
          boolean McuEcmErrorInternalReset: set at post-build, origin=Renesas_v1.0.0, default-value=false  # This parameter enables or disables generation of an internal reset when the error occurs from Flash Sequence error. | true: enables generation of an internal reset when the error occurs from Flash Sequence error. false: disables generation of an internal reset when the error occurs from Flash Sequence error.
          boolean McuEcmErrorNMIDelayTimer: set at post-build, origin=Renesas_v1.0.0, default-value=false  # This parameter enables or disables delay timer start caused by non-maskable interrupts in response to errors from Flash Sequence error. | true: enables delay timer start caused by non-maskable interrupts in response to errors from Flash Sequence error. false: disables delay timer start caused by non-maskable interrupts in response to errors from Flash Sequence error.
          boolean McuEcmErrorMIDelayTimer: set at post-build, origin=Renesas_v1.0.0, default-value=false  # This parameter enables or disables delay timer start caused by maskable interrupts in response to errors from Flash Sequence error. | true: enables delay timer start caused by maskable interrupts in response to errors from Flash Sequence error. false: disables delay timer start caused by maskable interrupts in response to errors from Flash Sequence error.
          boolean McuEcmErrorOutputMask: set at post-build, origin=Renesas_v1.0.0, default-value=true  # This parameter mask or unmask the individual error sources of the error pin output from Flash Sequence error. | true: mask the individual error sources of the error pin output from Flash Sequence error. false: unmask the individual error sources of the error pin output from Flash Sequence error.
          function name McuMiNotification [0..1]: set at post-build, origin=Renesas_v1.0.0, default-value=NULL_PTR, regular-expression=[a-zA-Z][a-zA-Z0-9_]*  # This parameter contains notification function for MI notification. | The syntax for McuMiNotification should be provided as Mcu_EcmMINotification.
          function name McuNmiNotification [0..1]: set at post-build, origin=Renesas_v1.0.0, default-value=NULL_PTR, regular-expression=[a-zA-Z][a-zA-Z0-9_]*  # This parameter contains notification function for NMI notification. | The syntax for McuNmiNotification should be provided as Mcu_EcmNMINotification.
          function name McuEcmInitialNotification [0..1]: set at post-build, origin=Renesas_v1.0.2, default-value=NULL_PTR, regular-expression=[a-zA-Z][a-zA-Z0-9_]*  # This parameter is used for notify the upper layer, if any ECM error has been already detected at system start-up. | The syntax for McuEcmInitialNotification should be provided as Mcu_EcmInitialNotification.
        container McuEcmErrorSource83  # This container contains all the supported configuration parameters of the related error source from FACI Reset/Refresh transfer error.
          boolean McuEcmErrorMaskableInterrupt: set at post-build, origin=Renesas_v1.0.0, default-value=false  # This parameter enables or disables generation of a maskable interrupt when the error occurs from FACI Reset/Refresh transfer error. | true: enables generation of a maskable interrupt when the error occurs from FACI Reset/Refresh transfer error. false: disables generation of a maskable interrupt when the error occurs from FACI Reset/Refresh transfer error.
          boolean McuEcmErrorNonMaskableInterrupt: set at post-build, origin=Renesas_v1.0.0, default-value=false  # This parameter enables or disables generation of a non-maskable interrupt when the error occurs from FACI Reset/Refresh transfer error. | true: enables generation of a non-maskable interrupt when the error occurs from FACI Reset/Refresh transfer error. false: disables generation of a non-maskable interrupt when the error occurs from FACI Reset/Refresh transfer error.
          boolean McuEcmErrorInternalReset: set at post-build, origin=Renesas_v1.0.0, default-value=false  # This parameter enables or disables generation of an internal reset when the error occurs from FACI Reset/Refresh transfer error. | true: enables generation of an internal reset when the error occurs from FACI Reset/Refresh transfer error. false: disables generation of an internal reset when the error occurs from Data flash ECC.
          boolean McuEcmErrorNMIDelayTimer: set at post-build, origin=Renesas_v1.0.0, default-value=false  # This parameter enables or disables delay timer start caused by non-maskable interrupts in response to errors from FACI Reset/Refresh transfer error. | true: enables delay timer start caused by non-maskable interrupts in response to errors from FACI Reset/Refresh transfer error. false: disables delay timer start caused by non-maskable interrupts in response to errors from FACI Reset/Refresh transfer error.
          boolean McuEcmErrorMIDelayTimer: set at post-build, origin=Renesas_v1.0.0, default-value=false  # This parameter enables or disables delay timer start caused by maskable interrupts in response to errors from FACI Reset/Refresh transfer error. | true: enables delay timer start caused by maskable interrupts in response to errors from FACI Reset/Refresh transfer error. false: disables delay timer start caused by maskable interrupts in response to errors from FACI Reset/Refresh transfer error.
          boolean McuEcmErrorOutputMask: set at post-build, origin=Renesas_v1.0.0, default-value=true  # This parameter mask or unmask the individual error sources of the error pin output from FACI Reset/Refresh transfer error. | true: mask the individual error sources of the error pin output from FACI Reset/Refresh transfer error. false: unmask the individual error sources of the error pin output from FACI Reset/Refresh transfer error.
          function name McuMiNotification [0..1]: set at post-build, origin=Renesas_v1.0.0, default-value=NULL_PTR, regular-expression=[a-zA-Z][a-zA-Z0-9_]*  # This parameter contains notification function for MI notification. | The syntax for McuMiNotification should be provided as Mcu_EcmMINotification.
          function name McuNmiNotification [0..1]: set at post-build, origin=Renesas_v1.0.0, default-value=NULL_PTR, regular-expression=[a-zA-Z][a-zA-Z0-9_]*  # This parameter contains notification function for NMI notification. | The syntax for McuNmiNotification should be provided as Mcu_EcmNMINotification.
          function name McuEcmInitialNotification [0..1]: set at post-build, origin=Renesas_v1.0.2, default-value=NULL_PTR, regular-expression=[a-zA-Z][a-zA-Z0-9_]*  # This parameter is used for notify the upper layer, if any ECM error has been already detected at system start-up. | The syntax for McuEcmInitialNotification should be provided as Mcu_EcmInitialNotification.
        container McuEcmErrorSource84  # This container contains all the supported configuration parameters of the related error source from ADC Parity error.
          boolean McuEcmErrorMaskableInterrupt: set at post-build, origin=Renesas_v1.0.0, default-value=false  # This parameter enables or disables generation of a maskable interrupt when the error occurs from ADC Parity error. | true: enables generation of a maskable interrupt when the error occurs from ADC Parity error. false: disables generation of a maskable interrupt when the error occurs from ADC Parity error.
          boolean McuEcmErrorNonMaskableInterrupt: set at post-build, origin=Renesas_v1.0.0, default-value=false  # This parameter enables or disables generation of a non-maskable interrupt when the error occurs from ADC Parity error. | true: enables generation of a non-maskable interrupt when the error occurs from ADC Parity error. false: disables generation of a non-maskable interrupt when the error occurs from ADC Parity error.
          boolean McuEcmErrorInternalReset: set at post-build, origin=Renesas_v1.0.0, default-value=false  # This parameter enables or disables generation of an internal reset when the error occurs from ADC Parity error. | true: enables generation of an internal reset when the error occurs from ADC Parity error. false: disables generation of an internal reset when the error occurs from ADC Parity error.
          boolean McuEcmErrorNMIDelayTimer: set at post-build, origin=Renesas_v1.0.0, default-value=false  # This parameter enables or disables delay timer start caused by non-maskable interrupts in response to errors from ADC Parity error. | true: enables delay timer start caused by non-maskable interrupts in response to errors from ADC Parity error. false: disables delay timer start caused by non-maskable interrupts in response to errors from ADC Parity error.
          boolean McuEcmErrorMIDelayTimer: set at post-build, origin=Renesas_v1.0.0, default-value=false  # This parameter enables or disables delay timer start caused by maskable interrupts in response to errors from ADC Parity error. | true: enables delay timer start caused by maskable interrupts in response to errors from ADC Parity error. false: disables delay timer start caused by maskable interrupts in response to errors from ADC Parity error.
          boolean McuEcmErrorOutputMask: set at post-build, origin=Renesas_v1.0.0, default-value=true  # This parameter mask or unmask the individual error sources of the error pin output from ADC Parity error. | true: mask the individual error sources of the error pin output from ADC Parity error. false: unmask the individual error sources of the error pin output from ADC Parity error.
          function name McuMiNotification [0..1]: set at post-build, origin=Renesas_v1.0.0, default-value=NULL_PTR, regular-expression=[a-zA-Z][a-zA-Z0-9_]*  # This parameter contains notification function for MI notification. | The syntax for McuMiNotification should be provided as Mcu_EcmMINotification.
          function name McuNmiNotification [0..1]: set at post-build, origin=Renesas_v1.0.0, default-value=NULL_PTR, regular-expression=[a-zA-Z][a-zA-Z0-9_]*  # This parameter contains notification function for NMI notification. | The syntax for McuNmiNotification should be provided as Mcu_EcmNMINotification.
          function name McuEcmInitialNotification [0..1]: set at post-build, origin=Renesas_v1.0.2, default-value=NULL_PTR, regular-expression=[a-zA-Z][a-zA-Z0-9_]*  # This parameter is used for notify the upper layer, if any ECM error has been already detected at system start-up. | The syntax for McuEcmInitialNotification should be provided as Mcu_EcmInitialNotification.
        container McuEcmErrorSource87  # This container contains all the supported configuration parameters of the related error source from Unintended DISABLE/ENABLE of PE2.
          boolean McuEcmErrorMaskableInterrupt: set at post-build, origin=Renesas_v1.0.0, default-value=false  # This parameter enables or disables generation of a maskable interrupt when the error occurs from Unintended DISABLE/ENABLE of PE2. | true: enables generation of a maskable interrupt when the error occurs from Unintended DISABLE/ENABLE of PE2. false: disables generation of a maskable interrupt when the error occurs from Unintended DISABLE/ENABLE of PE2.
          boolean McuEcmErrorNonMaskableInterrupt: set at post-build, origin=Renesas_v1.0.0, default-value=false  # This parameter enables or disables generation of a non-maskable interrupt when the error occurs from Unintended DISABLE/ENABLE of PE2. | true: enables generation of a non-maskable interrupt when the error occurs from Unintended DISABLE/ENABLE of PE2. false: disables generation of a non-maskable interrupt when the error occurs from Unintended DISABLE/ENABLE of PE2.
          boolean McuEcmErrorInternalReset: set at post-build, origin=Renesas_v1.0.0, default-value=false  # This parameter enables or disables generation of an internal reset when the error occurs from Unintended DISABLE/ENABLE of PE2. | true: enables generation of an internal reset when the error occurs from Unintended DISABLE/ENABLE of PE2. false: disables generation of an internal reset when the error occurs from Unintended DISABLE/ENABLE of PE2.
          boolean McuEcmErrorNMIDelayTimer: set at post-build, origin=Renesas_v1.0.0, default-value=false  # This parameter enables or disables delay timer start caused by non-maskable interrupts in response to errors from Unintended DISABLE/ENABLE of PE2. | true: enables delay timer start caused by non-maskable interrupts in response to errors from Unintended DISABLE/ENABLE of PE2. false: disables delay timer start caused by non-maskable interrupts in response to errors from Unintended DISABLE/ENABLE of PE2.
          boolean McuEcmErrorMIDelayTimer: set at post-build, origin=Renesas_v1.0.0, default-value=false  # This parameter enables or disables delay timer start caused by maskable interrupts in response to errors from Unintended DISABLE/ENABLE of PE2. | true: enables delay timer start caused by maskable interrupts in response to errors from Unintended DISABLE/ENABLE of PE2. false: disables delay timer start caused by maskable interrupts in response to errors from Unintended DISABLE/ENABLE of PE2.
          boolean McuEcmErrorOutputMask: set at post-build, origin=Renesas_v1.0.0, default-value=true  # This parameter mask or unmask the individual error sources of the error pin output from Unintended DISABLE/ENABLE of PE2. | true: mask the individual error sources of the error pin output from Unintended DISABLE/ENABLE of PE2. false: unmask the individual error sources of the error pin output from Unintended DISABLE/ENABLE of PE2.
          function name McuMiNotification [0..1]: set at post-build, origin=Renesas_v1.0.0, default-value=NULL_PTR, regular-expression=[a-zA-Z][a-zA-Z0-9_]*  # This parameter contains notification function for MI notification. | The syntax for McuMiNotification should be provided as Mcu_EcmMINotification.
          function name McuNmiNotification [0..1]: set at post-build, origin=Renesas_v1.0.0, default-value=NULL_PTR, regular-expression=[a-zA-Z][a-zA-Z0-9_]*  # This parameter contains notification function for NMI notification. | The syntax for McuNmiNotification should be provided as Mcu_EcmNMINotification.
          function name McuEcmInitialNotification [0..1]: set at post-build, origin=Renesas_v1.0.2, default-value=NULL_PTR, regular-expression=[a-zA-Z][a-zA-Z0-9_]*  # This parameter is used for notify the upper layer, if any ECM error has been already detected at system start-up. | The syntax for McuEcmInitialNotification should be provided as Mcu_EcmInitialNotification.
        container McuEcmErrorSource88  # This container contains all the supported configuration parameters of the related error source from Unintended deactivation of user mode.
          boolean McuEcmErrorMaskableInterrupt: set at post-build, origin=Renesas_v1.0.0, default-value=false  # This parameter enables or disables generation of a maskable interrupt when the error occurs from Unintended deactivation of user mode. | true: enables generation of a maskable interrupt when the error occurs from Unintended deactivation of user mode. false: disables generation of a maskable interrupt when the error occurs from Unintended deactivation of user mode.
          boolean McuEcmErrorNonMaskableInterrupt: set at post-build, origin=Renesas_v1.0.0, default-value=false  # This parameter enables or disables generation of a non-maskable interrupt when the error occurs from Unintended deactivation of user mode. | true: enables generation of a non-maskable interrupt when the error occurs from Unintended deactivation of user mode. false: disables generation of a non-maskable interrupt when the error occurs from Unintended deactivation of user mode.
          boolean McuEcmErrorInternalReset: set at post-build, origin=Renesas_v1.0.0, default-value=false  # This parameter enables or disables generation of an internal reset when the error occurs from Unintended deactivation of user mode. | true: enables generation of an internal reset when the error occurs from Unintended deactivation of user mode. false: disables generation of an internal reset when the error occurs from Unintended deactivation of user mode.
          boolean McuEcmErrorNMIDelayTimer: set at post-build, origin=Renesas_v1.0.0, default-value=false  # This parameter enables or disables delay timer start caused by non-maskable interrupts in response to errors from Unintended deactivation of user mode. | true: enables delay timer start caused by non-maskable interrupts in response to errors from Unintended deactivation of user mode. false: disables delay timer start caused by non-maskable interrupts in response to errors from Unintended deactivation of user mode.
          boolean McuEcmErrorMIDelayTimer: set at post-build, origin=Renesas_v1.0.0, default-value=false  # This parameter enables or disables delay timer start caused by maskable interrupts in response to errors from Unintended deactivation of user mode. | true: enables delay timer start caused by maskable interrupts in response to errors from Unintended deactivation of user mode. false: disables delay timer start caused by maskable interrupts in response to errors from Unintended deactivation of user mode.
          boolean McuEcmErrorOutputMask: set at post-build, origin=Renesas_v1.0.0, default-value=true  # This parameter mask or unmask the individual error sources of the error pin output from Unintended deactivation of user mode. | true: mask the individual error sources of the error pin output from Unintended deactivation of user mode. false: unmask the individual error sources of the error pin output from Unintended deactivation of user mode.
          function name McuMiNotification [0..1]: set at post-build, origin=Renesas_v1.0.0, default-value=NULL_PTR, regular-expression=[a-zA-Z][a-zA-Z0-9_]*  # This parameter contains notification function for MI notification. | The syntax for McuMiNotification should be provided as Mcu_EcmMINotification.
          function name McuNmiNotification [0..1]: set at post-build, origin=Renesas_v1.0.0, default-value=NULL_PTR, regular-expression=[a-zA-Z][a-zA-Z0-9_]*  # This parameter contains notification function for NMI notification. | The syntax for McuNmiNotification should be provided as Mcu_EcmNMINotification.
          function name McuEcmInitialNotification [0..1]: set at post-build, origin=Renesas_v1.0.2, default-value=NULL_PTR, regular-expression=[a-zA-Z][a-zA-Z0-9_]*  # This parameter is used for notify the upper layer, if any ECM error has been already detected at system start-up. | The syntax for McuEcmInitialNotification should be provided as Mcu_EcmInitialNotification.
        container McuEcmErrorSource89  # This container contains all the supported configuration parameters of the related error source from Unintended activation of code flash programming mode.
          boolean McuEcmErrorMaskableInterrupt: set at post-build, origin=Renesas_v1.0.0, default-value=false  # This parameter enables or disables generation of a maskable interrupt when the error occurs from Unintended activation of code flash programming mode. | true: enables generation of a maskable interrupt when the error occurs from Unintended activation of code flash programming mode. false: disables generation of a maskable interrupt when the error occurs from Unintended activation of code flash programming mode.
          boolean McuEcmErrorNonMaskableInterrupt: set at post-build, origin=Renesas_v1.0.0, default-value=false  # This parameter enables or disables generation of a non-maskable interrupt when the error occurs from Unintended activation of code flash programming mode. | true: enables generation of a non-maskable interrupt when the error occurs from Unintended activation of code flash programming mode. false: disables generation of a non-maskable interrupt when the error occurs from Unintended activation of code flash programming mode.
          boolean McuEcmErrorInternalReset: set at post-build, origin=Renesas_v1.0.0, default-value=false  # This parameter enables or disables generation of an internal reset when the error occurs from Unintended activation of code flash programming mode. | true: enables generation of an internal reset when the error occurs from Unintended activation of code flash programming mode. false: disables generation of an internal reset when the error occurs from Unintended activation of code flash programming mode.
          boolean McuEcmErrorNMIDelayTimer: set at post-build, origin=Renesas_v1.0.0, default-value=false  # This parameter enables or disables delay timer start caused by non-maskable interrupts in response to errors from Unintended activation of code flash programming mode. | true: enables delay timer start caused by non-maskable interrupts in response to errors from Unintended activation of code flash programming mode. false: disables delay timer start caused by non-maskable interrupts in response to errors from Unintended activation of code flash programming mode.
          boolean McuEcmErrorMIDelayTimer: set at post-build, origin=Renesas_v1.0.0, default-value=false  # This parameter enables or disables delay timer start caused by maskable interrupts in response to errors from Unintended activation of code flash programming mode. | true: enables delay timer start caused by maskable interrupts in response to errors from Unintended activation of code flash programming mode. false: disables delay timer start caused by maskable interrupts in response to errors from Unintended activation of code flash programming mode.
          boolean McuEcmErrorOutputMask: set at post-build, origin=Renesas_v1.0.0, default-value=true  # This parameter mask or unmask the individual error sources of the error pin output from Unintended activation of code flash programming mode. | true: mask the individual error sources of the error pin output from Unintended activation of code flash programming mode. false: unmask the individual error sources of the error pin output from Unintended activation of code flash programming mode.
          function name McuMiNotification [0..1]: set at post-build, origin=Renesas_v1.0.0, default-value=NULL_PTR, regular-expression=[a-zA-Z][a-zA-Z0-9_]*  # This parameter contains notification function for MI notification. | The syntax for McuMiNotification should be provided as Mcu_EcmMINotification.
          function name McuNmiNotification [0..1]: set at post-build, origin=Renesas_v1.0.0, default-value=NULL_PTR, regular-expression=[a-zA-Z][a-zA-Z0-9_]*  # This parameter contains notification function for NMI notification. | The syntax for McuNmiNotification should be provided as Mcu_EcmNMINotification.
          function name McuEcmInitialNotification [0..1]: set at post-build, origin=Renesas_v1.0.2, default-value=NULL_PTR, regular-expression=[a-zA-Z][a-zA-Z0-9_]*  # This parameter is used for notify the upper layer, if any ECM error has been already detected at system start-up. | The syntax for McuEcmInitialNotification should be provided as Mcu_EcmInitialNotification.
        container McuEcmErrorSource90  # This container contains all the supported configuration parameters of the related error source from Unintended Debug enable detection .
          boolean McuEcmErrorMaskableInterrupt: set at post-build, origin=Renesas_v1.0.0, default-value=false  # This parameter enables or disables generation of a maskable interrupt when the error occurs from Unintended Debug enable detection. | true: enables generation of a maskable interrupt when the error occurs from Unintended Debug enable detection. false: disables generation of a maskable interrupt when the error occurs from Unintended Debug enable detection.
          boolean McuEcmErrorNonMaskableInterrupt: set at post-build, origin=Renesas_v1.0.0, default-value=false  # This parameter enables or disables generation of a non-maskable interrupt when the error occurs from Unintended Debug enable detection. | true: enables generation of a non-maskable interrupt when the error occurs from Unintended Debug enable detection. false: disables generation of a non-maskable interrupt when the error occurs from Unintended Debug enable detection.
          boolean McuEcmErrorInternalReset: set at post-build, origin=Renesas_v1.0.0, default-value=false  # This parameter enables or disables generation of an internal reset when the error occurs from Unintended Debug enable detection. | true: enables generation of an internal reset when the error occurs from Unintended Debug enable detection. false: disables generation of an internal reset when the error occurs from Unintended Debug enable detection.
          boolean McuEcmErrorNMIDelayTimer: set at post-build, origin=Renesas_v1.0.0, default-value=false  # This parameter enables or disables delay timer start caused by non-maskable interrupts in response to errors from Unintended Debug enable detection. | true: enables delay timer start caused by non-maskable interrupts in response to errors from Unintended Debug enable detection. false: disables delay timer start caused by non-maskable interrupts in response to errors from Unintended Debug enable detection.
          boolean McuEcmErrorMIDelayTimer: set at post-build, origin=Renesas_v1.0.0, default-value=false  # This parameter enables or disables delay timer start caused by maskable interrupts in response to errors from Unintended Debug enable detection. | true: enables delay timer start caused by maskable interrupts in response to errors from Unintended Debug enable detection. false: disables delay timer start caused by maskable interrupts in response to errors from Unintended Debug enable detection.
          boolean McuEcmErrorOutputMask: set at post-build, origin=Renesas_v1.0.0, default-value=true  # This parameter mask or unmask the individual error sources of the error pin output from Unintended Debug enable detection. | true: mask the individual error sources of the error pin output from Unintended Debug enable detection. false: unmask the individual error sources of the error pin output from Unintended Debug enable detection.
          function name McuMiNotification [0..1]: set at post-build, origin=Renesas_v1.0.0, default-value=NULL_PTR, regular-expression=[a-zA-Z][a-zA-Z0-9_]*  # This parameter contains notification function for MI notification. | The syntax for McuMiNotification should be provided as Mcu_EcmMINotification.
          function name McuNmiNotification [0..1]: set at post-build, origin=Renesas_v1.0.0, default-value=NULL_PTR, regular-expression=[a-zA-Z][a-zA-Z0-9_]*  # This parameter contains notification function for NMI notification. | The syntax for McuNmiNotification should be provided as Mcu_EcmNMINotification.
          function name McuEcmInitialNotification [0..1]: set at post-build, origin=Renesas_v1.0.2, default-value=NULL_PTR, regular-expression=[a-zA-Z][a-zA-Z0-9_]*  # This parameter is used for notify the upper layer, if any ECM error has been already detected at system start-up. | The syntax for McuEcmInitialNotification should be provided as Mcu_EcmInitialNotification.
        container McuEcmErrorSource91  # This container contains all the supported configuration parameters of the related error source from Unintended activation of test mode.
          boolean McuEcmErrorMaskableInterrupt: set at post-build, origin=Renesas_v1.0.0, default-value=false  # This parameter enables or disables generation of a maskable interrupt when the error occurs from Unintended activation of test mode. | true: enables generation of a maskable interrupt when the error occurs from Unintended activation of test mode. false: disables generation of a maskable interrupt when the error occurs from Unintended activation of test mode.
          boolean McuEcmErrorNonMaskableInterrupt: set at post-build, origin=Renesas_v1.0.0, default-value=false  # This parameter enables or disables generation of a non-maskable interrupt when the error occurs from Unintended activation of test mode. | true: enables generation of a non-maskable interrupt when the error occurs from Unintended activation of test mode. false: disables generation of a non-maskable interrupt when the error occurs from Unintended activation of test mode.
          boolean McuEcmErrorInternalReset: set at post-build, origin=Renesas_v1.0.0, default-value=false  # This parameter enables or disables generation of an internal reset when the error occurs from Unintended activation of test mode. | true: enables generation of an internal reset when the error occurs from Unintended activation of test mode. false: disables generation of an internal reset when the error occurs from Unintended activation of test mode.
          boolean McuEcmErrorNMIDelayTimer: set at post-build, origin=Renesas_v1.0.0, default-value=false  # This parameter enables or disables delay timer start caused by non-maskable interrupts in response to errors Unintended activation of test mode. | true: enables delay timer start caused by non-maskable interrupts in response to errors from Unintended activation of test mode. false: disables delay timer start caused by non-maskable interrupts in response to errors from Unintended activation of test mode.
          boolean McuEcmErrorMIDelayTimer: set at post-build, origin=Renesas_v1.0.0, default-value=false  # This parameter enables or disables delay timer start caused by maskable interrupts in response to errors from Unintended activation of test mode. | true: enables delay timer start caused by maskable interrupts in response to errors from Unintended activation of test mode. false: disables delay timer start caused by maskable interrupts in response to errors from Unintended activation of test mode.
          boolean McuEcmErrorOutputMask: set at post-build, origin=Renesas_v1.0.0, default-value=true  # This parameter mask or unmask the individual error sources of the error pin output from Unintended activation of test mode. | true: mask the individual error sources of the error pin output from Unintended activation of test mode. false: unmask the individual error sources of the error pin output from Unintended activation of test mode.
          function name McuMiNotification [0..1]: set at post-build, origin=Renesas_v1.0.0, default-value=NULL_PTR, regular-expression=[a-zA-Z][a-zA-Z0-9_]*  # This parameter contains notification function for MI notification. | The syntax for McuMiNotification should be provided as Mcu_EcmMINotification.
          function name McuNmiNotification [0..1]: set at post-build, origin=Renesas_v1.0.0, default-value=NULL_PTR, regular-expression=[a-zA-Z][a-zA-Z0-9_]*  # This parameter contains notification function for NMI notification. | The syntax for McuNmiNotification should be provided as Mcu_EcmNMINotification.
          function name McuEcmInitialNotification [0..1]: set at post-build, origin=Renesas_v1.0.2, default-value=NULL_PTR, regular-expression=[a-zA-Z][a-zA-Z0-9_]*  # This parameter is used for notify the upper layer, if any ECM error has been already detected at system start-up. | The syntax for McuEcmInitialNotification should be provided as Mcu_EcmInitialNotification.
        container McuEcmErrorSource92  # This container contains all the supported configuration parameters of the related error source from ECM Compare Error.
          boolean McuEcmErrorMaskableInterrupt: set at post-build, origin=Renesas_v1.0.0, default-value=false  # This parameter enables or disables generation of a maskable interrupt when the error occurs from ECM Compare Error. | true: enables generation of a maskable interrupt when the error occurs from ECM Compare Error. false: disables generation of a maskable interrupt when the error occurs from ECM Compare Error.
          boolean McuEcmErrorNonMaskableInterrupt: set at post-build, origin=Renesas_v1.0.0, default-value=false  # This parameter enables or disables generation of a non-maskable interrupt when the error occurs from ECM Compare Error. | true: enables generation of a non-maskable interrupt when the error occurs from ECM Compare Error. false: disables generation of a non-maskable interrupt when the error occurs from ECM Compare Error.
          boolean McuEcmErrorInternalReset: set at post-build, origin=Renesas_v1.0.0, default-value=false  # This parameter enables or disables generation of an internal reset when the error occurs from ECM Compare Error. | true: enables generation of an internal reset when the error occurs from ECM Compare Error. false: disables generation of an internal reset when the error occurs from ECM Compare Error.
          boolean McuEcmErrorNMIDelayTimer: set at post-build, origin=Renesas_v1.0.0, default-value=false  # This parameter enables or disables delay timer start caused by non-maskable interrupts in response to errors ECM Compare Error. | true: enables delay timer start caused by non-maskable interrupts in response to errors from ECM Compare Error. false: disables delay timer start caused by non-maskable interrupts in response to errors from ECM Compare Error.
          boolean McuEcmErrorMIDelayTimer: set at post-build, origin=Renesas_v1.0.0, default-value=false  # This parameter enables or disables delay timer start caused by maskable interrupts in response to errors from ECM Compare Error. | true: enables delay timer start caused by maskable interrupts in response to errors from ECM Compare Error. false: disables delay timer start caused by maskable interrupts in response to errors from ECM Compare Error.
          boolean McuEcmErrorOutputMask: set at post-build, origin=Renesas_v1.0.0, default-value=true  # This parameter mask or unmask the individual error sources of the error pin output from ECM Compare Error. | true: mask the individual error sources of the error pin output from ECM Compare Error. false: unmask the individual error sources of the error pin output from ECM Compare Error.
          function name McuMiNotification [0..1]: set at post-build, origin=Renesas_v1.0.0, default-value=NULL_PTR, regular-expression=[a-zA-Z][a-zA-Z0-9_]*  # This parameter contains notification function for MI notification. | The syntax for McuMiNotification should be provided as Mcu_EcmMINotification.
          function name McuNmiNotification [0..1]: set at post-build, origin=Renesas_v1.0.0, default-value=NULL_PTR, regular-expression=[a-zA-Z][a-zA-Z0-9_]*  # This parameter contains notification function for NMI notification. | The syntax for McuNmiNotification should be provided as Mcu_EcmNMINotification.
          function name McuEcmInitialNotification [0..1]: set at post-build, origin=Renesas_v1.0.2, default-value=NULL_PTR, regular-expression=[a-zA-Z][a-zA-Z0-9_]*  # This parameter is used for notify the upper layer, if any ECM error has been already detected at system start-up. | The syntax for McuEcmInitialNotification should be provided as Mcu_EcmInitialNotification.
        container McuEcmErrorSource93  # This container contains all the supported configuration parameters of the related error source for ecm delay timer overflow.
          boolean McuEcmErrorInternalReset: set at post-build, origin=Renesas_v1.0.0, default-value=false  # This parameter enables or disables generation of an internal reset when the ecm delay timer overflow error occurs. | true: enables generation of an internal reset when the ecm delay timer overflow error occurs. false: disables generation of an internal reset when the ecm delay timer overflow error occurs.
          boolean McuEcmErrorOutputMask: set at post-build, origin=Renesas_v1.0.0, default-value=true  # This parameter mask or unmask the individual error sources of the error pin output when the ecm delay timer overflow error occurs. | true: mask the individual error sources of the error pin output when the ecm delay timer overflow error occurs. false: unmask the individual error sources of the error pin output when the ecm delay timer overflow error occurs.
          function name McuEcmInitialNotification [0..1]: set at post-build, origin=Renesas_v1.0.2, default-value=NULL_PTR, regular-expression=[a-zA-Z][a-zA-Z0-9_]*  # This parameter is used for notify the upper layer, if any ECM error has been already detected at system start-up. | The syntax for McuEcmInitialNotification should be provided as Mcu_EcmInitialNotification.
      container McuDemEventParameterRefs  # Container for the references to DemEventParameter elements which shall be invoked using the API Dem_ReportErrorStatus API in case the corresponding error occurs. The EventId is taken from the referenced DemEventParameter's DemEventId value. The standardized errors are provided in the container and can be extended by vendor specific error references.
        symbolic name reference MCU_E_CLOCK_FAILURE: set at pre-compile, destination=DemEventParameter  # Reference to configured DEM event to report "Clock source failure".
        symbolic name reference MCU_E_WRITE_TIMEOUT_FAILURE: set at pre-compile, origin=Renesas_v1.0.0, destination=DemEventParameter  # Reference to configured DEM event to report "write failure".
        symbolic name reference MCU_E_POWERDOWN_MODE_FAILURE: set at pre-compile, origin=Renesas_v1.0.0, destination=DemEventParameter  # Reference to configured DEM event to report "Power Down mode failure".
        symbolic name reference MCU_E_INT_INCONSISTENT [0..1]: set at pre-compile, origin=Renesas_v1.0.2, destination=DemEventParameter  # This parameter specifies the reference to the DemEventParameter which shall be issued when interrupt inconsistency is detected.
        symbolic name reference MCU_E_REG_WRITE_VERIFY [0..1]: set at pre-compile, origin=Renesas_v1.0.2, destination=DemEventParameter  # Reference to the DemEventParameter which shall be issued when a register write-verify failure was detected. If the reference is not configured the error shall not be reported..
        symbolic name reference MCU_E_CLM_SELFDIAG_FAILURE [0..1]: set at pre-compile, origin=Renesas_v1.0.2, destination=DemEventParameter  # Reference to configured DEM event to report "CLM self diagnostic failure".
        symbolic name reference MCU_E_ECM_SELFDIAG_FAILURE [0..1]: set at pre-compile, origin=Renesas_v1.0.2, destination=DemEventParameter  # Reference to configured DEM event to report "ECM self diagnostic failure".
        symbolic name reference MCU_E_CVM_SELFDIAG_FAILURE [0..1]: set at pre-compile, origin=Renesas_v1.0.2, destination=DemEventParameter  # Reference to configured DEM event to report "CVM Self Diagnostic failure".
        symbolic name reference MCU_E_LOCKSTEP_SELFDIAG_FAILURE [0..1]: set at pre-compile, origin=Renesas_v1.0.2, destination=DemEventParameter  # Reference to configured DEM event to report "LockStep self diagnostic failure".
      container McuModeSettingConf [1..2]  # This container contains the configuration (parameters) for the Mode setting of the MCU. Please see MCU035 for more information on the MCU mode settings. This container is not used for implementation.
        integer McuMode: 1..255, set at pre-compile, symbolic-name-value=true, default-value=1  # The parameter represents the MCU Mode settings. This parameter is not used for implementation.
        enumeration McuModeType: {MCU_HALT_MODE, MCU_MODULE_STANDBY_MODE}, set at post-build, origin=Renesas_v1.0.0, default-value=MCU_HALT_MODE  # This parameter contains the power save mode type. The value for this parameter should not be repeated within same configuration set. HALT_MODE: PE1/PE2 will be in Halt Mode. MODULE_STANDBY_MODE: Clock to all the Peripherals and PE1/PE2 will be stopped.
        boolean McuMcanStopTrigger: set at post-build, origin=Renesas_v1.0.0, default-value=false  # This parameter will enables or disables the stop mode triggering of MCAN domain.Depending upon the configuration of this parameter clock to MCAN domain will be stopped before entering into module standby mode | true: enables the stop mode triggering of MCAN domain. false: disables the stop mode triggering of MCAN domain.
        boolean McuFlexrayStopTrigger: set at post-build, origin=Renesas_v1.0.0, default-value=false  # This parameter will enables or disables the stop mode triggering of FLEXRAY domain.Depending upon the configuration of this parameter clock to FLEXRAY domain will be stopped before entering into module standby mode. | true: enables the stop mode triggering of FLEXRAY domain. false: disables the stop mode triggering of FLEXRAY domain.
        boolean McuGtmStopTrigger: set at post-build, origin=Renesas_v1.0.0, default-value=false  # This parameter will enables or disables the stop mode triggering of GTM domain.Depending upon the configuration of this parameter clock to GTM domain will be stopped before entering into module standby mode | true: enables the stop mode triggering of GTM domain. false: disables the stop mode triggering of GTM domain.
        boolean McuEthernetStopTrigger: set at post-build, origin=Renesas_v1.0.0, default-value=false  # This parameter will enables or disables the stop mode triggering of ETHERNET domain.Depending upon the configuration of this parameter clock to ETHERNET domain will be stopped before entering into module standby mode | true: enables the stop mode triggering of ETHERNET domain. false: disables the stop mode triggering of ETHERNET domain.
        boolean McuRsentStopTrigger: set at post-build, origin=Renesas_v1.0.0, default-value=false  # This parameter will enables or disables the stop mode triggering of RSENT domain.Depending upon the configuration of this parameter clock to RSENT domain will be stopped before entering into module standby mode | true: enables the stop mode triggering of RSENT domain. false: disables the stop mode triggering of RSENT domain.
        boolean McuHsUsrtStopTrigger: set at post-build, origin=Renesas_v1.0.0, default-value=false  # This parameter will enables or disables the stop mode triggering of HS-USRT domain.Depending upon the configuration of this parameter clock to HS-USRT domain will be stopped before entering into module standby mode | true: enables the stop mode triggering of HS-USRT domain. false: disables the stop mode triggering of HS-USRT domain.
        boolean McuCsihStopTrigger: set at post-build, origin=Renesas_v1.0.0, default-value=false  # This parameter will enables or disables the stop mode triggering of CSIH domain.Depending upon the configuration of this parameter clock to CSIH domain will be stopped before entering into module standby mode | true: enables the stop mode triggering of CSIH domain. false: disables the stop mode triggering of CSIH domain.
        boolean McuRlin3StopTrigger: set at post-build, origin=Renesas_v1.0.0, default-value=false  # This parameter will enables or disables the stop mode triggering of RLIN3 domain.Depending upon the configuration of this parameter clock to RLIN3 domain will be stopped before entering into module standby mode | true: enables the stop mode triggering of RLIN3 domain. false: disables the stop mode triggering of RLIN3 domain.
        boolean McuAdcStopTrigger: set at post-build, origin=Renesas_v1.0.0, default-value=false  # This parameter will enables or disables the stop mode triggering of ADC domain.Depending upon the configuration of this parameter clock to ADC domain will be stopped before entering into module standby mode | true: enables the stop mode triggering of ADC domain. false: disables the stop mode triggering of ADC domain.
        boolean McuMcanWakeUpTrigger: set at post-build, origin=Renesas_v1.0.0, default-value=false  # This parameter will enables or disables the Wakeup triggering of MCAN domain.Depending upon the configuration of this parameter clock to MCAN domain will be enabled after wakeup from module standby mode. | true: enables the Wakeup triggering of MCAN domain. false: disables the Wakeup triggering of MCAN domain.
        boolean McuFlexrayWakeupTrigger: set at post-build, origin=Renesas_v1.0.0, default-value=false  # This parameter will enables or disables the Wakeup triggering of FLEXRAY domain.Depending upon the configuration of this parameter clock to FLEXRAY domain will be enabled after wakeup from module standby mode | true: enables the Wakeup triggering of FLEXRAY domain. false: disables the Wakeup triggering of FLEXRAY domain.
        boolean McuGtmWakeupTrigger: set at post-build, origin=Renesas_v1.0.0, default-value=false  # This parameter will enables or disables the Wakeup triggering of GTM domain.Depending upon the configuration of this parameter clock to GTM domain will be enabled after wakeup from module standby mode | true: enables the Wakeup triggering of GTM domain. false: disables the Wakeup triggering of GTM domain.
        boolean McuEthernetWakeupTrigger: set at post-build, origin=Renesas_v1.0.0, default-value=false  # This parameter will enables or disables the Wakeup triggering of ETHERNET domain.Depending upon the configuration of this parameter clock to ETHERNET domain will be enabled after wakeup from module standby mode | true: enables the Wakeup triggering of ETHERNET domain. false: disables the Wakeup triggering of ETHERNET domain.
        boolean McuRsentWakeupTrigger: set at post-build, origin=Renesas_v1.0.0, default-value=false  # This parameter will enables or disables the Wakeup triggering of RSENT domain.Depending upon the configuration of this parameter clock to RSENT domain will be enabled after wakeup from module standby mode | true: enables the Wakeup triggering of RSENT domain. false: disables the Wakeup triggering of RSENT domain.
        boolean McuHsUsrtWakeupTrigger: set at post-build, origin=Renesas_v1.0.0, default-value=false  # This parameter will enables or disables the Wakeup triggering of HS-USRT domain.Depending upon the configuration of this parameter clock to HS-USRT domain will be enabled after wakeup from module standby mode | true: enables the Wakeup triggering of HS-USRT domain. false: disables the Wakeup triggering of HS-USRT domain.
        boolean McuCsihWakeupTrigger: set at post-build, origin=Renesas_v1.0.0, default-value=false  # This parameter will enables or disables the Wakeup triggering of CSIH domain.Depending upon the configuration of this parameter clock to CSIH domain will be enabled after wakeup from module standby mode | true: enables the Wakeup triggering of CSIH domain. false: disables the Wakeup triggering of CSIH domain.
        boolean McuRlin3WakeupTrigger: set at post-build, origin=Renesas_v1.0.0, default-value=false  # This parameter will enables or disables the Wakeup triggering of RLIN3 domain.Depending upon the configuration of this parameter clock to RLIN3 domain will be enabled after wakeup from module standby mode | true: enables the Wakeup triggering of RLIN3 domain. false: disables the Wakeup triggering of RLIN3 domain.
        boolean McuAdcWakeupTrigger: set at post-build, origin=Renesas_v1.0.0, default-value=false  # This parameter will enables or disables the Wakeup triggering of ADC domain.Depending upon the configuration of this parameter clock to ADC domain will be enabled after wakeup from module standby mode | true: enables the Wakeup triggering of ADC domain. false: disables the Wakeup triggering of ADC domain.
        container McuWakeUpFactorDetails [1..42]: post-build-changeable=true  # This container contains the configuration of wake up factor for PE/Peripherals.
          enumeration McuWakeUpFactorName: {INTECMMI, INTIPIR0, INTIPIR1, INTICUP, INTWDTA, INTSW0, INTP0, INTP1, INTP2, INTP3, INTP4, INTOTS0OTI, INTOTS0OTULI, INTSTM00, INTSTM01, INTGTM0TIM00, INTGTM0TIM02, INTGTM0MCS00, INTGTM0MCS02, INTADCF012, INTCSIH0TIR, INTCSIH1TIR, INTRLIN33UR2, INTP5, INTP6, INTP7, INTP8, INTP9, INTGTM0TIM01, INTGTM0TIM03, INTMTTCANFE, INTMCAN0FE, INTETNA0, INTFLX0LINE0, INTFLX1LINE0, INTSENT0RI, INTSENT1RI, INTDNFA2WUF0, INTDNFA2WUF1, INTDNFA3WUF0, INTDNFA3WUF1, INTDNFA4WUF0, INTDNFA4WUF1, FEINT, FENMISWDTA}, set at post-build, origin=Renesas_v1.0.0, default-value=INTECMMI  # This parameter contains wake up factor name for PE/Peripherals. The value of this parameter should not be repeated within the McuWakeUpFactorName containers.
      container McuRamSectorSettingConf [1..*]  # This container contains the configuration (parameters) for the RAM Sector setting. Please see MCU030 for more information on RAM sector settings.
        integer McuRamDefaultValue: 0..255, set at post-build, default-value=255  # This parameter shall represent the Data pre-setting to be initialized.
        integer McuRamSectionBaseAddress: 4275961856..4277829631, set at post-build, default-value=4275961856  # This parameter shall represent the MCU RAM section base address.The usable addresses depends on the selected device mode. For LOCAL RAM 128KB having range from 4275961856 to 4276092927(PE1). For LOCAL RAM 64KB having range from 4276027392 to 4276092927(PE2). For VARIABLE RAM 192KB having range from 4276453376 to 4276649983. For GLOBAL RAM BANK A 480KB having range from 4276649984 to 4277141503. For GLOBAL RAM BANK B 480KB having range from 4277141504 to 4277633023. For VARIABLE RAM 192KB having range from 4277633024 to 4277829631.
        integer McuRamSectionSize: 1..65536, set at post-build, default-value=256  # This parameter shall represent the MCU RAM Section size in bytes. For LOCAL RAM 128KB having range 1 to 131072. For VARIABLE RAM 192KB having range 1 to 196608. For GLOBAL RAM BANK A 480KB having range 1 to 491520. For GLOBAL RAM BANK B 480KB having range 1 to 491520. For VARIABLE RAM 192KB having range 1 to 196608.
