AUTOSAR XML (schema 4-0-3)
package /Renesas/EcucDefs_RamTst
  module config RamTst_Rec: definition=RamTst
  bsw implementation RamTst_Impl: programming-language=C, used-code-generator=EXTERNAL, behavior=RamTstBehavior, recommended-configuration=RamTst_Rec, vendor-specific-module-def=RamTst
