AUTOSAR XML (schema 4-0-3)
package /MICROSAR
  module config Dcm_Pre: definition=Dcm
  module config Dcm_Rec: definition=Dcm, implementation-config-variant=VARIANT-PRE-COMPILE
  module config Dcm_Pre_Class1: definition=Dcm
    DcmConfigSet
      DcmDsl
        DcmDslDiagResp: DcmDslDiagRespPeriodicMsgPaddingPattern=0
      DcmGeneral: DcmKeepAliveTime=6
