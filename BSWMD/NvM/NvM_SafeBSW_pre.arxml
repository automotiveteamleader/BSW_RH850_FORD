AUTOSAR XML (schema 4-0-3)
package /MICROSAR
  module config NvM_Rec: definition=NvM
    NvMCommon: NvMSafeBswChecks=1
