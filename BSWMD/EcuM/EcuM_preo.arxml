AUTOSAR XML (schema 4-0-3)
package /MICROSAR
  module config EcuM_Pre: definition=EcuM
  module config EcuM_Rec: definition=EcuM, implementation-config-variant=VARIANT-PRE-COMPILE
    EcuMFlexGeneral: EcuMAlarmClockPresent=0, EcuMResetLoopDetection=0, EcuMEnableDefBehaviour=0
    EcuMGeneral: EcuMDevErrorDetect=1, EcuMIncludeDem=1, EcuMIncludeDet=1, EcuMProductionError=1, EcuMVersionInfoApi=0
  module config EcuM_Rec_Class1: definition=EcuM
  module config EcuM_Rec_Class2: definition=EcuM
